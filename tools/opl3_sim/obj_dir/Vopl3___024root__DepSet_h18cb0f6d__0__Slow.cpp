// Verilated -*- C++ -*-
// DESCRIPTION: Verilator output: Design implementation internals
// See Vopl3.h for the primary calling header

#include "Vopl3__pch.h"
#include "Vopl3___024root.h"

VL_ATTR_COLD void Vopl3___024root___eval_static__TOP(Vopl3___024root* vlSelf);

VL_ATTR_COLD void Vopl3___024root___eval_static(Vopl3___024root* vlSelf) {
    if (false && vlSelf) {}  // Prevent unused
    Vopl3__Syms* const __restrict vlSymsp VL_ATTR_UNUSED = vlSelf->vlSymsp;
    VL_DEBUG_IF(VL_DBG_MSGF("+    Vopl3___024root___eval_static\n"); );
    // Body
    Vopl3___024root___eval_static__TOP(vlSelf);
}

VL_ATTR_COLD void Vopl3___024root___eval_static__TOP(Vopl3___024root* vlSelf) {
    if (false && vlSelf) {}  // Prevent unused
    Vopl3__Syms* const __restrict vlSymsp VL_ATTR_UNUSED = vlSelf->vlSymsp;
    VL_DEBUG_IF(VL_DBG_MSGF("+    Vopl3___024root___eval_static__TOP\n"); );
    // Body
    vlSelf->opl3__DOT__reset_sync__DOT__r0 = 1U;
    vlSelf->opl3__DOT__reset_sync__DOT__r1 = 1U;
    vlSelf->opl3__DOT__reset_sync__DOT__r2 = 1U;
    vlSelf->opl3__DOT__opl3_reg_wr = 0U;
    vlSelf->opl3__DOT__host_if__DOT__cs_p1_n = 1U;
    vlSelf->opl3__DOT__host_if__DOT__wr_p1_n = 1U;
    vlSelf->opl3__DOT__host_if__DOT__address_p1 = 0U;
    vlSelf->opl3__DOT__host_if__DOT__din_p1 = 0U;
    vlSelf->opl3__DOT__host_if__DOT__wr_p2 = 0U;
    vlSelf->opl3__DOT__host_if__DOT__host_status_p1 = 0U;
    vlSelf->opl3__DOT__host_if__DOT__dout_sync__DOT__sync_regs = 0U;
    vlSelf->opl3__DOT__host_if__DOT__genblk1__DOT__trick_sw_detection__DOT__cs_p1_n = 1U;
    vlSelf->opl3__DOT__host_if__DOT__genblk1__DOT__trick_sw_detection__DOT__wr_p1_n = 1U;
    vlSelf->opl3__DOT__host_if__DOT__genblk1__DOT__trick_sw_detection__DOT__rd_p1_n = 1U;
    vlSelf->opl3__DOT__host_if__DOT__genblk1__DOT__trick_sw_detection__DOT__address_p1 = 0U;
    vlSelf->opl3__DOT__host_if__DOT__genblk1__DOT__trick_sw_detection__DOT__din_p1 = 0U;
    vlSelf->opl3__DOT__host_if__DOT__genblk1__DOT__trick_sw_detection__DOT__wr_p2 = 0U;
    vlSelf->opl3__DOT__host_if__DOT__genblk1__DOT__trick_sw_detection__DOT__host_rd_counter = 0U;
    vlSelf->opl3__DOT__host_if__DOT__genblk1__DOT__trick_sw_detection__DOT__rd_p2 = 0U;
    vlSelf->opl3__DOT__host_if__DOT__genblk1__DOT__trick_sw_detection__DOT__host_force_timer_overflow = 0U;
    vlSelf->opl3__DOT__host_if__DOT__genblk1__DOT__trick_sw_detection__DOT__start_counter = 0U;
    vlSelf->opl3__DOT__host_if__DOT__genblk1__DOT__trick_sw_detection__DOT__timer1 = 0U;
    vlSelf->opl3__DOT__host_if__DOT__genblk1__DOT__trick_sw_detection__DOT__force_timer_overflow_sync__DOT__sync_regs = 0U;
    vlSelf->opl3__DOT__sample_clk_en = 0U;
    vlSelf->opl3__DOT__sample_clk_gen__DOT__counter = 0U;
    vlSelf->opl3__DOT__channels__DOT__channel_l = 0U;
    vlSelf->opl3__DOT__channels__DOT__channel_r = 0U;
    vlSelf->opl3__DOT__channels__DOT__channel_valid = 0U;
    vlSelf->opl3__DOT__channels__DOT__connection_sel = 0U;
    vlSelf->opl3__DOT__channels__DOT__is_new = 0U;
    vlSelf->opl3__DOT__channels__DOT__ryt = 0U;
    vlSelf->opl3__DOT__channels__DOT__state = 0U;
    vlSelf->opl3__DOT__channels__DOT__self[0U] = 0U;
    vlSelf->opl3__DOT__channels__DOT__self[1U] = 0U;
    vlSelf->opl3__DOT__channels__DOT__self[2U] = 0U;
    vlSelf->opl3__DOT__channels__DOT__ch_abcd_cnt_mem__DOT__bankgen__BRA__0__KET____DOT__genblk1__DOT__mem_bank__DOT__ram[8U] = 0U;
    vlSelf->opl3__DOT__channels__DOT__ch_abcd_cnt_mem__DOT__bankgen__BRA__0__KET____DOT__genblk1__DOT__mem_bank__DOT__ram[7U] = 0U;
    vlSelf->opl3__DOT__channels__DOT__ch_abcd_cnt_mem__DOT__bankgen__BRA__0__KET____DOT__genblk1__DOT__mem_bank__DOT__ram[6U] = 0U;
    vlSelf->opl3__DOT__channels__DOT__ch_abcd_cnt_mem__DOT__bankgen__BRA__0__KET____DOT__genblk1__DOT__mem_bank__DOT__ram[5U] = 0U;
    vlSelf->opl3__DOT__channels__DOT__ch_abcd_cnt_mem__DOT__bankgen__BRA__0__KET____DOT__genblk1__DOT__mem_bank__DOT__ram[4U] = 0U;
    vlSelf->opl3__DOT__channels__DOT__ch_abcd_cnt_mem__DOT__bankgen__BRA__0__KET____DOT__genblk1__DOT__mem_bank__DOT__ram[3U] = 0U;
    vlSelf->opl3__DOT__channels__DOT__ch_abcd_cnt_mem__DOT__bankgen__BRA__0__KET____DOT__genblk1__DOT__mem_bank__DOT__ram[2U] = 0U;
    vlSelf->opl3__DOT__channels__DOT__ch_abcd_cnt_mem__DOT__bankgen__BRA__0__KET____DOT__genblk1__DOT__mem_bank__DOT__ram[1U] = 0U;
    vlSelf->opl3__DOT__channels__DOT__ch_abcd_cnt_mem__DOT__bankgen__BRA__0__KET____DOT__genblk1__DOT__mem_bank__DOT__ram[0U] = 0U;
    vlSelf->opl3__DOT__channels__DOT__ch_abcd_cnt_mem__DOT__bankgen__BRA__1__KET____DOT__genblk1__DOT__mem_bank__DOT__ram[8U] = 0U;
    vlSelf->opl3__DOT__channels__DOT__ch_abcd_cnt_mem__DOT__bankgen__BRA__1__KET____DOT__genblk1__DOT__mem_bank__DOT__ram[7U] = 0U;
    vlSelf->opl3__DOT__channels__DOT__ch_abcd_cnt_mem__DOT__bankgen__BRA__1__KET____DOT__genblk1__DOT__mem_bank__DOT__ram[6U] = 0U;
    vlSelf->opl3__DOT__channels__DOT__ch_abcd_cnt_mem__DOT__bankgen__BRA__1__KET____DOT__genblk1__DOT__mem_bank__DOT__ram[5U] = 0U;
    vlSelf->opl3__DOT__channels__DOT__ch_abcd_cnt_mem__DOT__bankgen__BRA__1__KET____DOT__genblk1__DOT__mem_bank__DOT__ram[4U] = 0U;
    vlSelf->opl3__DOT__channels__DOT__ch_abcd_cnt_mem__DOT__bankgen__BRA__1__KET____DOT__genblk1__DOT__mem_bank__DOT__ram[3U] = 0U;
    vlSelf->opl3__DOT__channels__DOT__ch_abcd_cnt_mem__DOT__bankgen__BRA__1__KET____DOT__genblk1__DOT__mem_bank__DOT__ram[2U] = 0U;
    vlSelf->opl3__DOT__channels__DOT__ch_abcd_cnt_mem__DOT__bankgen__BRA__1__KET____DOT__genblk1__DOT__mem_bank__DOT__ram[1U] = 0U;
    vlSelf->opl3__DOT__channels__DOT__ch_abcd_cnt_mem__DOT__bankgen__BRA__1__KET____DOT__genblk1__DOT__mem_bank__DOT__ram[0U] = 0U;
    vlSelf->opl3__DOT__channels__DOT__ops_done_pulse = 0U;
    vlSelf->opl3__DOT__channels__DOT__control_operators__DOT__delay_counter = 0U;
    vlSelf->opl3__DOT__channels__DOT__control_operators__DOT__state = 0U;
    vlSelf->opl3__DOT__channels__DOT__control_operators__DOT__bank_num_p1 = 0U;
    vlSelf->opl3__DOT__channels__DOT__control_operators__DOT__op_num_p1 = 0U;
    vlSelf->opl3__DOT__channels__DOT__control_operators__DOT__use_feedback_p1 = 0U;
    vlSelf->opl3__DOT__channels__DOT__control_operators__DOT__modulation_p1 = 0U;
    vlSelf->opl3__DOT__channels__DOT__control_operators__DOT__connection_sel_p1 = 0U;
    vlSelf->opl3__DOT__channels__DOT__control_operators__DOT__ryt_p1 = 0U;
    vlSelf->opl3__DOT__channels__DOT__control_operators__DOT__nts = 0U;
    vlSelf->opl3__DOT__channels__DOT__control_operators__DOT__dvb = 0U;
    vlSelf->opl3__DOT__channels__DOT__control_operators__DOT__dam = 0U;
    vlSelf->opl3__DOT__channels__DOT__control_operators__DOT__bd = 0U;
    vlSelf->opl3__DOT__channels__DOT__control_operators__DOT__sd = 0U;
    vlSelf->opl3__DOT__channels__DOT__control_operators__DOT__tom = 0U;
    vlSelf->opl3__DOT__channels__DOT__control_operators__DOT__tc = 0U;
    vlSelf->opl3__DOT__channels__DOT__control_operators__DOT__hh = 0U;
    vlSelf->opl3__DOT__channels__DOT__control_operators__DOT__am_vib_egt_ksr_mult_mem__DOT__bankgen__BRA__0__KET____DOT__genblk1__DOT__mem_bank__DOT__ram[0x15U] = 0U;
    vlSelf->opl3__DOT__channels__DOT__control_operators__DOT__am_vib_egt_ksr_mult_mem__DOT__bankgen__BRA__0__KET____DOT__genblk1__DOT__mem_bank__DOT__ram[0x14U] = 0U;
    vlSelf->opl3__DOT__channels__DOT__control_operators__DOT__am_vib_egt_ksr_mult_mem__DOT__bankgen__BRA__0__KET____DOT__genblk1__DOT__mem_bank__DOT__ram[0x13U] = 0U;
    vlSelf->opl3__DOT__channels__DOT__control_operators__DOT__am_vib_egt_ksr_mult_mem__DOT__bankgen__BRA__0__KET____DOT__genblk1__DOT__mem_bank__DOT__ram[0x12U] = 0U;
    vlSelf->opl3__DOT__channels__DOT__control_operators__DOT__am_vib_egt_ksr_mult_mem__DOT__bankgen__BRA__0__KET____DOT__genblk1__DOT__mem_bank__DOT__ram[0x11U] = 0U;
    vlSelf->opl3__DOT__channels__DOT__control_operators__DOT__am_vib_egt_ksr_mult_mem__DOT__bankgen__BRA__0__KET____DOT__genblk1__DOT__mem_bank__DOT__ram[0x10U] = 0U;
    vlSelf->opl3__DOT__channels__DOT__control_operators__DOT__am_vib_egt_ksr_mult_mem__DOT__bankgen__BRA__0__KET____DOT__genblk1__DOT__mem_bank__DOT__ram[0xfU] = 0U;
    vlSelf->opl3__DOT__channels__DOT__control_operators__DOT__am_vib_egt_ksr_mult_mem__DOT__bankgen__BRA__0__KET____DOT__genblk1__DOT__mem_bank__DOT__ram[0xeU] = 0U;
    vlSelf->opl3__DOT__channels__DOT__control_operators__DOT__am_vib_egt_ksr_mult_mem__DOT__bankgen__BRA__0__KET____DOT__genblk1__DOT__mem_bank__DOT__ram[0xdU] = 0U;
    vlSelf->opl3__DOT__channels__DOT__control_operators__DOT__am_vib_egt_ksr_mult_mem__DOT__bankgen__BRA__0__KET____DOT__genblk1__DOT__mem_bank__DOT__ram[0xcU] = 0U;
    vlSelf->opl3__DOT__channels__DOT__control_operators__DOT__am_vib_egt_ksr_mult_mem__DOT__bankgen__BRA__0__KET____DOT__genblk1__DOT__mem_bank__DOT__ram[0xbU] = 0U;
    vlSelf->opl3__DOT__channels__DOT__control_operators__DOT__am_vib_egt_ksr_mult_mem__DOT__bankgen__BRA__0__KET____DOT__genblk1__DOT__mem_bank__DOT__ram[0xaU] = 0U;
    vlSelf->opl3__DOT__channels__DOT__control_operators__DOT__am_vib_egt_ksr_mult_mem__DOT__bankgen__BRA__0__KET____DOT__genblk1__DOT__mem_bank__DOT__ram[9U] = 0U;
    vlSelf->opl3__DOT__channels__DOT__control_operators__DOT__am_vib_egt_ksr_mult_mem__DOT__bankgen__BRA__0__KET____DOT__genblk1__DOT__mem_bank__DOT__ram[8U] = 0U;
    vlSelf->opl3__DOT__channels__DOT__control_operators__DOT__am_vib_egt_ksr_mult_mem__DOT__bankgen__BRA__0__KET____DOT__genblk1__DOT__mem_bank__DOT__ram[7U] = 0U;
    vlSelf->opl3__DOT__channels__DOT__control_operators__DOT__am_vib_egt_ksr_mult_mem__DOT__bankgen__BRA__0__KET____DOT__genblk1__DOT__mem_bank__DOT__ram[6U] = 0U;
    vlSelf->opl3__DOT__channels__DOT__control_operators__DOT__am_vib_egt_ksr_mult_mem__DOT__bankgen__BRA__0__KET____DOT__genblk1__DOT__mem_bank__DOT__ram[5U] = 0U;
    vlSelf->opl3__DOT__channels__DOT__control_operators__DOT__am_vib_egt_ksr_mult_mem__DOT__bankgen__BRA__0__KET____DOT__genblk1__DOT__mem_bank__DOT__ram[4U] = 0U;
    vlSelf->opl3__DOT__channels__DOT__control_operators__DOT__am_vib_egt_ksr_mult_mem__DOT__bankgen__BRA__0__KET____DOT__genblk1__DOT__mem_bank__DOT__ram[3U] = 0U;
    vlSelf->opl3__DOT__channels__DOT__control_operators__DOT__am_vib_egt_ksr_mult_mem__DOT__bankgen__BRA__0__KET____DOT__genblk1__DOT__mem_bank__DOT__ram[2U] = 0U;
    vlSelf->opl3__DOT__channels__DOT__control_operators__DOT__am_vib_egt_ksr_mult_mem__DOT__bankgen__BRA__0__KET____DOT__genblk1__DOT__mem_bank__DOT__ram[1U] = 0U;
    vlSelf->opl3__DOT__channels__DOT__control_operators__DOT__am_vib_egt_ksr_mult_mem__DOT__bankgen__BRA__0__KET____DOT__genblk1__DOT__mem_bank__DOT__ram[0U] = 0U;
    vlSelf->opl3__DOT__channels__DOT__control_operators__DOT__am_vib_egt_ksr_mult_mem__DOT__bankgen__BRA__1__KET____DOT__genblk1__DOT__mem_bank__DOT__ram[0x15U] = 0U;
    vlSelf->opl3__DOT__channels__DOT__control_operators__DOT__am_vib_egt_ksr_mult_mem__DOT__bankgen__BRA__1__KET____DOT__genblk1__DOT__mem_bank__DOT__ram[0x14U] = 0U;
    vlSelf->opl3__DOT__channels__DOT__control_operators__DOT__am_vib_egt_ksr_mult_mem__DOT__bankgen__BRA__1__KET____DOT__genblk1__DOT__mem_bank__DOT__ram[0x13U] = 0U;
    vlSelf->opl3__DOT__channels__DOT__control_operators__DOT__am_vib_egt_ksr_mult_mem__DOT__bankgen__BRA__1__KET____DOT__genblk1__DOT__mem_bank__DOT__ram[0x12U] = 0U;
    vlSelf->opl3__DOT__channels__DOT__control_operators__DOT__am_vib_egt_ksr_mult_mem__DOT__bankgen__BRA__1__KET____DOT__genblk1__DOT__mem_bank__DOT__ram[0x11U] = 0U;
    vlSelf->opl3__DOT__channels__DOT__control_operators__DOT__am_vib_egt_ksr_mult_mem__DOT__bankgen__BRA__1__KET____DOT__genblk1__DOT__mem_bank__DOT__ram[0x10U] = 0U;
    vlSelf->opl3__DOT__channels__DOT__control_operators__DOT__am_vib_egt_ksr_mult_mem__DOT__bankgen__BRA__1__KET____DOT__genblk1__DOT__mem_bank__DOT__ram[0xfU] = 0U;
    vlSelf->opl3__DOT__channels__DOT__control_operators__DOT__am_vib_egt_ksr_mult_mem__DOT__bankgen__BRA__1__KET____DOT__genblk1__DOT__mem_bank__DOT__ram[0xeU] = 0U;
    vlSelf->opl3__DOT__channels__DOT__control_operators__DOT__am_vib_egt_ksr_mult_mem__DOT__bankgen__BRA__1__KET____DOT__genblk1__DOT__mem_bank__DOT__ram[0xdU] = 0U;
    vlSelf->opl3__DOT__channels__DOT__control_operators__DOT__am_vib_egt_ksr_mult_mem__DOT__bankgen__BRA__1__KET____DOT__genblk1__DOT__mem_bank__DOT__ram[0xcU] = 0U;
    vlSelf->opl3__DOT__channels__DOT__control_operators__DOT__am_vib_egt_ksr_mult_mem__DOT__bankgen__BRA__1__KET____DOT__genblk1__DOT__mem_bank__DOT__ram[0xbU] = 0U;
    vlSelf->opl3__DOT__channels__DOT__control_operators__DOT__am_vib_egt_ksr_mult_mem__DOT__bankgen__BRA__1__KET____DOT__genblk1__DOT__mem_bank__DOT__ram[0xaU] = 0U;
    vlSelf->opl3__DOT__channels__DOT__control_operators__DOT__am_vib_egt_ksr_mult_mem__DOT__bankgen__BRA__1__KET____DOT__genblk1__DOT__mem_bank__DOT__ram[9U] = 0U;
    vlSelf->opl3__DOT__channels__DOT__control_operators__DOT__am_vib_egt_ksr_mult_mem__DOT__bankgen__BRA__1__KET____DOT__genblk1__DOT__mem_bank__DOT__ram[8U] = 0U;
    vlSelf->opl3__DOT__channels__DOT__control_operators__DOT__am_vib_egt_ksr_mult_mem__DOT__bankgen__BRA__1__KET____DOT__genblk1__DOT__mem_bank__DOT__ram[7U] = 0U;
    vlSelf->opl3__DOT__channels__DOT__control_operators__DOT__am_vib_egt_ksr_mult_mem__DOT__bankgen__BRA__1__KET____DOT__genblk1__DOT__mem_bank__DOT__ram[6U] = 0U;
    vlSelf->opl3__DOT__channels__DOT__control_operators__DOT__am_vib_egt_ksr_mult_mem__DOT__bankgen__BRA__1__KET____DOT__genblk1__DOT__mem_bank__DOT__ram[5U] = 0U;
    vlSelf->opl3__DOT__channels__DOT__control_operators__DOT__am_vib_egt_ksr_mult_mem__DOT__bankgen__BRA__1__KET____DOT__genblk1__DOT__mem_bank__DOT__ram[4U] = 0U;
    vlSelf->opl3__DOT__channels__DOT__control_operators__DOT__am_vib_egt_ksr_mult_mem__DOT__bankgen__BRA__1__KET____DOT__genblk1__DOT__mem_bank__DOT__ram[3U] = 0U;
    vlSelf->opl3__DOT__channels__DOT__control_operators__DOT__am_vib_egt_ksr_mult_mem__DOT__bankgen__BRA__1__KET____DOT__genblk1__DOT__mem_bank__DOT__ram[2U] = 0U;
    vlSelf->opl3__DOT__channels__DOT__control_operators__DOT__am_vib_egt_ksr_mult_mem__DOT__bankgen__BRA__1__KET____DOT__genblk1__DOT__mem_bank__DOT__ram[1U] = 0U;
    vlSelf->opl3__DOT__channels__DOT__control_operators__DOT__am_vib_egt_ksr_mult_mem__DOT__bankgen__BRA__1__KET____DOT__genblk1__DOT__mem_bank__DOT__ram[0U] = 0U;
    vlSelf->opl3__DOT__channels__DOT__control_operators__DOT__ksl_tl_mem__DOT__bankgen__BRA__0__KET____DOT__genblk1__DOT__mem_bank__DOT__ram[0x15U] = 0U;
    vlSelf->opl3__DOT__channels__DOT__control_operators__DOT__ksl_tl_mem__DOT__bankgen__BRA__0__KET____DOT__genblk1__DOT__mem_bank__DOT__ram[0x14U] = 0U;
    vlSelf->opl3__DOT__channels__DOT__control_operators__DOT__ksl_tl_mem__DOT__bankgen__BRA__0__KET____DOT__genblk1__DOT__mem_bank__DOT__ram[0x13U] = 0U;
    vlSelf->opl3__DOT__channels__DOT__control_operators__DOT__ksl_tl_mem__DOT__bankgen__BRA__0__KET____DOT__genblk1__DOT__mem_bank__DOT__ram[0x12U] = 0U;
    vlSelf->opl3__DOT__channels__DOT__control_operators__DOT__ksl_tl_mem__DOT__bankgen__BRA__0__KET____DOT__genblk1__DOT__mem_bank__DOT__ram[0x11U] = 0U;
    vlSelf->opl3__DOT__channels__DOT__control_operators__DOT__ksl_tl_mem__DOT__bankgen__BRA__0__KET____DOT__genblk1__DOT__mem_bank__DOT__ram[0x10U] = 0U;
    vlSelf->opl3__DOT__channels__DOT__control_operators__DOT__ksl_tl_mem__DOT__bankgen__BRA__0__KET____DOT__genblk1__DOT__mem_bank__DOT__ram[0xfU] = 0U;
    vlSelf->opl3__DOT__channels__DOT__control_operators__DOT__ksl_tl_mem__DOT__bankgen__BRA__0__KET____DOT__genblk1__DOT__mem_bank__DOT__ram[0xeU] = 0U;
    vlSelf->opl3__DOT__channels__DOT__control_operators__DOT__ksl_tl_mem__DOT__bankgen__BRA__0__KET____DOT__genblk1__DOT__mem_bank__DOT__ram[0xdU] = 0U;
    vlSelf->opl3__DOT__channels__DOT__control_operators__DOT__ksl_tl_mem__DOT__bankgen__BRA__0__KET____DOT__genblk1__DOT__mem_bank__DOT__ram[0xcU] = 0U;
    vlSelf->opl3__DOT__channels__DOT__control_operators__DOT__ksl_tl_mem__DOT__bankgen__BRA__0__KET____DOT__genblk1__DOT__mem_bank__DOT__ram[0xbU] = 0U;
    vlSelf->opl3__DOT__channels__DOT__control_operators__DOT__ksl_tl_mem__DOT__bankgen__BRA__0__KET____DOT__genblk1__DOT__mem_bank__DOT__ram[0xaU] = 0U;
    vlSelf->opl3__DOT__channels__DOT__control_operators__DOT__ksl_tl_mem__DOT__bankgen__BRA__0__KET____DOT__genblk1__DOT__mem_bank__DOT__ram[9U] = 0U;
    vlSelf->opl3__DOT__channels__DOT__control_operators__DOT__ksl_tl_mem__DOT__bankgen__BRA__0__KET____DOT__genblk1__DOT__mem_bank__DOT__ram[8U] = 0U;
    vlSelf->opl3__DOT__channels__DOT__control_operators__DOT__ksl_tl_mem__DOT__bankgen__BRA__0__KET____DOT__genblk1__DOT__mem_bank__DOT__ram[7U] = 0U;
    vlSelf->opl3__DOT__channels__DOT__control_operators__DOT__ksl_tl_mem__DOT__bankgen__BRA__0__KET____DOT__genblk1__DOT__mem_bank__DOT__ram[6U] = 0U;
    vlSelf->opl3__DOT__channels__DOT__control_operators__DOT__ksl_tl_mem__DOT__bankgen__BRA__0__KET____DOT__genblk1__DOT__mem_bank__DOT__ram[5U] = 0U;
    vlSelf->opl3__DOT__channels__DOT__control_operators__DOT__ksl_tl_mem__DOT__bankgen__BRA__0__KET____DOT__genblk1__DOT__mem_bank__DOT__ram[4U] = 0U;
    vlSelf->opl3__DOT__channels__DOT__control_operators__DOT__ksl_tl_mem__DOT__bankgen__BRA__0__KET____DOT__genblk1__DOT__mem_bank__DOT__ram[3U] = 0U;
    vlSelf->opl3__DOT__channels__DOT__control_operators__DOT__ksl_tl_mem__DOT__bankgen__BRA__0__KET____DOT__genblk1__DOT__mem_bank__DOT__ram[2U] = 0U;
    vlSelf->opl3__DOT__channels__DOT__control_operators__DOT__ksl_tl_mem__DOT__bankgen__BRA__0__KET____DOT__genblk1__DOT__mem_bank__DOT__ram[1U] = 0U;
    vlSelf->opl3__DOT__channels__DOT__control_operators__DOT__ksl_tl_mem__DOT__bankgen__BRA__0__KET____DOT__genblk1__DOT__mem_bank__DOT__ram[0U] = 0U;
    vlSelf->opl3__DOT__channels__DOT__control_operators__DOT__ksl_tl_mem__DOT__bankgen__BRA__1__KET____DOT__genblk1__DOT__mem_bank__DOT__ram[0x15U] = 0U;
    vlSelf->opl3__DOT__channels__DOT__control_operators__DOT__ksl_tl_mem__DOT__bankgen__BRA__1__KET____DOT__genblk1__DOT__mem_bank__DOT__ram[0x14U] = 0U;
    vlSelf->opl3__DOT__channels__DOT__control_operators__DOT__ksl_tl_mem__DOT__bankgen__BRA__1__KET____DOT__genblk1__DOT__mem_bank__DOT__ram[0x13U] = 0U;
    vlSelf->opl3__DOT__channels__DOT__control_operators__DOT__ksl_tl_mem__DOT__bankgen__BRA__1__KET____DOT__genblk1__DOT__mem_bank__DOT__ram[0x12U] = 0U;
    vlSelf->opl3__DOT__channels__DOT__control_operators__DOT__ksl_tl_mem__DOT__bankgen__BRA__1__KET____DOT__genblk1__DOT__mem_bank__DOT__ram[0x11U] = 0U;
    vlSelf->opl3__DOT__channels__DOT__control_operators__DOT__ksl_tl_mem__DOT__bankgen__BRA__1__KET____DOT__genblk1__DOT__mem_bank__DOT__ram[0x10U] = 0U;
    vlSelf->opl3__DOT__channels__DOT__control_operators__DOT__ksl_tl_mem__DOT__bankgen__BRA__1__KET____DOT__genblk1__DOT__mem_bank__DOT__ram[0xfU] = 0U;
    vlSelf->opl3__DOT__channels__DOT__control_operators__DOT__ksl_tl_mem__DOT__bankgen__BRA__1__KET____DOT__genblk1__DOT__mem_bank__DOT__ram[0xeU] = 0U;
    vlSelf->opl3__DOT__channels__DOT__control_operators__DOT__ksl_tl_mem__DOT__bankgen__BRA__1__KET____DOT__genblk1__DOT__mem_bank__DOT__ram[0xdU] = 0U;
    vlSelf->opl3__DOT__channels__DOT__control_operators__DOT__ksl_tl_mem__DOT__bankgen__BRA__1__KET____DOT__genblk1__DOT__mem_bank__DOT__ram[0xcU] = 0U;
    vlSelf->opl3__DOT__channels__DOT__control_operators__DOT__ksl_tl_mem__DOT__bankgen__BRA__1__KET____DOT__genblk1__DOT__mem_bank__DOT__ram[0xbU] = 0U;
    vlSelf->opl3__DOT__channels__DOT__control_operators__DOT__ksl_tl_mem__DOT__bankgen__BRA__1__KET____DOT__genblk1__DOT__mem_bank__DOT__ram[0xaU] = 0U;
    vlSelf->opl3__DOT__channels__DOT__control_operators__DOT__ksl_tl_mem__DOT__bankgen__BRA__1__KET____DOT__genblk1__DOT__mem_bank__DOT__ram[9U] = 0U;
    vlSelf->opl3__DOT__channels__DOT__control_operators__DOT__ksl_tl_mem__DOT__bankgen__BRA__1__KET____DOT__genblk1__DOT__mem_bank__DOT__ram[8U] = 0U;
    vlSelf->opl3__DOT__channels__DOT__control_operators__DOT__ksl_tl_mem__DOT__bankgen__BRA__1__KET____DOT__genblk1__DOT__mem_bank__DOT__ram[7U] = 0U;
    vlSelf->opl3__DOT__channels__DOT__control_operators__DOT__ksl_tl_mem__DOT__bankgen__BRA__1__KET____DOT__genblk1__DOT__mem_bank__DOT__ram[6U] = 0U;
    vlSelf->opl3__DOT__channels__DOT__control_operators__DOT__ksl_tl_mem__DOT__bankgen__BRA__1__KET____DOT__genblk1__DOT__mem_bank__DOT__ram[5U] = 0U;
    vlSelf->opl3__DOT__channels__DOT__control_operators__DOT__ksl_tl_mem__DOT__bankgen__BRA__1__KET____DOT__genblk1__DOT__mem_bank__DOT__ram[4U] = 0U;
    vlSelf->opl3__DOT__channels__DOT__control_operators__DOT__ksl_tl_mem__DOT__bankgen__BRA__1__KET____DOT__genblk1__DOT__mem_bank__DOT__ram[3U] = 0U;
    vlSelf->opl3__DOT__channels__DOT__control_operators__DOT__ksl_tl_mem__DOT__bankgen__BRA__1__KET____DOT__genblk1__DOT__mem_bank__DOT__ram[2U] = 0U;
    vlSelf->opl3__DOT__channels__DOT__control_operators__DOT__ksl_tl_mem__DOT__bankgen__BRA__1__KET____DOT__genblk1__DOT__mem_bank__DOT__ram[1U] = 0U;
    vlSelf->opl3__DOT__channels__DOT__control_operators__DOT__ksl_tl_mem__DOT__bankgen__BRA__1__KET____DOT__genblk1__DOT__mem_bank__DOT__ram[0U] = 0U;
    vlSelf->opl3__DOT__channels__DOT__control_operators__DOT__ar_dr_mem__DOT__bankgen__BRA__0__KET____DOT__genblk1__DOT__mem_bank__DOT__ram[0x15U] = 0U;
    vlSelf->opl3__DOT__channels__DOT__control_operators__DOT__ar_dr_mem__DOT__bankgen__BRA__0__KET____DOT__genblk1__DOT__mem_bank__DOT__ram[0x14U] = 0U;
    vlSelf->opl3__DOT__channels__DOT__control_operators__DOT__ar_dr_mem__DOT__bankgen__BRA__0__KET____DOT__genblk1__DOT__mem_bank__DOT__ram[0x13U] = 0U;
    vlSelf->opl3__DOT__channels__DOT__control_operators__DOT__ar_dr_mem__DOT__bankgen__BRA__0__KET____DOT__genblk1__DOT__mem_bank__DOT__ram[0x12U] = 0U;
    vlSelf->opl3__DOT__channels__DOT__control_operators__DOT__ar_dr_mem__DOT__bankgen__BRA__0__KET____DOT__genblk1__DOT__mem_bank__DOT__ram[0x11U] = 0U;
    vlSelf->opl3__DOT__channels__DOT__control_operators__DOT__ar_dr_mem__DOT__bankgen__BRA__0__KET____DOT__genblk1__DOT__mem_bank__DOT__ram[0x10U] = 0U;
    vlSelf->opl3__DOT__channels__DOT__control_operators__DOT__ar_dr_mem__DOT__bankgen__BRA__0__KET____DOT__genblk1__DOT__mem_bank__DOT__ram[0xfU] = 0U;
    vlSelf->opl3__DOT__channels__DOT__control_operators__DOT__ar_dr_mem__DOT__bankgen__BRA__0__KET____DOT__genblk1__DOT__mem_bank__DOT__ram[0xeU] = 0U;
    vlSelf->opl3__DOT__channels__DOT__control_operators__DOT__ar_dr_mem__DOT__bankgen__BRA__0__KET____DOT__genblk1__DOT__mem_bank__DOT__ram[0xdU] = 0U;
    vlSelf->opl3__DOT__channels__DOT__control_operators__DOT__ar_dr_mem__DOT__bankgen__BRA__0__KET____DOT__genblk1__DOT__mem_bank__DOT__ram[0xcU] = 0U;
    vlSelf->opl3__DOT__channels__DOT__control_operators__DOT__ar_dr_mem__DOT__bankgen__BRA__0__KET____DOT__genblk1__DOT__mem_bank__DOT__ram[0xbU] = 0U;
    vlSelf->opl3__DOT__channels__DOT__control_operators__DOT__ar_dr_mem__DOT__bankgen__BRA__0__KET____DOT__genblk1__DOT__mem_bank__DOT__ram[0xaU] = 0U;
    vlSelf->opl3__DOT__channels__DOT__control_operators__DOT__ar_dr_mem__DOT__bankgen__BRA__0__KET____DOT__genblk1__DOT__mem_bank__DOT__ram[9U] = 0U;
    vlSelf->opl3__DOT__channels__DOT__control_operators__DOT__ar_dr_mem__DOT__bankgen__BRA__0__KET____DOT__genblk1__DOT__mem_bank__DOT__ram[8U] = 0U;
    vlSelf->opl3__DOT__channels__DOT__control_operators__DOT__ar_dr_mem__DOT__bankgen__BRA__0__KET____DOT__genblk1__DOT__mem_bank__DOT__ram[7U] = 0U;
    vlSelf->opl3__DOT__channels__DOT__control_operators__DOT__ar_dr_mem__DOT__bankgen__BRA__0__KET____DOT__genblk1__DOT__mem_bank__DOT__ram[6U] = 0U;
    vlSelf->opl3__DOT__channels__DOT__control_operators__DOT__ar_dr_mem__DOT__bankgen__BRA__0__KET____DOT__genblk1__DOT__mem_bank__DOT__ram[5U] = 0U;
    vlSelf->opl3__DOT__channels__DOT__control_operators__DOT__ar_dr_mem__DOT__bankgen__BRA__0__KET____DOT__genblk1__DOT__mem_bank__DOT__ram[4U] = 0U;
    vlSelf->opl3__DOT__channels__DOT__control_operators__DOT__ar_dr_mem__DOT__bankgen__BRA__0__KET____DOT__genblk1__DOT__mem_bank__DOT__ram[3U] = 0U;
    vlSelf->opl3__DOT__channels__DOT__control_operators__DOT__ar_dr_mem__DOT__bankgen__BRA__0__KET____DOT__genblk1__DOT__mem_bank__DOT__ram[2U] = 0U;
    vlSelf->opl3__DOT__channels__DOT__control_operators__DOT__ar_dr_mem__DOT__bankgen__BRA__0__KET____DOT__genblk1__DOT__mem_bank__DOT__ram[1U] = 0U;
    vlSelf->opl3__DOT__channels__DOT__control_operators__DOT__ar_dr_mem__DOT__bankgen__BRA__0__KET____DOT__genblk1__DOT__mem_bank__DOT__ram[0U] = 0U;
    vlSelf->opl3__DOT__channels__DOT__control_operators__DOT__ar_dr_mem__DOT__bankgen__BRA__1__KET____DOT__genblk1__DOT__mem_bank__DOT__ram[0x15U] = 0U;
    vlSelf->opl3__DOT__channels__DOT__control_operators__DOT__ar_dr_mem__DOT__bankgen__BRA__1__KET____DOT__genblk1__DOT__mem_bank__DOT__ram[0x14U] = 0U;
    vlSelf->opl3__DOT__channels__DOT__control_operators__DOT__ar_dr_mem__DOT__bankgen__BRA__1__KET____DOT__genblk1__DOT__mem_bank__DOT__ram[0x13U] = 0U;
    vlSelf->opl3__DOT__channels__DOT__control_operators__DOT__ar_dr_mem__DOT__bankgen__BRA__1__KET____DOT__genblk1__DOT__mem_bank__DOT__ram[0x12U] = 0U;
    vlSelf->opl3__DOT__channels__DOT__control_operators__DOT__ar_dr_mem__DOT__bankgen__BRA__1__KET____DOT__genblk1__DOT__mem_bank__DOT__ram[0x11U] = 0U;
    vlSelf->opl3__DOT__channels__DOT__control_operators__DOT__ar_dr_mem__DOT__bankgen__BRA__1__KET____DOT__genblk1__DOT__mem_bank__DOT__ram[0x10U] = 0U;
    vlSelf->opl3__DOT__channels__DOT__control_operators__DOT__ar_dr_mem__DOT__bankgen__BRA__1__KET____DOT__genblk1__DOT__mem_bank__DOT__ram[0xfU] = 0U;
    vlSelf->opl3__DOT__channels__DOT__control_operators__DOT__ar_dr_mem__DOT__bankgen__BRA__1__KET____DOT__genblk1__DOT__mem_bank__DOT__ram[0xeU] = 0U;
    vlSelf->opl3__DOT__channels__DOT__control_operators__DOT__ar_dr_mem__DOT__bankgen__BRA__1__KET____DOT__genblk1__DOT__mem_bank__DOT__ram[0xdU] = 0U;
    vlSelf->opl3__DOT__channels__DOT__control_operators__DOT__ar_dr_mem__DOT__bankgen__BRA__1__KET____DOT__genblk1__DOT__mem_bank__DOT__ram[0xcU] = 0U;
    vlSelf->opl3__DOT__channels__DOT__control_operators__DOT__ar_dr_mem__DOT__bankgen__BRA__1__KET____DOT__genblk1__DOT__mem_bank__DOT__ram[0xbU] = 0U;
    vlSelf->opl3__DOT__channels__DOT__control_operators__DOT__ar_dr_mem__DOT__bankgen__BRA__1__KET____DOT__genblk1__DOT__mem_bank__DOT__ram[0xaU] = 0U;
    vlSelf->opl3__DOT__channels__DOT__control_operators__DOT__ar_dr_mem__DOT__bankgen__BRA__1__KET____DOT__genblk1__DOT__mem_bank__DOT__ram[9U] = 0U;
    vlSelf->opl3__DOT__channels__DOT__control_operators__DOT__ar_dr_mem__DOT__bankgen__BRA__1__KET____DOT__genblk1__DOT__mem_bank__DOT__ram[8U] = 0U;
    vlSelf->opl3__DOT__channels__DOT__control_operators__DOT__ar_dr_mem__DOT__bankgen__BRA__1__KET____DOT__genblk1__DOT__mem_bank__DOT__ram[7U] = 0U;
    vlSelf->opl3__DOT__channels__DOT__control_operators__DOT__ar_dr_mem__DOT__bankgen__BRA__1__KET____DOT__genblk1__DOT__mem_bank__DOT__ram[6U] = 0U;
    vlSelf->opl3__DOT__channels__DOT__control_operators__DOT__ar_dr_mem__DOT__bankgen__BRA__1__KET____DOT__genblk1__DOT__mem_bank__DOT__ram[5U] = 0U;
    vlSelf->opl3__DOT__channels__DOT__control_operators__DOT__ar_dr_mem__DOT__bankgen__BRA__1__KET____DOT__genblk1__DOT__mem_bank__DOT__ram[4U] = 0U;
    vlSelf->opl3__DOT__channels__DOT__control_operators__DOT__ar_dr_mem__DOT__bankgen__BRA__1__KET____DOT__genblk1__DOT__mem_bank__DOT__ram[3U] = 0U;
    vlSelf->opl3__DOT__channels__DOT__control_operators__DOT__ar_dr_mem__DOT__bankgen__BRA__1__KET____DOT__genblk1__DOT__mem_bank__DOT__ram[2U] = 0U;
    vlSelf->opl3__DOT__channels__DOT__control_operators__DOT__ar_dr_mem__DOT__bankgen__BRA__1__KET____DOT__genblk1__DOT__mem_bank__DOT__ram[1U] = 0U;
    vlSelf->opl3__DOT__channels__DOT__control_operators__DOT__ar_dr_mem__DOT__bankgen__BRA__1__KET____DOT__genblk1__DOT__mem_bank__DOT__ram[0U] = 0U;
    vlSelf->opl3__DOT__channels__DOT__control_operators__DOT__sl_rr_mem__DOT__bankgen__BRA__0__KET____DOT__genblk1__DOT__mem_bank__DOT__ram[0x15U] = 0U;
    vlSelf->opl3__DOT__channels__DOT__control_operators__DOT__sl_rr_mem__DOT__bankgen__BRA__0__KET____DOT__genblk1__DOT__mem_bank__DOT__ram[0x14U] = 0U;
    vlSelf->opl3__DOT__channels__DOT__control_operators__DOT__sl_rr_mem__DOT__bankgen__BRA__0__KET____DOT__genblk1__DOT__mem_bank__DOT__ram[0x13U] = 0U;
    vlSelf->opl3__DOT__channels__DOT__control_operators__DOT__sl_rr_mem__DOT__bankgen__BRA__0__KET____DOT__genblk1__DOT__mem_bank__DOT__ram[0x12U] = 0U;
    vlSelf->opl3__DOT__channels__DOT__control_operators__DOT__sl_rr_mem__DOT__bankgen__BRA__0__KET____DOT__genblk1__DOT__mem_bank__DOT__ram[0x11U] = 0U;
    vlSelf->opl3__DOT__channels__DOT__control_operators__DOT__sl_rr_mem__DOT__bankgen__BRA__0__KET____DOT__genblk1__DOT__mem_bank__DOT__ram[0x10U] = 0U;
    vlSelf->opl3__DOT__channels__DOT__control_operators__DOT__sl_rr_mem__DOT__bankgen__BRA__0__KET____DOT__genblk1__DOT__mem_bank__DOT__ram[0xfU] = 0U;
    vlSelf->opl3__DOT__channels__DOT__control_operators__DOT__sl_rr_mem__DOT__bankgen__BRA__0__KET____DOT__genblk1__DOT__mem_bank__DOT__ram[0xeU] = 0U;
    vlSelf->opl3__DOT__channels__DOT__control_operators__DOT__sl_rr_mem__DOT__bankgen__BRA__0__KET____DOT__genblk1__DOT__mem_bank__DOT__ram[0xdU] = 0U;
    vlSelf->opl3__DOT__channels__DOT__control_operators__DOT__sl_rr_mem__DOT__bankgen__BRA__0__KET____DOT__genblk1__DOT__mem_bank__DOT__ram[0xcU] = 0U;
    vlSelf->opl3__DOT__channels__DOT__control_operators__DOT__sl_rr_mem__DOT__bankgen__BRA__0__KET____DOT__genblk1__DOT__mem_bank__DOT__ram[0xbU] = 0U;
    vlSelf->opl3__DOT__channels__DOT__control_operators__DOT__sl_rr_mem__DOT__bankgen__BRA__0__KET____DOT__genblk1__DOT__mem_bank__DOT__ram[0xaU] = 0U;
    vlSelf->opl3__DOT__channels__DOT__control_operators__DOT__sl_rr_mem__DOT__bankgen__BRA__0__KET____DOT__genblk1__DOT__mem_bank__DOT__ram[9U] = 0U;
    vlSelf->opl3__DOT__channels__DOT__control_operators__DOT__sl_rr_mem__DOT__bankgen__BRA__0__KET____DOT__genblk1__DOT__mem_bank__DOT__ram[8U] = 0U;
    vlSelf->opl3__DOT__channels__DOT__control_operators__DOT__sl_rr_mem__DOT__bankgen__BRA__0__KET____DOT__genblk1__DOT__mem_bank__DOT__ram[7U] = 0U;
    vlSelf->opl3__DOT__channels__DOT__control_operators__DOT__sl_rr_mem__DOT__bankgen__BRA__0__KET____DOT__genblk1__DOT__mem_bank__DOT__ram[6U] = 0U;
    vlSelf->opl3__DOT__channels__DOT__control_operators__DOT__sl_rr_mem__DOT__bankgen__BRA__0__KET____DOT__genblk1__DOT__mem_bank__DOT__ram[5U] = 0U;
    vlSelf->opl3__DOT__channels__DOT__control_operators__DOT__sl_rr_mem__DOT__bankgen__BRA__0__KET____DOT__genblk1__DOT__mem_bank__DOT__ram[4U] = 0U;
    vlSelf->opl3__DOT__channels__DOT__control_operators__DOT__sl_rr_mem__DOT__bankgen__BRA__0__KET____DOT__genblk1__DOT__mem_bank__DOT__ram[3U] = 0U;
    vlSelf->opl3__DOT__channels__DOT__control_operators__DOT__sl_rr_mem__DOT__bankgen__BRA__0__KET____DOT__genblk1__DOT__mem_bank__DOT__ram[2U] = 0U;
    vlSelf->opl3__DOT__channels__DOT__control_operators__DOT__sl_rr_mem__DOT__bankgen__BRA__0__KET____DOT__genblk1__DOT__mem_bank__DOT__ram[1U] = 0U;
    vlSelf->opl3__DOT__channels__DOT__control_operators__DOT__sl_rr_mem__DOT__bankgen__BRA__0__KET____DOT__genblk1__DOT__mem_bank__DOT__ram[0U] = 0U;
    vlSelf->opl3__DOT__channels__DOT__control_operators__DOT__sl_rr_mem__DOT__bankgen__BRA__1__KET____DOT__genblk1__DOT__mem_bank__DOT__ram[0x15U] = 0U;
    vlSelf->opl3__DOT__channels__DOT__control_operators__DOT__sl_rr_mem__DOT__bankgen__BRA__1__KET____DOT__genblk1__DOT__mem_bank__DOT__ram[0x14U] = 0U;
    vlSelf->opl3__DOT__channels__DOT__control_operators__DOT__sl_rr_mem__DOT__bankgen__BRA__1__KET____DOT__genblk1__DOT__mem_bank__DOT__ram[0x13U] = 0U;
    vlSelf->opl3__DOT__channels__DOT__control_operators__DOT__sl_rr_mem__DOT__bankgen__BRA__1__KET____DOT__genblk1__DOT__mem_bank__DOT__ram[0x12U] = 0U;
    vlSelf->opl3__DOT__channels__DOT__control_operators__DOT__sl_rr_mem__DOT__bankgen__BRA__1__KET____DOT__genblk1__DOT__mem_bank__DOT__ram[0x11U] = 0U;
    vlSelf->opl3__DOT__channels__DOT__control_operators__DOT__sl_rr_mem__DOT__bankgen__BRA__1__KET____DOT__genblk1__DOT__mem_bank__DOT__ram[0x10U] = 0U;
    vlSelf->opl3__DOT__channels__DOT__control_operators__DOT__sl_rr_mem__DOT__bankgen__BRA__1__KET____DOT__genblk1__DOT__mem_bank__DOT__ram[0xfU] = 0U;
    vlSelf->opl3__DOT__channels__DOT__control_operators__DOT__sl_rr_mem__DOT__bankgen__BRA__1__KET____DOT__genblk1__DOT__mem_bank__DOT__ram[0xeU] = 0U;
    vlSelf->opl3__DOT__channels__DOT__control_operators__DOT__sl_rr_mem__DOT__bankgen__BRA__1__KET____DOT__genblk1__DOT__mem_bank__DOT__ram[0xdU] = 0U;
    vlSelf->opl3__DOT__channels__DOT__control_operators__DOT__sl_rr_mem__DOT__bankgen__BRA__1__KET____DOT__genblk1__DOT__mem_bank__DOT__ram[0xcU] = 0U;
    vlSelf->opl3__DOT__channels__DOT__control_operators__DOT__sl_rr_mem__DOT__bankgen__BRA__1__KET____DOT__genblk1__DOT__mem_bank__DOT__ram[0xbU] = 0U;
    vlSelf->opl3__DOT__channels__DOT__control_operators__DOT__sl_rr_mem__DOT__bankgen__BRA__1__KET____DOT__genblk1__DOT__mem_bank__DOT__ram[0xaU] = 0U;
    vlSelf->opl3__DOT__channels__DOT__control_operators__DOT__sl_rr_mem__DOT__bankgen__BRA__1__KET____DOT__genblk1__DOT__mem_bank__DOT__ram[9U] = 0U;
    vlSelf->opl3__DOT__channels__DOT__control_operators__DOT__sl_rr_mem__DOT__bankgen__BRA__1__KET____DOT__genblk1__DOT__mem_bank__DOT__ram[8U] = 0U;
    vlSelf->opl3__DOT__channels__DOT__control_operators__DOT__sl_rr_mem__DOT__bankgen__BRA__1__KET____DOT__genblk1__DOT__mem_bank__DOT__ram[7U] = 0U;
    vlSelf->opl3__DOT__channels__DOT__control_operators__DOT__sl_rr_mem__DOT__bankgen__BRA__1__KET____DOT__genblk1__DOT__mem_bank__DOT__ram[6U] = 0U;
    vlSelf->opl3__DOT__channels__DOT__control_operators__DOT__sl_rr_mem__DOT__bankgen__BRA__1__KET____DOT__genblk1__DOT__mem_bank__DOT__ram[5U] = 0U;
    vlSelf->opl3__DOT__channels__DOT__control_operators__DOT__sl_rr_mem__DOT__bankgen__BRA__1__KET____DOT__genblk1__DOT__mem_bank__DOT__ram[4U] = 0U;
    vlSelf->opl3__DOT__channels__DOT__control_operators__DOT__sl_rr_mem__DOT__bankgen__BRA__1__KET____DOT__genblk1__DOT__mem_bank__DOT__ram[3U] = 0U;
    vlSelf->opl3__DOT__channels__DOT__control_operators__DOT__sl_rr_mem__DOT__bankgen__BRA__1__KET____DOT__genblk1__DOT__mem_bank__DOT__ram[2U] = 0U;
    vlSelf->opl3__DOT__channels__DOT__control_operators__DOT__sl_rr_mem__DOT__bankgen__BRA__1__KET____DOT__genblk1__DOT__mem_bank__DOT__ram[1U] = 0U;
    vlSelf->opl3__DOT__channels__DOT__control_operators__DOT__sl_rr_mem__DOT__bankgen__BRA__1__KET____DOT__genblk1__DOT__mem_bank__DOT__ram[0U] = 0U;
    vlSelf->opl3__DOT__channels__DOT__control_operators__DOT__ws_mem__DOT__bankgen__BRA__0__KET____DOT__genblk1__DOT__mem_bank__DOT__ram[0x15U] = 0U;
    vlSelf->opl3__DOT__channels__DOT__control_operators__DOT__ws_mem__DOT__bankgen__BRA__0__KET____DOT__genblk1__DOT__mem_bank__DOT__ram[0x14U] = 0U;
    vlSelf->opl3__DOT__channels__DOT__control_operators__DOT__ws_mem__DOT__bankgen__BRA__0__KET____DOT__genblk1__DOT__mem_bank__DOT__ram[0x13U] = 0U;
    vlSelf->opl3__DOT__channels__DOT__control_operators__DOT__ws_mem__DOT__bankgen__BRA__0__KET____DOT__genblk1__DOT__mem_bank__DOT__ram[0x12U] = 0U;
    vlSelf->opl3__DOT__channels__DOT__control_operators__DOT__ws_mem__DOT__bankgen__BRA__0__KET____DOT__genblk1__DOT__mem_bank__DOT__ram[0x11U] = 0U;
    vlSelf->opl3__DOT__channels__DOT__control_operators__DOT__ws_mem__DOT__bankgen__BRA__0__KET____DOT__genblk1__DOT__mem_bank__DOT__ram[0x10U] = 0U;
    vlSelf->opl3__DOT__channels__DOT__control_operators__DOT__ws_mem__DOT__bankgen__BRA__0__KET____DOT__genblk1__DOT__mem_bank__DOT__ram[0xfU] = 0U;
    vlSelf->opl3__DOT__channels__DOT__control_operators__DOT__ws_mem__DOT__bankgen__BRA__0__KET____DOT__genblk1__DOT__mem_bank__DOT__ram[0xeU] = 0U;
    vlSelf->opl3__DOT__channels__DOT__control_operators__DOT__ws_mem__DOT__bankgen__BRA__0__KET____DOT__genblk1__DOT__mem_bank__DOT__ram[0xdU] = 0U;
    vlSelf->opl3__DOT__channels__DOT__control_operators__DOT__ws_mem__DOT__bankgen__BRA__0__KET____DOT__genblk1__DOT__mem_bank__DOT__ram[0xcU] = 0U;
    vlSelf->opl3__DOT__channels__DOT__control_operators__DOT__ws_mem__DOT__bankgen__BRA__0__KET____DOT__genblk1__DOT__mem_bank__DOT__ram[0xbU] = 0U;
    vlSelf->opl3__DOT__channels__DOT__control_operators__DOT__ws_mem__DOT__bankgen__BRA__0__KET____DOT__genblk1__DOT__mem_bank__DOT__ram[0xaU] = 0U;
    vlSelf->opl3__DOT__channels__DOT__control_operators__DOT__ws_mem__DOT__bankgen__BRA__0__KET____DOT__genblk1__DOT__mem_bank__DOT__ram[9U] = 0U;
    vlSelf->opl3__DOT__channels__DOT__control_operators__DOT__ws_mem__DOT__bankgen__BRA__0__KET____DOT__genblk1__DOT__mem_bank__DOT__ram[8U] = 0U;
    vlSelf->opl3__DOT__channels__DOT__control_operators__DOT__ws_mem__DOT__bankgen__BRA__0__KET____DOT__genblk1__DOT__mem_bank__DOT__ram[7U] = 0U;
    vlSelf->opl3__DOT__channels__DOT__control_operators__DOT__ws_mem__DOT__bankgen__BRA__0__KET____DOT__genblk1__DOT__mem_bank__DOT__ram[6U] = 0U;
    vlSelf->opl3__DOT__channels__DOT__control_operators__DOT__ws_mem__DOT__bankgen__BRA__0__KET____DOT__genblk1__DOT__mem_bank__DOT__ram[5U] = 0U;
    vlSelf->opl3__DOT__channels__DOT__control_operators__DOT__ws_mem__DOT__bankgen__BRA__0__KET____DOT__genblk1__DOT__mem_bank__DOT__ram[4U] = 0U;
    vlSelf->opl3__DOT__channels__DOT__control_operators__DOT__ws_mem__DOT__bankgen__BRA__0__KET____DOT__genblk1__DOT__mem_bank__DOT__ram[3U] = 0U;
    vlSelf->opl3__DOT__channels__DOT__control_operators__DOT__ws_mem__DOT__bankgen__BRA__0__KET____DOT__genblk1__DOT__mem_bank__DOT__ram[2U] = 0U;
    vlSelf->opl3__DOT__channels__DOT__control_operators__DOT__ws_mem__DOT__bankgen__BRA__0__KET____DOT__genblk1__DOT__mem_bank__DOT__ram[1U] = 0U;
    vlSelf->opl3__DOT__channels__DOT__control_operators__DOT__ws_mem__DOT__bankgen__BRA__0__KET____DOT__genblk1__DOT__mem_bank__DOT__ram[0U] = 0U;
    vlSelf->opl3__DOT__channels__DOT__control_operators__DOT__ws_mem__DOT__bankgen__BRA__1__KET____DOT__genblk1__DOT__mem_bank__DOT__ram[0x15U] = 0U;
    vlSelf->opl3__DOT__channels__DOT__control_operators__DOT__ws_mem__DOT__bankgen__BRA__1__KET____DOT__genblk1__DOT__mem_bank__DOT__ram[0x14U] = 0U;
    vlSelf->opl3__DOT__channels__DOT__control_operators__DOT__ws_mem__DOT__bankgen__BRA__1__KET____DOT__genblk1__DOT__mem_bank__DOT__ram[0x13U] = 0U;
    vlSelf->opl3__DOT__channels__DOT__control_operators__DOT__ws_mem__DOT__bankgen__BRA__1__KET____DOT__genblk1__DOT__mem_bank__DOT__ram[0x12U] = 0U;
    vlSelf->opl3__DOT__channels__DOT__control_operators__DOT__ws_mem__DOT__bankgen__BRA__1__KET____DOT__genblk1__DOT__mem_bank__DOT__ram[0x11U] = 0U;
    vlSelf->opl3__DOT__channels__DOT__control_operators__DOT__ws_mem__DOT__bankgen__BRA__1__KET____DOT__genblk1__DOT__mem_bank__DOT__ram[0x10U] = 0U;
    vlSelf->opl3__DOT__channels__DOT__control_operators__DOT__ws_mem__DOT__bankgen__BRA__1__KET____DOT__genblk1__DOT__mem_bank__DOT__ram[0xfU] = 0U;
    vlSelf->opl3__DOT__channels__DOT__control_operators__DOT__ws_mem__DOT__bankgen__BRA__1__KET____DOT__genblk1__DOT__mem_bank__DOT__ram[0xeU] = 0U;
    vlSelf->opl3__DOT__channels__DOT__control_operators__DOT__ws_mem__DOT__bankgen__BRA__1__KET____DOT__genblk1__DOT__mem_bank__DOT__ram[0xdU] = 0U;
    vlSelf->opl3__DOT__channels__DOT__control_operators__DOT__ws_mem__DOT__bankgen__BRA__1__KET____DOT__genblk1__DOT__mem_bank__DOT__ram[0xcU] = 0U;
    vlSelf->opl3__DOT__channels__DOT__control_operators__DOT__ws_mem__DOT__bankgen__BRA__1__KET____DOT__genblk1__DOT__mem_bank__DOT__ram[0xbU] = 0U;
    vlSelf->opl3__DOT__channels__DOT__control_operators__DOT__ws_mem__DOT__bankgen__BRA__1__KET____DOT__genblk1__DOT__mem_bank__DOT__ram[0xaU] = 0U;
    vlSelf->opl3__DOT__channels__DOT__control_operators__DOT__ws_mem__DOT__bankgen__BRA__1__KET____DOT__genblk1__DOT__mem_bank__DOT__ram[9U] = 0U;
    vlSelf->opl3__DOT__channels__DOT__control_operators__DOT__ws_mem__DOT__bankgen__BRA__1__KET____DOT__genblk1__DOT__mem_bank__DOT__ram[8U] = 0U;
    vlSelf->opl3__DOT__channels__DOT__control_operators__DOT__ws_mem__DOT__bankgen__BRA__1__KET____DOT__genblk1__DOT__mem_bank__DOT__ram[7U] = 0U;
    vlSelf->opl3__DOT__channels__DOT__control_operators__DOT__ws_mem__DOT__bankgen__BRA__1__KET____DOT__genblk1__DOT__mem_bank__DOT__ram[6U] = 0U;
    vlSelf->opl3__DOT__channels__DOT__control_operators__DOT__ws_mem__DOT__bankgen__BRA__1__KET____DOT__genblk1__DOT__mem_bank__DOT__ram[5U] = 0U;
    vlSelf->opl3__DOT__channels__DOT__control_operators__DOT__ws_mem__DOT__bankgen__BRA__1__KET____DOT__genblk1__DOT__mem_bank__DOT__ram[4U] = 0U;
    vlSelf->opl3__DOT__channels__DOT__control_operators__DOT__ws_mem__DOT__bankgen__BRA__1__KET____DOT__genblk1__DOT__mem_bank__DOT__ram[3U] = 0U;
    vlSelf->opl3__DOT__channels__DOT__control_operators__DOT__ws_mem__DOT__bankgen__BRA__1__KET____DOT__genblk1__DOT__mem_bank__DOT__ram[2U] = 0U;
    vlSelf->opl3__DOT__channels__DOT__control_operators__DOT__ws_mem__DOT__bankgen__BRA__1__KET____DOT__genblk1__DOT__mem_bank__DOT__ram[1U] = 0U;
    vlSelf->opl3__DOT__channels__DOT__control_operators__DOT__ws_mem__DOT__bankgen__BRA__1__KET____DOT__genblk1__DOT__mem_bank__DOT__ram[0U] = 0U;
    vlSelf->opl3__DOT__channels__DOT__control_operators__DOT__fnum_low_mem__DOT__bankgen__BRA__0__KET____DOT__genblk1__DOT__mem_bank__DOT__ram[8U] = 0U;
    vlSelf->opl3__DOT__channels__DOT__control_operators__DOT__fnum_low_mem__DOT__bankgen__BRA__0__KET____DOT__genblk1__DOT__mem_bank__DOT__ram[7U] = 0U;
    vlSelf->opl3__DOT__channels__DOT__control_operators__DOT__fnum_low_mem__DOT__bankgen__BRA__0__KET____DOT__genblk1__DOT__mem_bank__DOT__ram[6U] = 0U;
    vlSelf->opl3__DOT__channels__DOT__control_operators__DOT__fnum_low_mem__DOT__bankgen__BRA__0__KET____DOT__genblk1__DOT__mem_bank__DOT__ram[5U] = 0U;
    vlSelf->opl3__DOT__channels__DOT__control_operators__DOT__fnum_low_mem__DOT__bankgen__BRA__0__KET____DOT__genblk1__DOT__mem_bank__DOT__ram[4U] = 0U;
    vlSelf->opl3__DOT__channels__DOT__control_operators__DOT__fnum_low_mem__DOT__bankgen__BRA__0__KET____DOT__genblk1__DOT__mem_bank__DOT__ram[3U] = 0U;
    vlSelf->opl3__DOT__channels__DOT__control_operators__DOT__fnum_low_mem__DOT__bankgen__BRA__0__KET____DOT__genblk1__DOT__mem_bank__DOT__ram[2U] = 0U;
    vlSelf->opl3__DOT__channels__DOT__control_operators__DOT__fnum_low_mem__DOT__bankgen__BRA__0__KET____DOT__genblk1__DOT__mem_bank__DOT__ram[1U] = 0U;
    vlSelf->opl3__DOT__channels__DOT__control_operators__DOT__fnum_low_mem__DOT__bankgen__BRA__0__KET____DOT__genblk1__DOT__mem_bank__DOT__ram[0U] = 0U;
    vlSelf->opl3__DOT__channels__DOT__control_operators__DOT__fnum_low_mem__DOT__bankgen__BRA__1__KET____DOT__genblk1__DOT__mem_bank__DOT__ram[8U] = 0U;
    vlSelf->opl3__DOT__channels__DOT__control_operators__DOT__fnum_low_mem__DOT__bankgen__BRA__1__KET____DOT__genblk1__DOT__mem_bank__DOT__ram[7U] = 0U;
    vlSelf->opl3__DOT__channels__DOT__control_operators__DOT__fnum_low_mem__DOT__bankgen__BRA__1__KET____DOT__genblk1__DOT__mem_bank__DOT__ram[6U] = 0U;
    vlSelf->opl3__DOT__channels__DOT__control_operators__DOT__fnum_low_mem__DOT__bankgen__BRA__1__KET____DOT__genblk1__DOT__mem_bank__DOT__ram[5U] = 0U;
    vlSelf->opl3__DOT__channels__DOT__control_operators__DOT__fnum_low_mem__DOT__bankgen__BRA__1__KET____DOT__genblk1__DOT__mem_bank__DOT__ram[4U] = 0U;
    vlSelf->opl3__DOT__channels__DOT__control_operators__DOT__fnum_low_mem__DOT__bankgen__BRA__1__KET____DOT__genblk1__DOT__mem_bank__DOT__ram[3U] = 0U;
    vlSelf->opl3__DOT__channels__DOT__control_operators__DOT__fnum_low_mem__DOT__bankgen__BRA__1__KET____DOT__genblk1__DOT__mem_bank__DOT__ram[2U] = 0U;
    vlSelf->opl3__DOT__channels__DOT__control_operators__DOT__fnum_low_mem__DOT__bankgen__BRA__1__KET____DOT__genblk1__DOT__mem_bank__DOT__ram[1U] = 0U;
    vlSelf->opl3__DOT__channels__DOT__control_operators__DOT__fnum_low_mem__DOT__bankgen__BRA__1__KET____DOT__genblk1__DOT__mem_bank__DOT__ram[0U] = 0U;
    vlSelf->opl3__DOT__channels__DOT__control_operators__DOT__kon_mem__DOT__state = 0U;
    vlSelf->opl3__DOT__channels__DOT__control_operators__DOT__kon_mem__DOT__self = 0U;
    vlSelf->opl3__DOT__channels__DOT__control_operators__DOT__kon_mem__DOT__bankgen__BRA__0__KET____DOT__genblk1__DOT__mem_bank__DOT__ram[8U] = 0U;
    vlSelf->opl3__DOT__channels__DOT__control_operators__DOT__kon_mem__DOT__bankgen__BRA__0__KET____DOT__genblk1__DOT__mem_bank__DOT__ram[7U] = 0U;
    vlSelf->opl3__DOT__channels__DOT__control_operators__DOT__kon_mem__DOT__bankgen__BRA__0__KET____DOT__genblk1__DOT__mem_bank__DOT__ram[6U] = 0U;
    vlSelf->opl3__DOT__channels__DOT__control_operators__DOT__kon_mem__DOT__bankgen__BRA__0__KET____DOT__genblk1__DOT__mem_bank__DOT__ram[5U] = 0U;
    vlSelf->opl3__DOT__channels__DOT__control_operators__DOT__kon_mem__DOT__bankgen__BRA__0__KET____DOT__genblk1__DOT__mem_bank__DOT__ram[4U] = 0U;
    vlSelf->opl3__DOT__channels__DOT__control_operators__DOT__kon_mem__DOT__bankgen__BRA__0__KET____DOT__genblk1__DOT__mem_bank__DOT__ram[3U] = 0U;
    vlSelf->opl3__DOT__channels__DOT__control_operators__DOT__kon_mem__DOT__bankgen__BRA__0__KET____DOT__genblk1__DOT__mem_bank__DOT__ram[2U] = 0U;
    vlSelf->opl3__DOT__channels__DOT__control_operators__DOT__kon_mem__DOT__bankgen__BRA__0__KET____DOT__genblk1__DOT__mem_bank__DOT__ram[1U] = 0U;
    vlSelf->opl3__DOT__channels__DOT__control_operators__DOT__kon_mem__DOT__bankgen__BRA__0__KET____DOT__genblk1__DOT__mem_bank__DOT__ram[0U] = 0U;
    vlSelf->opl3__DOT__channels__DOT__control_operators__DOT__kon_mem__DOT__bankgen__BRA__1__KET____DOT__genblk1__DOT__mem_bank__DOT__ram[8U] = 0U;
    vlSelf->opl3__DOT__channels__DOT__control_operators__DOT__kon_mem__DOT__bankgen__BRA__1__KET____DOT__genblk1__DOT__mem_bank__DOT__ram[7U] = 0U;
    vlSelf->opl3__DOT__channels__DOT__control_operators__DOT__kon_mem__DOT__bankgen__BRA__1__KET____DOT__genblk1__DOT__mem_bank__DOT__ram[6U] = 0U;
    vlSelf->opl3__DOT__channels__DOT__control_operators__DOT__kon_mem__DOT__bankgen__BRA__1__KET____DOT__genblk1__DOT__mem_bank__DOT__ram[5U] = 0U;
    vlSelf->opl3__DOT__channels__DOT__control_operators__DOT__kon_mem__DOT__bankgen__BRA__1__KET____DOT__genblk1__DOT__mem_bank__DOT__ram[4U] = 0U;
    vlSelf->opl3__DOT__channels__DOT__control_operators__DOT__kon_mem__DOT__bankgen__BRA__1__KET____DOT__genblk1__DOT__mem_bank__DOT__ram[3U] = 0U;
    vlSelf->opl3__DOT__channels__DOT__control_operators__DOT__kon_mem__DOT__bankgen__BRA__1__KET____DOT__genblk1__DOT__mem_bank__DOT__ram[2U] = 0U;
    vlSelf->opl3__DOT__channels__DOT__control_operators__DOT__kon_mem__DOT__bankgen__BRA__1__KET____DOT__genblk1__DOT__mem_bank__DOT__ram[1U] = 0U;
    vlSelf->opl3__DOT__channels__DOT__control_operators__DOT__kon_mem__DOT__bankgen__BRA__1__KET____DOT__genblk1__DOT__mem_bank__DOT__ram[0U] = 0U;
    vlSelf->opl3__DOT__channels__DOT__control_operators__DOT__block_fnum_high_mem__DOT__bankgen__BRA__0__KET____DOT__genblk1__DOT__mem_bank__DOT__ram[8U] = 0U;
    vlSelf->opl3__DOT__channels__DOT__control_operators__DOT__block_fnum_high_mem__DOT__bankgen__BRA__0__KET____DOT__genblk1__DOT__mem_bank__DOT__ram[7U] = 0U;
    vlSelf->opl3__DOT__channels__DOT__control_operators__DOT__block_fnum_high_mem__DOT__bankgen__BRA__0__KET____DOT__genblk1__DOT__mem_bank__DOT__ram[6U] = 0U;
    vlSelf->opl3__DOT__channels__DOT__control_operators__DOT__block_fnum_high_mem__DOT__bankgen__BRA__0__KET____DOT__genblk1__DOT__mem_bank__DOT__ram[5U] = 0U;
    vlSelf->opl3__DOT__channels__DOT__control_operators__DOT__block_fnum_high_mem__DOT__bankgen__BRA__0__KET____DOT__genblk1__DOT__mem_bank__DOT__ram[4U] = 0U;
    vlSelf->opl3__DOT__channels__DOT__control_operators__DOT__block_fnum_high_mem__DOT__bankgen__BRA__0__KET____DOT__genblk1__DOT__mem_bank__DOT__ram[3U] = 0U;
    vlSelf->opl3__DOT__channels__DOT__control_operators__DOT__block_fnum_high_mem__DOT__bankgen__BRA__0__KET____DOT__genblk1__DOT__mem_bank__DOT__ram[2U] = 0U;
    vlSelf->opl3__DOT__channels__DOT__control_operators__DOT__block_fnum_high_mem__DOT__bankgen__BRA__0__KET____DOT__genblk1__DOT__mem_bank__DOT__ram[1U] = 0U;
    vlSelf->opl3__DOT__channels__DOT__control_operators__DOT__block_fnum_high_mem__DOT__bankgen__BRA__0__KET____DOT__genblk1__DOT__mem_bank__DOT__ram[0U] = 0U;
    vlSelf->opl3__DOT__channels__DOT__control_operators__DOT__block_fnum_high_mem__DOT__bankgen__BRA__1__KET____DOT__genblk1__DOT__mem_bank__DOT__ram[8U] = 0U;
    vlSelf->opl3__DOT__channels__DOT__control_operators__DOT__block_fnum_high_mem__DOT__bankgen__BRA__1__KET____DOT__genblk1__DOT__mem_bank__DOT__ram[7U] = 0U;
    vlSelf->opl3__DOT__channels__DOT__control_operators__DOT__block_fnum_high_mem__DOT__bankgen__BRA__1__KET____DOT__genblk1__DOT__mem_bank__DOT__ram[6U] = 0U;
    vlSelf->opl3__DOT__channels__DOT__control_operators__DOT__block_fnum_high_mem__DOT__bankgen__BRA__1__KET____DOT__genblk1__DOT__mem_bank__DOT__ram[5U] = 0U;
    vlSelf->opl3__DOT__channels__DOT__control_operators__DOT__block_fnum_high_mem__DOT__bankgen__BRA__1__KET____DOT__genblk1__DOT__mem_bank__DOT__ram[4U] = 0U;
    vlSelf->opl3__DOT__channels__DOT__control_operators__DOT__block_fnum_high_mem__DOT__bankgen__BRA__1__KET____DOT__genblk1__DOT__mem_bank__DOT__ram[3U] = 0U;
    vlSelf->opl3__DOT__channels__DOT__control_operators__DOT__block_fnum_high_mem__DOT__bankgen__BRA__1__KET____DOT__genblk1__DOT__mem_bank__DOT__ram[2U] = 0U;
    vlSelf->opl3__DOT__channels__DOT__control_operators__DOT__block_fnum_high_mem__DOT__bankgen__BRA__1__KET____DOT__genblk1__DOT__mem_bank__DOT__ram[1U] = 0U;
    vlSelf->opl3__DOT__channels__DOT__control_operators__DOT__block_fnum_high_mem__DOT__bankgen__BRA__1__KET____DOT__genblk1__DOT__mem_bank__DOT__ram[0U] = 0U;
    vlSelf->opl3__DOT__channels__DOT__control_operators__DOT__fb_cnt0_mem__DOT__bankb_p = 0U;
    vlSelf->opl3__DOT__channels__DOT__control_operators__DOT__fb_cnt0_mem__DOT__bankgen__BRA__0__KET____DOT__genblk1__DOT__mem_bank__DOT__ram[8U] = 0U;
    vlSelf->opl3__DOT__channels__DOT__control_operators__DOT__fb_cnt0_mem__DOT__bankgen__BRA__0__KET____DOT__genblk1__DOT__mem_bank__DOT__ram[7U] = 0U;
    vlSelf->opl3__DOT__channels__DOT__control_operators__DOT__fb_cnt0_mem__DOT__bankgen__BRA__0__KET____DOT__genblk1__DOT__mem_bank__DOT__ram[6U] = 0U;
    vlSelf->opl3__DOT__channels__DOT__control_operators__DOT__fb_cnt0_mem__DOT__bankgen__BRA__0__KET____DOT__genblk1__DOT__mem_bank__DOT__ram[5U] = 0U;
    vlSelf->opl3__DOT__channels__DOT__control_operators__DOT__fb_cnt0_mem__DOT__bankgen__BRA__0__KET____DOT__genblk1__DOT__mem_bank__DOT__ram[4U] = 0U;
    vlSelf->opl3__DOT__channels__DOT__control_operators__DOT__fb_cnt0_mem__DOT__bankgen__BRA__0__KET____DOT__genblk1__DOT__mem_bank__DOT__ram[3U] = 0U;
    vlSelf->opl3__DOT__channels__DOT__control_operators__DOT__fb_cnt0_mem__DOT__bankgen__BRA__0__KET____DOT__genblk1__DOT__mem_bank__DOT__ram[2U] = 0U;
    vlSelf->opl3__DOT__channels__DOT__control_operators__DOT__fb_cnt0_mem__DOT__bankgen__BRA__0__KET____DOT__genblk1__DOT__mem_bank__DOT__ram[1U] = 0U;
    vlSelf->opl3__DOT__channels__DOT__control_operators__DOT__fb_cnt0_mem__DOT__bankgen__BRA__0__KET____DOT__genblk1__DOT__mem_bank__DOT__ram[0U] = 0U;
    vlSelf->opl3__DOT__channels__DOT__control_operators__DOT__fb_cnt0_mem__DOT__bankgen__BRA__0__KET____DOT__genblk1__DOT__mem_bank__DOT__genblk1__DOT__dob_p1 = 0U;
    vlSelf->opl3__DOT__channels__DOT__control_operators__DOT__fb_cnt0_mem__DOT__bankgen__BRA__1__KET____DOT__genblk1__DOT__mem_bank__DOT__ram[8U] = 0U;
    vlSelf->opl3__DOT__channels__DOT__control_operators__DOT__fb_cnt0_mem__DOT__bankgen__BRA__1__KET____DOT__genblk1__DOT__mem_bank__DOT__ram[7U] = 0U;
    vlSelf->opl3__DOT__channels__DOT__control_operators__DOT__fb_cnt0_mem__DOT__bankgen__BRA__1__KET____DOT__genblk1__DOT__mem_bank__DOT__ram[6U] = 0U;
    vlSelf->opl3__DOT__channels__DOT__control_operators__DOT__fb_cnt0_mem__DOT__bankgen__BRA__1__KET____DOT__genblk1__DOT__mem_bank__DOT__ram[5U] = 0U;
    vlSelf->opl3__DOT__channels__DOT__control_operators__DOT__fb_cnt0_mem__DOT__bankgen__BRA__1__KET____DOT__genblk1__DOT__mem_bank__DOT__ram[4U] = 0U;
    vlSelf->opl3__DOT__channels__DOT__control_operators__DOT__fb_cnt0_mem__DOT__bankgen__BRA__1__KET____DOT__genblk1__DOT__mem_bank__DOT__ram[3U] = 0U;
    vlSelf->opl3__DOT__channels__DOT__control_operators__DOT__fb_cnt0_mem__DOT__bankgen__BRA__1__KET____DOT__genblk1__DOT__mem_bank__DOT__ram[2U] = 0U;
    vlSelf->opl3__DOT__channels__DOT__control_operators__DOT__fb_cnt0_mem__DOT__bankgen__BRA__1__KET____DOT__genblk1__DOT__mem_bank__DOT__ram[1U] = 0U;
    vlSelf->opl3__DOT__channels__DOT__control_operators__DOT__fb_cnt0_mem__DOT__bankgen__BRA__1__KET____DOT__genblk1__DOT__mem_bank__DOT__ram[0U] = 0U;
    vlSelf->opl3__DOT__channels__DOT__control_operators__DOT__fb_cnt0_mem__DOT__bankgen__BRA__1__KET____DOT__genblk1__DOT__mem_bank__DOT__genblk1__DOT__dob_p1 = 0U;
    vlSelf->opl3__DOT__channels__DOT__control_operators__DOT__fb_cnt1_mem__DOT__bankb_p = 0U;
    vlSelf->opl3__DOT__channels__DOT__control_operators__DOT__fb_cnt1_mem__DOT__bankgen__BRA__0__KET____DOT__genblk1__DOT__mem_bank__DOT__ram[8U] = 0U;
    vlSelf->opl3__DOT__channels__DOT__control_operators__DOT__fb_cnt1_mem__DOT__bankgen__BRA__0__KET____DOT__genblk1__DOT__mem_bank__DOT__ram[7U] = 0U;
    vlSelf->opl3__DOT__channels__DOT__control_operators__DOT__fb_cnt1_mem__DOT__bankgen__BRA__0__KET____DOT__genblk1__DOT__mem_bank__DOT__ram[6U] = 0U;
    vlSelf->opl3__DOT__channels__DOT__control_operators__DOT__fb_cnt1_mem__DOT__bankgen__BRA__0__KET____DOT__genblk1__DOT__mem_bank__DOT__ram[5U] = 0U;
    vlSelf->opl3__DOT__channels__DOT__control_operators__DOT__fb_cnt1_mem__DOT__bankgen__BRA__0__KET____DOT__genblk1__DOT__mem_bank__DOT__ram[4U] = 0U;
    vlSelf->opl3__DOT__channels__DOT__control_operators__DOT__fb_cnt1_mem__DOT__bankgen__BRA__0__KET____DOT__genblk1__DOT__mem_bank__DOT__ram[3U] = 0U;
    vlSelf->opl3__DOT__channels__DOT__control_operators__DOT__fb_cnt1_mem__DOT__bankgen__BRA__0__KET____DOT__genblk1__DOT__mem_bank__DOT__ram[2U] = 0U;
    vlSelf->opl3__DOT__channels__DOT__control_operators__DOT__fb_cnt1_mem__DOT__bankgen__BRA__0__KET____DOT__genblk1__DOT__mem_bank__DOT__ram[1U] = 0U;
    vlSelf->opl3__DOT__channels__DOT__control_operators__DOT__fb_cnt1_mem__DOT__bankgen__BRA__0__KET____DOT__genblk1__DOT__mem_bank__DOT__ram[0U] = 0U;
    vlSelf->opl3__DOT__channels__DOT__control_operators__DOT__fb_cnt1_mem__DOT__bankgen__BRA__0__KET____DOT__genblk1__DOT__mem_bank__DOT__genblk1__DOT__dob_p1 = 0U;
    vlSelf->opl3__DOT__channels__DOT__control_operators__DOT__fb_cnt1_mem__DOT__bankgen__BRA__1__KET____DOT__genblk1__DOT__mem_bank__DOT__ram[8U] = 0U;
    vlSelf->opl3__DOT__channels__DOT__control_operators__DOT__fb_cnt1_mem__DOT__bankgen__BRA__1__KET____DOT__genblk1__DOT__mem_bank__DOT__ram[7U] = 0U;
    vlSelf->opl3__DOT__channels__DOT__control_operators__DOT__fb_cnt1_mem__DOT__bankgen__BRA__1__KET____DOT__genblk1__DOT__mem_bank__DOT__ram[6U] = 0U;
    vlSelf->opl3__DOT__channels__DOT__control_operators__DOT__fb_cnt1_mem__DOT__bankgen__BRA__1__KET____DOT__genblk1__DOT__mem_bank__DOT__ram[5U] = 0U;
    vlSelf->opl3__DOT__channels__DOT__control_operators__DOT__fb_cnt1_mem__DOT__bankgen__BRA__1__KET____DOT__genblk1__DOT__mem_bank__DOT__ram[4U] = 0U;
    vlSelf->opl3__DOT__channels__DOT__control_operators__DOT__fb_cnt1_mem__DOT__bankgen__BRA__1__KET____DOT__genblk1__DOT__mem_bank__DOT__ram[3U] = 0U;
    vlSelf->opl3__DOT__channels__DOT__control_operators__DOT__fb_cnt1_mem__DOT__bankgen__BRA__1__KET____DOT__genblk1__DOT__mem_bank__DOT__ram[2U] = 0U;
    vlSelf->opl3__DOT__channels__DOT__control_operators__DOT__fb_cnt1_mem__DOT__bankgen__BRA__1__KET____DOT__genblk1__DOT__mem_bank__DOT__ram[1U] = 0U;
    vlSelf->opl3__DOT__channels__DOT__control_operators__DOT__fb_cnt1_mem__DOT__bankgen__BRA__1__KET____DOT__genblk1__DOT__mem_bank__DOT__ram[0U] = 0U;
    vlSelf->opl3__DOT__channels__DOT__control_operators__DOT__fb_cnt1_mem__DOT__bankgen__BRA__1__KET____DOT__genblk1__DOT__mem_bank__DOT__genblk1__DOT__dob_p1 = 0U;
    vlSelf->opl3__DOT__channels__DOT__control_operators__DOT__operator__DOT____Vcellout__sample_clk_en_sr__out = 0U;
    vlSelf->opl3__DOT__channels__DOT__control_operators__DOT__operator__DOT__bank_num_p = 0U;
    vlSelf->opl3__DOT__channels__DOT__control_operators__DOT__operator__DOT__op_num_p = 0U;
    vlSelf->opl3__DOT__channels__DOT__control_operators__DOT__operator__DOT__calc_phase_inc__DOT__pre_mult_p1 = 0U;
    vlSelf->opl3__DOT__channels__DOT__control_operators__DOT__operator__DOT__calc_phase_inc__DOT__post_mult_p2 = 0U;
    vlSelf->opl3__DOT__channels__DOT__control_operators__DOT__operator__DOT__calc_phase_inc__DOT__multiplier_p1 = 0U;
    vlSelf->opl3__DOT__channels__DOT__control_operators__DOT__operator__DOT__calc_phase_inc__DOT____Vcellout__vib_sr__out = 0U;
    vlSelf->opl3__DOT__channels__DOT__control_operators__DOT__operator__DOT__calc_phase_inc__DOT__vib_val_p2 = 0U;
    vlSelf->opl3__DOT__channels__DOT__control_operators__DOT__operator__DOT__calc_phase_inc__DOT__vibrato__DOT__vibrato_index_p1 = 0U;
    vlSelf->opl3__DOT__channels__DOT__control_operators__DOT__operator__DOT__calc_phase_inc__DOT__vibrato__DOT__fnum_p1 = 0U;
    vlSelf->opl3__DOT__channels__DOT__control_operators__DOT__operator__DOT__calc_phase_inc__DOT__vibrato__DOT__dvb_p1 = 0U;
    vlSelf->opl3__DOT__channels__DOT__control_operators__DOT__operator__DOT__env_p3 = 0x1ffU;
    vlSelf->opl3__DOT__channels__DOT__control_operators__DOT__operator__DOT__envelope_generator__DOT__state_p1 = 8U;
    vlSelf->opl3__DOT__channels__DOT__control_operators__DOT__operator__DOT__envelope_generator__DOT__state_p2 = 8U;
    vlSelf->opl3__DOT__channels__DOT__control_operators__DOT__operator__DOT__envelope_generator__DOT__state_p3 = 8U;
    vlSelf->opl3__DOT__channels__DOT__control_operators__DOT__operator__DOT__envelope_generator__DOT__env_int_new_p3 = 0U;
    vlSelf->opl3__DOT__channels__DOT__control_operators__DOT__operator__DOT__envelope_generator__DOT____Vcellout__sample_clk_en_sr__out = 0U;
    vlSelf->opl3__DOT__channels__DOT__control_operators__DOT__operator__DOT__envelope_generator__DOT__bank_num_p = 0U;
    vlSelf->opl3__DOT__channels__DOT__control_operators__DOT__operator__DOT__envelope_generator__DOT__op_num_p = 0U;
    vlSelf->opl3__DOT__channels__DOT__control_operators__DOT__operator__DOT__envelope_generator__DOT__tl_p = 0U;
    vlSelf->opl3__DOT__channels__DOT__control_operators__DOT__operator__DOT__envelope_generator__DOT__sl_p = 0U;
    vlSelf->opl3__DOT__channels__DOT__control_operators__DOT__operator__DOT__envelope_generator__DOT__env_int_p = 0U;
    vlSelf->opl3__DOT__channels__DOT__control_operators__DOT__operator__DOT__envelope_generator__DOT____Vcellout__key_on_sr__out = 0U;
    vlSelf->opl3__DOT__channels__DOT__control_operators__DOT__operator__DOT__envelope_generator__DOT____Vcellout__eg_reset_sr__out = 0U;
    vlSelf->opl3__DOT__channels__DOT__control_operators__DOT__operator__DOT__envelope_generator__DOT__ksl_add_p2 = 0U;
    vlSelf->opl3__DOT__channels__DOT__control_operators__DOT__operator__DOT__envelope_generator__DOT__ksl_add_rom__DOT__rom_out_p1 = 0U;
    vlSelf->opl3__DOT__channels__DOT__control_operators__DOT__operator__DOT__envelope_generator__DOT__ksl_add_rom__DOT__tmp0_p1 = 0U;
    vlSelf->opl3__DOT__channels__DOT__control_operators__DOT__operator__DOT__envelope_generator__DOT__ksl_add_rom__DOT__ksl_p1 = 0U;
    vlSelf->opl3__DOT__channels__DOT__control_operators__DOT__operator__DOT__envelope_generator__DOT__state_mem__DOT__bankgen__BRA__0__KET____DOT__genblk1__DOT__mem_bank__DOT__ram[0x11U] = 8U;
    vlSelf->opl3__DOT__channels__DOT__control_operators__DOT__operator__DOT__envelope_generator__DOT__state_mem__DOT__bankgen__BRA__0__KET____DOT__genblk1__DOT__mem_bank__DOT__ram[0x10U] = 8U;
    vlSelf->opl3__DOT__channels__DOT__control_operators__DOT__operator__DOT__envelope_generator__DOT__state_mem__DOT__bankgen__BRA__0__KET____DOT__genblk1__DOT__mem_bank__DOT__ram[0xfU] = 8U;
    vlSelf->opl3__DOT__channels__DOT__control_operators__DOT__operator__DOT__envelope_generator__DOT__state_mem__DOT__bankgen__BRA__0__KET____DOT__genblk1__DOT__mem_bank__DOT__ram[0xeU] = 8U;
    vlSelf->opl3__DOT__channels__DOT__control_operators__DOT__operator__DOT__envelope_generator__DOT__state_mem__DOT__bankgen__BRA__0__KET____DOT__genblk1__DOT__mem_bank__DOT__ram[0xdU] = 8U;
    vlSelf->opl3__DOT__channels__DOT__control_operators__DOT__operator__DOT__envelope_generator__DOT__state_mem__DOT__bankgen__BRA__0__KET____DOT__genblk1__DOT__mem_bank__DOT__ram[0xcU] = 8U;
    vlSelf->opl3__DOT__channels__DOT__control_operators__DOT__operator__DOT__envelope_generator__DOT__state_mem__DOT__bankgen__BRA__0__KET____DOT__genblk1__DOT__mem_bank__DOT__ram[0xbU] = 8U;
    vlSelf->opl3__DOT__channels__DOT__control_operators__DOT__operator__DOT__envelope_generator__DOT__state_mem__DOT__bankgen__BRA__0__KET____DOT__genblk1__DOT__mem_bank__DOT__ram[0xaU] = 8U;
    vlSelf->opl3__DOT__channels__DOT__control_operators__DOT__operator__DOT__envelope_generator__DOT__state_mem__DOT__bankgen__BRA__0__KET____DOT__genblk1__DOT__mem_bank__DOT__ram[9U] = 8U;
    vlSelf->opl3__DOT__channels__DOT__control_operators__DOT__operator__DOT__envelope_generator__DOT__state_mem__DOT__bankgen__BRA__0__KET____DOT__genblk1__DOT__mem_bank__DOT__ram[8U] = 8U;
    vlSelf->opl3__DOT__channels__DOT__control_operators__DOT__operator__DOT__envelope_generator__DOT__state_mem__DOT__bankgen__BRA__0__KET____DOT__genblk1__DOT__mem_bank__DOT__ram[7U] = 8U;
    vlSelf->opl3__DOT__channels__DOT__control_operators__DOT__operator__DOT__envelope_generator__DOT__state_mem__DOT__bankgen__BRA__0__KET____DOT__genblk1__DOT__mem_bank__DOT__ram[6U] = 8U;
    vlSelf->opl3__DOT__channels__DOT__control_operators__DOT__operator__DOT__envelope_generator__DOT__state_mem__DOT__bankgen__BRA__0__KET____DOT__genblk1__DOT__mem_bank__DOT__ram[5U] = 8U;
    vlSelf->opl3__DOT__channels__DOT__control_operators__DOT__operator__DOT__envelope_generator__DOT__state_mem__DOT__bankgen__BRA__0__KET____DOT__genblk1__DOT__mem_bank__DOT__ram[4U] = 8U;
    vlSelf->opl3__DOT__channels__DOT__control_operators__DOT__operator__DOT__envelope_generator__DOT__state_mem__DOT__bankgen__BRA__0__KET____DOT__genblk1__DOT__mem_bank__DOT__ram[3U] = 8U;
    vlSelf->opl3__DOT__channels__DOT__control_operators__DOT__operator__DOT__envelope_generator__DOT__state_mem__DOT__bankgen__BRA__0__KET____DOT__genblk1__DOT__mem_bank__DOT__ram[2U] = 8U;
    vlSelf->opl3__DOT__channels__DOT__control_operators__DOT__operator__DOT__envelope_generator__DOT__state_mem__DOT__bankgen__BRA__0__KET____DOT__genblk1__DOT__mem_bank__DOT__ram[1U] = 8U;
    vlSelf->opl3__DOT__channels__DOT__control_operators__DOT__operator__DOT__envelope_generator__DOT__state_mem__DOT__bankgen__BRA__0__KET____DOT__genblk1__DOT__mem_bank__DOT__ram[0U] = 8U;
    vlSelf->opl3__DOT__channels__DOT__control_operators__DOT__operator__DOT__envelope_generator__DOT__state_mem__DOT__bankgen__BRA__1__KET____DOT__genblk1__DOT__mem_bank__DOT__ram[0x11U] = 8U;
    vlSelf->opl3__DOT__channels__DOT__control_operators__DOT__operator__DOT__envelope_generator__DOT__state_mem__DOT__bankgen__BRA__1__KET____DOT__genblk1__DOT__mem_bank__DOT__ram[0x10U] = 8U;
    vlSelf->opl3__DOT__channels__DOT__control_operators__DOT__operator__DOT__envelope_generator__DOT__state_mem__DOT__bankgen__BRA__1__KET____DOT__genblk1__DOT__mem_bank__DOT__ram[0xfU] = 8U;
    vlSelf->opl3__DOT__channels__DOT__control_operators__DOT__operator__DOT__envelope_generator__DOT__state_mem__DOT__bankgen__BRA__1__KET____DOT__genblk1__DOT__mem_bank__DOT__ram[0xeU] = 8U;
    vlSelf->opl3__DOT__channels__DOT__control_operators__DOT__operator__DOT__envelope_generator__DOT__state_mem__DOT__bankgen__BRA__1__KET____DOT__genblk1__DOT__mem_bank__DOT__ram[0xdU] = 8U;
    vlSelf->opl3__DOT__channels__DOT__control_operators__DOT__operator__DOT__envelope_generator__DOT__state_mem__DOT__bankgen__BRA__1__KET____DOT__genblk1__DOT__mem_bank__DOT__ram[0xcU] = 8U;
    vlSelf->opl3__DOT__channels__DOT__control_operators__DOT__operator__DOT__envelope_generator__DOT__state_mem__DOT__bankgen__BRA__1__KET____DOT__genblk1__DOT__mem_bank__DOT__ram[0xbU] = 8U;
    vlSelf->opl3__DOT__channels__DOT__control_operators__DOT__operator__DOT__envelope_generator__DOT__state_mem__DOT__bankgen__BRA__1__KET____DOT__genblk1__DOT__mem_bank__DOT__ram[0xaU] = 8U;
    vlSelf->opl3__DOT__channels__DOT__control_operators__DOT__operator__DOT__envelope_generator__DOT__state_mem__DOT__bankgen__BRA__1__KET____DOT__genblk1__DOT__mem_bank__DOT__ram[9U] = 8U;
    vlSelf->opl3__DOT__channels__DOT__control_operators__DOT__operator__DOT__envelope_generator__DOT__state_mem__DOT__bankgen__BRA__1__KET____DOT__genblk1__DOT__mem_bank__DOT__ram[8U] = 8U;
    vlSelf->opl3__DOT__channels__DOT__control_operators__DOT__operator__DOT__envelope_generator__DOT__state_mem__DOT__bankgen__BRA__1__KET____DOT__genblk1__DOT__mem_bank__DOT__ram[7U] = 8U;
    vlSelf->opl3__DOT__channels__DOT__control_operators__DOT__operator__DOT__envelope_generator__DOT__state_mem__DOT__bankgen__BRA__1__KET____DOT__genblk1__DOT__mem_bank__DOT__ram[6U] = 8U;
    vlSelf->opl3__DOT__channels__DOT__control_operators__DOT__operator__DOT__envelope_generator__DOT__state_mem__DOT__bankgen__BRA__1__KET____DOT__genblk1__DOT__mem_bank__DOT__ram[5U] = 8U;
    vlSelf->opl3__DOT__channels__DOT__control_operators__DOT__operator__DOT__envelope_generator__DOT__state_mem__DOT__bankgen__BRA__1__KET____DOT__genblk1__DOT__mem_bank__DOT__ram[4U] = 8U;
    vlSelf->opl3__DOT__channels__DOT__control_operators__DOT__operator__DOT__envelope_generator__DOT__state_mem__DOT__bankgen__BRA__1__KET____DOT__genblk1__DOT__mem_bank__DOT__ram[3U] = 8U;
    vlSelf->opl3__DOT__channels__DOT__control_operators__DOT__operator__DOT__envelope_generator__DOT__state_mem__DOT__bankgen__BRA__1__KET____DOT__genblk1__DOT__mem_bank__DOT__ram[2U] = 8U;
    vlSelf->opl3__DOT__channels__DOT__control_operators__DOT__operator__DOT__envelope_generator__DOT__state_mem__DOT__bankgen__BRA__1__KET____DOT__genblk1__DOT__mem_bank__DOT__ram[1U] = 8U;
    vlSelf->opl3__DOT__channels__DOT__control_operators__DOT__operator__DOT__envelope_generator__DOT__state_mem__DOT__bankgen__BRA__1__KET____DOT__genblk1__DOT__mem_bank__DOT__ram[0U] = 8U;
    vlSelf->opl3__DOT__channels__DOT__control_operators__DOT__operator__DOT__envelope_generator__DOT__rate_hi_p2 = 0U;
    vlSelf->opl3__DOT__channels__DOT__control_operators__DOT__operator__DOT__envelope_generator__DOT__env_shift_p2 = 0U;
    vlSelf->opl3__DOT__channels__DOT__control_operators__DOT__operator__DOT__envelope_generator__DOT__calc_envelope_shift__DOT__eg_timer = 0U;
    vlSelf->opl3__DOT__channels__DOT__control_operators__DOT__operator__DOT__envelope_generator__DOT__calc_envelope_shift__DOT__eg_state = 0U;
    vlSelf->opl3__DOT__channels__DOT__control_operators__DOT__operator__DOT__envelope_generator__DOT__calc_envelope_shift__DOT__eg_add = 0U;
    vlSelf->opl3__DOT__channels__DOT__control_operators__DOT__operator__DOT__envelope_generator__DOT__calc_envelope_shift__DOT__rate_p1 = 0U;
    vlSelf->opl3__DOT__channels__DOT__control_operators__DOT__operator__DOT__envelope_generator__DOT__calc_envelope_shift__DOT__eg_timer_lo = 0U;
    vlSelf->opl3__DOT__channels__DOT__control_operators__DOT__operator__DOT__envelope_generator__DOT__calc_envelope_shift__DOT____Vcellout__sample_clk_en_sr__out = 0U;
    vlSelf->opl3__DOT__channels__DOT__control_operators__DOT__operator__DOT__envelope_generator__DOT__calc_envelope_shift__DOT__bank_num_p = 0U;
    vlSelf->opl3__DOT__channels__DOT__control_operators__DOT__operator__DOT__envelope_generator__DOT__calc_envelope_shift__DOT__op_num_p = 0U;
    vlSelf->opl3__DOT__channels__DOT__control_operators__DOT__operator__DOT__envelope_generator__DOT__env_int_mem__DOT__bankgen__BRA__0__KET____DOT__genblk1__DOT__mem_bank__DOT__ram[0x11U] = 0x1ffU;
    vlSelf->opl3__DOT__channels__DOT__control_operators__DOT__operator__DOT__envelope_generator__DOT__env_int_mem__DOT__bankgen__BRA__0__KET____DOT__genblk1__DOT__mem_bank__DOT__ram[0x10U] = 0x1ffU;
    vlSelf->opl3__DOT__channels__DOT__control_operators__DOT__operator__DOT__envelope_generator__DOT__env_int_mem__DOT__bankgen__BRA__0__KET____DOT__genblk1__DOT__mem_bank__DOT__ram[0xfU] = 0x1ffU;
    vlSelf->opl3__DOT__channels__DOT__control_operators__DOT__operator__DOT__envelope_generator__DOT__env_int_mem__DOT__bankgen__BRA__0__KET____DOT__genblk1__DOT__mem_bank__DOT__ram[0xeU] = 0x1ffU;
    vlSelf->opl3__DOT__channels__DOT__control_operators__DOT__operator__DOT__envelope_generator__DOT__env_int_mem__DOT__bankgen__BRA__0__KET____DOT__genblk1__DOT__mem_bank__DOT__ram[0xdU] = 0x1ffU;
    vlSelf->opl3__DOT__channels__DOT__control_operators__DOT__operator__DOT__envelope_generator__DOT__env_int_mem__DOT__bankgen__BRA__0__KET____DOT__genblk1__DOT__mem_bank__DOT__ram[0xcU] = 0x1ffU;
    vlSelf->opl3__DOT__channels__DOT__control_operators__DOT__operator__DOT__envelope_generator__DOT__env_int_mem__DOT__bankgen__BRA__0__KET____DOT__genblk1__DOT__mem_bank__DOT__ram[0xbU] = 0x1ffU;
    vlSelf->opl3__DOT__channels__DOT__control_operators__DOT__operator__DOT__envelope_generator__DOT__env_int_mem__DOT__bankgen__BRA__0__KET____DOT__genblk1__DOT__mem_bank__DOT__ram[0xaU] = 0x1ffU;
    vlSelf->opl3__DOT__channels__DOT__control_operators__DOT__operator__DOT__envelope_generator__DOT__env_int_mem__DOT__bankgen__BRA__0__KET____DOT__genblk1__DOT__mem_bank__DOT__ram[9U] = 0x1ffU;
    vlSelf->opl3__DOT__channels__DOT__control_operators__DOT__operator__DOT__envelope_generator__DOT__env_int_mem__DOT__bankgen__BRA__0__KET____DOT__genblk1__DOT__mem_bank__DOT__ram[8U] = 0x1ffU;
    vlSelf->opl3__DOT__channels__DOT__control_operators__DOT__operator__DOT__envelope_generator__DOT__env_int_mem__DOT__bankgen__BRA__0__KET____DOT__genblk1__DOT__mem_bank__DOT__ram[7U] = 0x1ffU;
    vlSelf->opl3__DOT__channels__DOT__control_operators__DOT__operator__DOT__envelope_generator__DOT__env_int_mem__DOT__bankgen__BRA__0__KET____DOT__genblk1__DOT__mem_bank__DOT__ram[6U] = 0x1ffU;
    vlSelf->opl3__DOT__channels__DOT__control_operators__DOT__operator__DOT__envelope_generator__DOT__env_int_mem__DOT__bankgen__BRA__0__KET____DOT__genblk1__DOT__mem_bank__DOT__ram[5U] = 0x1ffU;
    vlSelf->opl3__DOT__channels__DOT__control_operators__DOT__operator__DOT__envelope_generator__DOT__env_int_mem__DOT__bankgen__BRA__0__KET____DOT__genblk1__DOT__mem_bank__DOT__ram[4U] = 0x1ffU;
    vlSelf->opl3__DOT__channels__DOT__control_operators__DOT__operator__DOT__envelope_generator__DOT__env_int_mem__DOT__bankgen__BRA__0__KET____DOT__genblk1__DOT__mem_bank__DOT__ram[3U] = 0x1ffU;
    vlSelf->opl3__DOT__channels__DOT__control_operators__DOT__operator__DOT__envelope_generator__DOT__env_int_mem__DOT__bankgen__BRA__0__KET____DOT__genblk1__DOT__mem_bank__DOT__ram[2U] = 0x1ffU;
    vlSelf->opl3__DOT__channels__DOT__control_operators__DOT__operator__DOT__envelope_generator__DOT__env_int_mem__DOT__bankgen__BRA__0__KET____DOT__genblk1__DOT__mem_bank__DOT__ram[1U] = 0x1ffU;
    vlSelf->opl3__DOT__channels__DOT__control_operators__DOT__operator__DOT__envelope_generator__DOT__env_int_mem__DOT__bankgen__BRA__0__KET____DOT__genblk1__DOT__mem_bank__DOT__ram[0U] = 0x1ffU;
    vlSelf->opl3__DOT__channels__DOT__control_operators__DOT__operator__DOT__envelope_generator__DOT__env_int_mem__DOT__bankgen__BRA__1__KET____DOT__genblk1__DOT__mem_bank__DOT__ram[0x11U] = 0x1ffU;
    vlSelf->opl3__DOT__channels__DOT__control_operators__DOT__operator__DOT__envelope_generator__DOT__env_int_mem__DOT__bankgen__BRA__1__KET____DOT__genblk1__DOT__mem_bank__DOT__ram[0x10U] = 0x1ffU;
    vlSelf->opl3__DOT__channels__DOT__control_operators__DOT__operator__DOT__envelope_generator__DOT__env_int_mem__DOT__bankgen__BRA__1__KET____DOT__genblk1__DOT__mem_bank__DOT__ram[0xfU] = 0x1ffU;
    vlSelf->opl3__DOT__channels__DOT__control_operators__DOT__operator__DOT__envelope_generator__DOT__env_int_mem__DOT__bankgen__BRA__1__KET____DOT__genblk1__DOT__mem_bank__DOT__ram[0xeU] = 0x1ffU;
    vlSelf->opl3__DOT__channels__DOT__control_operators__DOT__operator__DOT__envelope_generator__DOT__env_int_mem__DOT__bankgen__BRA__1__KET____DOT__genblk1__DOT__mem_bank__DOT__ram[0xdU] = 0x1ffU;
    vlSelf->opl3__DOT__channels__DOT__control_operators__DOT__operator__DOT__envelope_generator__DOT__env_int_mem__DOT__bankgen__BRA__1__KET____DOT__genblk1__DOT__mem_bank__DOT__ram[0xcU] = 0x1ffU;
    vlSelf->opl3__DOT__channels__DOT__control_operators__DOT__operator__DOT__envelope_generator__DOT__env_int_mem__DOT__bankgen__BRA__1__KET____DOT__genblk1__DOT__mem_bank__DOT__ram[0xbU] = 0x1ffU;
    vlSelf->opl3__DOT__channels__DOT__control_operators__DOT__operator__DOT__envelope_generator__DOT__env_int_mem__DOT__bankgen__BRA__1__KET____DOT__genblk1__DOT__mem_bank__DOT__ram[0xaU] = 0x1ffU;
    vlSelf->opl3__DOT__channels__DOT__control_operators__DOT__operator__DOT__envelope_generator__DOT__env_int_mem__DOT__bankgen__BRA__1__KET____DOT__genblk1__DOT__mem_bank__DOT__ram[9U] = 0x1ffU;
    vlSelf->opl3__DOT__channels__DOT__control_operators__DOT__operator__DOT__envelope_generator__DOT__env_int_mem__DOT__bankgen__BRA__1__KET____DOT__genblk1__DOT__mem_bank__DOT__ram[8U] = 0x1ffU;
    vlSelf->opl3__DOT__channels__DOT__control_operators__DOT__operator__DOT__envelope_generator__DOT__env_int_mem__DOT__bankgen__BRA__1__KET____DOT__genblk1__DOT__mem_bank__DOT__ram[7U] = 0x1ffU;
    vlSelf->opl3__DOT__channels__DOT__control_operators__DOT__operator__DOT__envelope_generator__DOT__env_int_mem__DOT__bankgen__BRA__1__KET____DOT__genblk1__DOT__mem_bank__DOT__ram[6U] = 0x1ffU;
    vlSelf->opl3__DOT__channels__DOT__control_operators__DOT__operator__DOT__envelope_generator__DOT__env_int_mem__DOT__bankgen__BRA__1__KET____DOT__genblk1__DOT__mem_bank__DOT__ram[5U] = 0x1ffU;
    vlSelf->opl3__DOT__channels__DOT__control_operators__DOT__operator__DOT__envelope_generator__DOT__env_int_mem__DOT__bankgen__BRA__1__KET____DOT__genblk1__DOT__mem_bank__DOT__ram[4U] = 0x1ffU;
    vlSelf->opl3__DOT__channels__DOT__control_operators__DOT__operator__DOT__envelope_generator__DOT__env_int_mem__DOT__bankgen__BRA__1__KET____DOT__genblk1__DOT__mem_bank__DOT__ram[3U] = 0x1ffU;
    vlSelf->opl3__DOT__channels__DOT__control_operators__DOT__operator__DOT__envelope_generator__DOT__env_int_mem__DOT__bankgen__BRA__1__KET____DOT__genblk1__DOT__mem_bank__DOT__ram[2U] = 0x1ffU;
    vlSelf->opl3__DOT__channels__DOT__control_operators__DOT__operator__DOT__envelope_generator__DOT__env_int_mem__DOT__bankgen__BRA__1__KET____DOT__genblk1__DOT__mem_bank__DOT__ram[1U] = 0x1ffU;
    vlSelf->opl3__DOT__channels__DOT__control_operators__DOT__operator__DOT__envelope_generator__DOT__env_int_mem__DOT__bankgen__BRA__1__KET____DOT__genblk1__DOT__mem_bank__DOT__ram[0U] = 0x1ffU;
    vlSelf->opl3__DOT__channels__DOT__control_operators__DOT__operator__DOT__envelope_generator__DOT__am_val_p2 = 0U;
    vlSelf->opl3__DOT__channels__DOT__control_operators__DOT__operator__DOT__envelope_generator__DOT__tremolo__DOT__tremolo_index_p1 = 0U;
    vlSelf->opl3__DOT__channels__DOT__control_operators__DOT__operator__DOT__envelope_generator__DOT__tremolo__DOT__dam_p1 = 0U;
    vlSelf->opl3__DOT__channels__DOT__control_operators__DOT__out_p6 = 0U;
    vlSelf->opl3__DOT__channels__DOT__control_operators__DOT__operator__DOT__phase_generator__DOT__phase_acc_p3 = 0U;
    vlSelf->opl3__DOT__channels__DOT__control_operators__DOT__operator__DOT__phase_generator__DOT__env_shifted_p4 = 0U;
    vlSelf->opl3__DOT__channels__DOT__control_operators__DOT__operator__DOT__phase_generator__DOT__level_p5 = 0U;
    vlSelf->opl3__DOT__channels__DOT__control_operators__DOT__operator__DOT__phase_generator__DOT__neg_p5 = 0U;
    vlSelf->opl3__DOT__channels__DOT__control_operators__DOT__operator__DOT__phase_generator__DOT____Vcellout__sample_clk_en_sr__out = 0U;
    vlSelf->opl3__DOT__channels__DOT__control_operators__DOT__operator__DOT__phase_generator__DOT__bank_num_p = 0U;
    vlSelf->opl3__DOT__channels__DOT__control_operators__DOT__operator__DOT__phase_generator__DOT__op_num_p = 0U;
    vlSelf->opl3__DOT__channels__DOT__control_operators__DOT__operator__DOT__phase_generator__DOT__modulation_p[0U] = 0U;
    vlSelf->opl3__DOT__channels__DOT__control_operators__DOT__operator__DOT__phase_generator__DOT__modulation_p[1U] = 0U;
    vlSelf->opl3__DOT__channels__DOT__control_operators__DOT__operator__DOT__phase_generator__DOT__modulation_p[2U] = 0U;
    vlSelf->opl3__DOT__channels__DOT__control_operators__DOT__operator__DOT__phase_generator__DOT__final_phase_p = 0U;
    vlSelf->opl3__DOT__channels__DOT__control_operators__DOT__operator__DOT__phase_generator__DOT__ws_post_opl_p = 0U;
    vlSelf->opl3__DOT__channels__DOT__control_operators__DOT__operator__DOT__phase_generator__DOT__phase_acc_mem__DOT__bankb_p = 0U;
    vlSelf->opl3__DOT__channels__DOT__control_operators__DOT__operator__DOT__phase_generator__DOT__phase_acc_mem__DOT__bankgen__BRA__0__KET____DOT__genblk1__DOT__mem_bank__DOT__ram[0x11U] = 0U;
    vlSelf->opl3__DOT__channels__DOT__control_operators__DOT__operator__DOT__phase_generator__DOT__phase_acc_mem__DOT__bankgen__BRA__0__KET____DOT__genblk1__DOT__mem_bank__DOT__ram[0x10U] = 0U;
    vlSelf->opl3__DOT__channels__DOT__control_operators__DOT__operator__DOT__phase_generator__DOT__phase_acc_mem__DOT__bankgen__BRA__0__KET____DOT__genblk1__DOT__mem_bank__DOT__ram[0xfU] = 0U;
    vlSelf->opl3__DOT__channels__DOT__control_operators__DOT__operator__DOT__phase_generator__DOT__phase_acc_mem__DOT__bankgen__BRA__0__KET____DOT__genblk1__DOT__mem_bank__DOT__ram[0xeU] = 0U;
    vlSelf->opl3__DOT__channels__DOT__control_operators__DOT__operator__DOT__phase_generator__DOT__phase_acc_mem__DOT__bankgen__BRA__0__KET____DOT__genblk1__DOT__mem_bank__DOT__ram[0xdU] = 0U;
    vlSelf->opl3__DOT__channels__DOT__control_operators__DOT__operator__DOT__phase_generator__DOT__phase_acc_mem__DOT__bankgen__BRA__0__KET____DOT__genblk1__DOT__mem_bank__DOT__ram[0xcU] = 0U;
    vlSelf->opl3__DOT__channels__DOT__control_operators__DOT__operator__DOT__phase_generator__DOT__phase_acc_mem__DOT__bankgen__BRA__0__KET____DOT__genblk1__DOT__mem_bank__DOT__ram[0xbU] = 0U;
    vlSelf->opl3__DOT__channels__DOT__control_operators__DOT__operator__DOT__phase_generator__DOT__phase_acc_mem__DOT__bankgen__BRA__0__KET____DOT__genblk1__DOT__mem_bank__DOT__ram[0xaU] = 0U;
    vlSelf->opl3__DOT__channels__DOT__control_operators__DOT__operator__DOT__phase_generator__DOT__phase_acc_mem__DOT__bankgen__BRA__0__KET____DOT__genblk1__DOT__mem_bank__DOT__ram[9U] = 0U;
    vlSelf->opl3__DOT__channels__DOT__control_operators__DOT__operator__DOT__phase_generator__DOT__phase_acc_mem__DOT__bankgen__BRA__0__KET____DOT__genblk1__DOT__mem_bank__DOT__ram[8U] = 0U;
    vlSelf->opl3__DOT__channels__DOT__control_operators__DOT__operator__DOT__phase_generator__DOT__phase_acc_mem__DOT__bankgen__BRA__0__KET____DOT__genblk1__DOT__mem_bank__DOT__ram[7U] = 0U;
    vlSelf->opl3__DOT__channels__DOT__control_operators__DOT__operator__DOT__phase_generator__DOT__phase_acc_mem__DOT__bankgen__BRA__0__KET____DOT__genblk1__DOT__mem_bank__DOT__ram[6U] = 0U;
    vlSelf->opl3__DOT__channels__DOT__control_operators__DOT__operator__DOT__phase_generator__DOT__phase_acc_mem__DOT__bankgen__BRA__0__KET____DOT__genblk1__DOT__mem_bank__DOT__ram[5U] = 0U;
    vlSelf->opl3__DOT__channels__DOT__control_operators__DOT__operator__DOT__phase_generator__DOT__phase_acc_mem__DOT__bankgen__BRA__0__KET____DOT__genblk1__DOT__mem_bank__DOT__ram[4U] = 0U;
    vlSelf->opl3__DOT__channels__DOT__control_operators__DOT__operator__DOT__phase_generator__DOT__phase_acc_mem__DOT__bankgen__BRA__0__KET____DOT__genblk1__DOT__mem_bank__DOT__ram[3U] = 0U;
    vlSelf->opl3__DOT__channels__DOT__control_operators__DOT__operator__DOT__phase_generator__DOT__phase_acc_mem__DOT__bankgen__BRA__0__KET____DOT__genblk1__DOT__mem_bank__DOT__ram[2U] = 0U;
    vlSelf->opl3__DOT__channels__DOT__control_operators__DOT__operator__DOT__phase_generator__DOT__phase_acc_mem__DOT__bankgen__BRA__0__KET____DOT__genblk1__DOT__mem_bank__DOT__ram[1U] = 0U;
    vlSelf->opl3__DOT__channels__DOT__control_operators__DOT__operator__DOT__phase_generator__DOT__phase_acc_mem__DOT__bankgen__BRA__0__KET____DOT__genblk1__DOT__mem_bank__DOT__ram[0U] = 0U;
    vlSelf->opl3__DOT__channels__DOT__control_operators__DOT__operator__DOT__phase_generator__DOT__phase_acc_mem__DOT__bankgen__BRA__0__KET____DOT__genblk1__DOT__mem_bank__DOT__genblk1__DOT__dob_p1 = 0U;
    vlSelf->opl3__DOT__channels__DOT__control_operators__DOT__operator__DOT__phase_generator__DOT__phase_acc_mem__DOT__bankgen__BRA__0__KET____DOT__genblk1__DOT__mem_bank__DOT__genblk1__DOT__genblk1__DOT__dob_p2 = 0U;
    vlSelf->opl3__DOT__channels__DOT__control_operators__DOT__operator__DOT__phase_generator__DOT__phase_acc_mem__DOT__bankgen__BRA__1__KET____DOT__genblk1__DOT__mem_bank__DOT__ram[0x11U] = 0U;
    vlSelf->opl3__DOT__channels__DOT__control_operators__DOT__operator__DOT__phase_generator__DOT__phase_acc_mem__DOT__bankgen__BRA__1__KET____DOT__genblk1__DOT__mem_bank__DOT__ram[0x10U] = 0U;
    vlSelf->opl3__DOT__channels__DOT__control_operators__DOT__operator__DOT__phase_generator__DOT__phase_acc_mem__DOT__bankgen__BRA__1__KET____DOT__genblk1__DOT__mem_bank__DOT__ram[0xfU] = 0U;
    vlSelf->opl3__DOT__channels__DOT__control_operators__DOT__operator__DOT__phase_generator__DOT__phase_acc_mem__DOT__bankgen__BRA__1__KET____DOT__genblk1__DOT__mem_bank__DOT__ram[0xeU] = 0U;
    vlSelf->opl3__DOT__channels__DOT__control_operators__DOT__operator__DOT__phase_generator__DOT__phase_acc_mem__DOT__bankgen__BRA__1__KET____DOT__genblk1__DOT__mem_bank__DOT__ram[0xdU] = 0U;
    vlSelf->opl3__DOT__channels__DOT__control_operators__DOT__operator__DOT__phase_generator__DOT__phase_acc_mem__DOT__bankgen__BRA__1__KET____DOT__genblk1__DOT__mem_bank__DOT__ram[0xcU] = 0U;
    vlSelf->opl3__DOT__channels__DOT__control_operators__DOT__operator__DOT__phase_generator__DOT__phase_acc_mem__DOT__bankgen__BRA__1__KET____DOT__genblk1__DOT__mem_bank__DOT__ram[0xbU] = 0U;
    vlSelf->opl3__DOT__channels__DOT__control_operators__DOT__operator__DOT__phase_generator__DOT__phase_acc_mem__DOT__bankgen__BRA__1__KET____DOT__genblk1__DOT__mem_bank__DOT__ram[0xaU] = 0U;
    vlSelf->opl3__DOT__channels__DOT__control_operators__DOT__operator__DOT__phase_generator__DOT__phase_acc_mem__DOT__bankgen__BRA__1__KET____DOT__genblk1__DOT__mem_bank__DOT__ram[9U] = 0U;
    vlSelf->opl3__DOT__channels__DOT__control_operators__DOT__operator__DOT__phase_generator__DOT__phase_acc_mem__DOT__bankgen__BRA__1__KET____DOT__genblk1__DOT__mem_bank__DOT__ram[8U] = 0U;
    vlSelf->opl3__DOT__channels__DOT__control_operators__DOT__operator__DOT__phase_generator__DOT__phase_acc_mem__DOT__bankgen__BRA__1__KET____DOT__genblk1__DOT__mem_bank__DOT__ram[7U] = 0U;
    vlSelf->opl3__DOT__channels__DOT__control_operators__DOT__operator__DOT__phase_generator__DOT__phase_acc_mem__DOT__bankgen__BRA__1__KET____DOT__genblk1__DOT__mem_bank__DOT__ram[6U] = 0U;
    vlSelf->opl3__DOT__channels__DOT__control_operators__DOT__operator__DOT__phase_generator__DOT__phase_acc_mem__DOT__bankgen__BRA__1__KET____DOT__genblk1__DOT__mem_bank__DOT__ram[5U] = 0U;
    vlSelf->opl3__DOT__channels__DOT__control_operators__DOT__operator__DOT__phase_generator__DOT__phase_acc_mem__DOT__bankgen__BRA__1__KET____DOT__genblk1__DOT__mem_bank__DOT__ram[4U] = 0U;
    vlSelf->opl3__DOT__channels__DOT__control_operators__DOT__operator__DOT__phase_generator__DOT__phase_acc_mem__DOT__bankgen__BRA__1__KET____DOT__genblk1__DOT__mem_bank__DOT__ram[3U] = 0U;
    vlSelf->opl3__DOT__channels__DOT__control_operators__DOT__operator__DOT__phase_generator__DOT__phase_acc_mem__DOT__bankgen__BRA__1__KET____DOT__genblk1__DOT__mem_bank__DOT__ram[2U] = 0U;
    vlSelf->opl3__DOT__channels__DOT__control_operators__DOT__operator__DOT__phase_generator__DOT__phase_acc_mem__DOT__bankgen__BRA__1__KET____DOT__genblk1__DOT__mem_bank__DOT__ram[1U] = 0U;
    vlSelf->opl3__DOT__channels__DOT__control_operators__DOT__operator__DOT__phase_generator__DOT__phase_acc_mem__DOT__bankgen__BRA__1__KET____DOT__genblk1__DOT__mem_bank__DOT__ram[0U] = 0U;
    vlSelf->opl3__DOT__channels__DOT__control_operators__DOT__operator__DOT__phase_generator__DOT__phase_acc_mem__DOT__bankgen__BRA__1__KET____DOT__genblk1__DOT__mem_bank__DOT__genblk1__DOT__dob_p1 = 0U;
    vlSelf->opl3__DOT__channels__DOT__control_operators__DOT__operator__DOT__phase_generator__DOT__phase_acc_mem__DOT__bankgen__BRA__1__KET____DOT__genblk1__DOT__mem_bank__DOT__genblk1__DOT__genblk1__DOT__dob_p2 = 0U;
    vlSelf->opl3__DOT__channels__DOT__control_operators__DOT__operator__DOT__phase_generator__DOT__rhythm_phase_p3 = 0U;
    vlSelf->opl3__DOT__channels__DOT__control_operators__DOT__operator__DOT__phase_generator__DOT__calc_rhythm_phase__DOT__hh_phase_friend = 0U;
    vlSelf->opl3__DOT__channels__DOT__control_operators__DOT__operator__DOT__phase_generator__DOT__calc_rhythm_phase__DOT__tc_phase_friend = 0U;
    vlSelf->opl3__DOT__channels__DOT__control_operators__DOT__operator__DOT__phase_generator__DOT__calc_rhythm_phase__DOT__rand_num = 1U;
    vlSelf->opl3__DOT__channels__DOT__control_operators__DOT__operator__DOT__phase_generator__DOT__calc_rhythm_phase__DOT____Vcellout__sample_clk_en_sr__out = 0U;
    vlSelf->opl3__DOT__channels__DOT__control_operators__DOT__operator__DOT__phase_generator__DOT__calc_rhythm_phase__DOT__op_type_p = 0U;
    vlSelf->opl3__DOT__channels__DOT__control_operators__DOT__operator__DOT__phase_generator__DOT__calc_rhythm_phase__DOT__bank_num_p = 0U;
    vlSelf->opl3__DOT__channels__DOT__control_operators__DOT__operator__DOT__phase_generator__DOT__calc_rhythm_phase__DOT__op_num_p = 0U;
    vlSelf->opl3__DOT__channels__DOT__control_operators__DOT__operator__DOT__phase_generator__DOT__log_sin_out_p4 = 0U;
    vlSelf->opl3__DOT__channels__DOT__control_operators__DOT__operator__DOT__phase_generator__DOT__exp_out_p5 = 0U;
    vlSelf->opl3__DOT__channels__DOT__control_operators__DOT__operator__DOT__feedback_mem__DOT__bankb_p = 0U;
    vlSelf->opl3__DOT__channels__DOT__control_operators__DOT__operator__DOT__feedback_mem__DOT__bankgen__BRA__0__KET____DOT__genblk1__DOT__mem_bank__DOT__ram[0x11U] = 0U;
    vlSelf->opl3__DOT__channels__DOT__control_operators__DOT__operator__DOT__feedback_mem__DOT__bankgen__BRA__0__KET____DOT__genblk1__DOT__mem_bank__DOT__ram[0x10U] = 0U;
    vlSelf->opl3__DOT__channels__DOT__control_operators__DOT__operator__DOT__feedback_mem__DOT__bankgen__BRA__0__KET____DOT__genblk1__DOT__mem_bank__DOT__ram[0xfU] = 0U;
    vlSelf->opl3__DOT__channels__DOT__control_operators__DOT__operator__DOT__feedback_mem__DOT__bankgen__BRA__0__KET____DOT__genblk1__DOT__mem_bank__DOT__ram[0xeU] = 0U;
    vlSelf->opl3__DOT__channels__DOT__control_operators__DOT__operator__DOT__feedback_mem__DOT__bankgen__BRA__0__KET____DOT__genblk1__DOT__mem_bank__DOT__ram[0xdU] = 0U;
    vlSelf->opl3__DOT__channels__DOT__control_operators__DOT__operator__DOT__feedback_mem__DOT__bankgen__BRA__0__KET____DOT__genblk1__DOT__mem_bank__DOT__ram[0xcU] = 0U;
    vlSelf->opl3__DOT__channels__DOT__control_operators__DOT__operator__DOT__feedback_mem__DOT__bankgen__BRA__0__KET____DOT__genblk1__DOT__mem_bank__DOT__ram[0xbU] = 0U;
    vlSelf->opl3__DOT__channels__DOT__control_operators__DOT__operator__DOT__feedback_mem__DOT__bankgen__BRA__0__KET____DOT__genblk1__DOT__mem_bank__DOT__ram[0xaU] = 0U;
    vlSelf->opl3__DOT__channels__DOT__control_operators__DOT__operator__DOT__feedback_mem__DOT__bankgen__BRA__0__KET____DOT__genblk1__DOT__mem_bank__DOT__ram[9U] = 0U;
    vlSelf->opl3__DOT__channels__DOT__control_operators__DOT__operator__DOT__feedback_mem__DOT__bankgen__BRA__0__KET____DOT__genblk1__DOT__mem_bank__DOT__ram[8U] = 0U;
    vlSelf->opl3__DOT__channels__DOT__control_operators__DOT__operator__DOT__feedback_mem__DOT__bankgen__BRA__0__KET____DOT__genblk1__DOT__mem_bank__DOT__ram[7U] = 0U;
    vlSelf->opl3__DOT__channels__DOT__control_operators__DOT__operator__DOT__feedback_mem__DOT__bankgen__BRA__0__KET____DOT__genblk1__DOT__mem_bank__DOT__ram[6U] = 0U;
    vlSelf->opl3__DOT__channels__DOT__control_operators__DOT__operator__DOT__feedback_mem__DOT__bankgen__BRA__0__KET____DOT__genblk1__DOT__mem_bank__DOT__ram[5U] = 0U;
    vlSelf->opl3__DOT__channels__DOT__control_operators__DOT__operator__DOT__feedback_mem__DOT__bankgen__BRA__0__KET____DOT__genblk1__DOT__mem_bank__DOT__ram[4U] = 0U;
    vlSelf->opl3__DOT__channels__DOT__control_operators__DOT__operator__DOT__feedback_mem__DOT__bankgen__BRA__0__KET____DOT__genblk1__DOT__mem_bank__DOT__ram[3U] = 0U;
    vlSelf->opl3__DOT__channels__DOT__control_operators__DOT__operator__DOT__feedback_mem__DOT__bankgen__BRA__0__KET____DOT__genblk1__DOT__mem_bank__DOT__ram[2U] = 0U;
    vlSelf->opl3__DOT__channels__DOT__control_operators__DOT__operator__DOT__feedback_mem__DOT__bankgen__BRA__0__KET____DOT__genblk1__DOT__mem_bank__DOT__ram[1U] = 0U;
    vlSelf->opl3__DOT__channels__DOT__control_operators__DOT__operator__DOT__feedback_mem__DOT__bankgen__BRA__0__KET____DOT__genblk1__DOT__mem_bank__DOT__ram[0U] = 0U;
    vlSelf->opl3__DOT__channels__DOT__control_operators__DOT__operator__DOT__feedback_mem__DOT__bankgen__BRA__0__KET____DOT__genblk1__DOT__mem_bank__DOT__genblk1__DOT__dob_p1 = 0U;
    vlSelf->opl3__DOT__channels__DOT__control_operators__DOT__operator__DOT__feedback_mem__DOT__bankgen__BRA__1__KET____DOT__genblk1__DOT__mem_bank__DOT__ram[0x11U] = 0U;
    vlSelf->opl3__DOT__channels__DOT__control_operators__DOT__operator__DOT__feedback_mem__DOT__bankgen__BRA__1__KET____DOT__genblk1__DOT__mem_bank__DOT__ram[0x10U] = 0U;
    vlSelf->opl3__DOT__channels__DOT__control_operators__DOT__operator__DOT__feedback_mem__DOT__bankgen__BRA__1__KET____DOT__genblk1__DOT__mem_bank__DOT__ram[0xfU] = 0U;
    vlSelf->opl3__DOT__channels__DOT__control_operators__DOT__operator__DOT__feedback_mem__DOT__bankgen__BRA__1__KET____DOT__genblk1__DOT__mem_bank__DOT__ram[0xeU] = 0U;
    vlSelf->opl3__DOT__channels__DOT__control_operators__DOT__operator__DOT__feedback_mem__DOT__bankgen__BRA__1__KET____DOT__genblk1__DOT__mem_bank__DOT__ram[0xdU] = 0U;
    vlSelf->opl3__DOT__channels__DOT__control_operators__DOT__operator__DOT__feedback_mem__DOT__bankgen__BRA__1__KET____DOT__genblk1__DOT__mem_bank__DOT__ram[0xcU] = 0U;
    vlSelf->opl3__DOT__channels__DOT__control_operators__DOT__operator__DOT__feedback_mem__DOT__bankgen__BRA__1__KET____DOT__genblk1__DOT__mem_bank__DOT__ram[0xbU] = 0U;
    vlSelf->opl3__DOT__channels__DOT__control_operators__DOT__operator__DOT__feedback_mem__DOT__bankgen__BRA__1__KET____DOT__genblk1__DOT__mem_bank__DOT__ram[0xaU] = 0U;
    vlSelf->opl3__DOT__channels__DOT__control_operators__DOT__operator__DOT__feedback_mem__DOT__bankgen__BRA__1__KET____DOT__genblk1__DOT__mem_bank__DOT__ram[9U] = 0U;
    vlSelf->opl3__DOT__channels__DOT__control_operators__DOT__operator__DOT__feedback_mem__DOT__bankgen__BRA__1__KET____DOT__genblk1__DOT__mem_bank__DOT__ram[8U] = 0U;
    vlSelf->opl3__DOT__channels__DOT__control_operators__DOT__operator__DOT__feedback_mem__DOT__bankgen__BRA__1__KET____DOT__genblk1__DOT__mem_bank__DOT__ram[7U] = 0U;
    vlSelf->opl3__DOT__channels__DOT__control_operators__DOT__operator__DOT__feedback_mem__DOT__bankgen__BRA__1__KET____DOT__genblk1__DOT__mem_bank__DOT__ram[6U] = 0U;
    vlSelf->opl3__DOT__channels__DOT__control_operators__DOT__operator__DOT__feedback_mem__DOT__bankgen__BRA__1__KET____DOT__genblk1__DOT__mem_bank__DOT__ram[5U] = 0U;
    vlSelf->opl3__DOT__channels__DOT__control_operators__DOT__operator__DOT__feedback_mem__DOT__bankgen__BRA__1__KET____DOT__genblk1__DOT__mem_bank__DOT__ram[4U] = 0U;
    vlSelf->opl3__DOT__channels__DOT__control_operators__DOT__operator__DOT__feedback_mem__DOT__bankgen__BRA__1__KET____DOT__genblk1__DOT__mem_bank__DOT__ram[3U] = 0U;
    vlSelf->opl3__DOT__channels__DOT__control_operators__DOT__operator__DOT__feedback_mem__DOT__bankgen__BRA__1__KET____DOT__genblk1__DOT__mem_bank__DOT__ram[2U] = 0U;
    vlSelf->opl3__DOT__channels__DOT__control_operators__DOT__operator__DOT__feedback_mem__DOT__bankgen__BRA__1__KET____DOT__genblk1__DOT__mem_bank__DOT__ram[1U] = 0U;
    vlSelf->opl3__DOT__channels__DOT__control_operators__DOT__operator__DOT__feedback_mem__DOT__bankgen__BRA__1__KET____DOT__genblk1__DOT__mem_bank__DOT__ram[0U] = 0U;
    vlSelf->opl3__DOT__channels__DOT__control_operators__DOT__operator__DOT__feedback_mem__DOT__bankgen__BRA__1__KET____DOT__genblk1__DOT__mem_bank__DOT__genblk1__DOT__dob_p1 = 0U;
    vlSelf->opl3__DOT__channels__DOT__control_operators__DOT__operator__DOT____Vcellout__feedback_sr__out[0U] = 0U;
    vlSelf->opl3__DOT__channels__DOT__control_operators__DOT__operator__DOT____Vcellout__feedback_sr__out[1U] = 0U;
    vlSelf->opl3__DOT__channels__DOT__control_operators__DOT__operator__DOT____Vcellout__feedback_sr__out[2U] = 0U;
    vlSelf->opl3__DOT__channels__DOT__control_operators__DOT__operator__DOT____Vcellout__feedback_sr__out[3U] = 0U;
    vlSelf->opl3__DOT__channels__DOT__control_operators__DOT__operator__DOT____Vcellout__feedback_sr__out[4U] = 0U;
    vlSelf->opl3__DOT__channels__DOT__control_operators__DOT____Vcellout__sample_clk_en_sr__out = 0U;
    vlSelf->opl3__DOT__channels__DOT__control_operators__DOT__bank_num_p = 0U;
    vlSelf->opl3__DOT__channels__DOT__control_operators__DOT__op_num_p = 0U;
    vlSelf->opl3__DOT__channels__DOT__operator_out_mem__DOT__bankb_p = 0U;
    vlSelf->opl3__DOT__channels__DOT__operator_out_mem__DOT__bankgen__BRA__0__KET____DOT__genblk1__DOT__mem_bank__DOT__ram[0x11U] = 0U;
    vlSelf->opl3__DOT__channels__DOT__operator_out_mem__DOT__bankgen__BRA__0__KET____DOT__genblk1__DOT__mem_bank__DOT__ram[0x10U] = 0U;
    vlSelf->opl3__DOT__channels__DOT__operator_out_mem__DOT__bankgen__BRA__0__KET____DOT__genblk1__DOT__mem_bank__DOT__ram[0xfU] = 0U;
    vlSelf->opl3__DOT__channels__DOT__operator_out_mem__DOT__bankgen__BRA__0__KET____DOT__genblk1__DOT__mem_bank__DOT__ram[0xeU] = 0U;
    vlSelf->opl3__DOT__channels__DOT__operator_out_mem__DOT__bankgen__BRA__0__KET____DOT__genblk1__DOT__mem_bank__DOT__ram[0xdU] = 0U;
    vlSelf->opl3__DOT__channels__DOT__operator_out_mem__DOT__bankgen__BRA__0__KET____DOT__genblk1__DOT__mem_bank__DOT__ram[0xcU] = 0U;
    vlSelf->opl3__DOT__channels__DOT__operator_out_mem__DOT__bankgen__BRA__0__KET____DOT__genblk1__DOT__mem_bank__DOT__ram[0xbU] = 0U;
    vlSelf->opl3__DOT__channels__DOT__operator_out_mem__DOT__bankgen__BRA__0__KET____DOT__genblk1__DOT__mem_bank__DOT__ram[0xaU] = 0U;
    vlSelf->opl3__DOT__channels__DOT__operator_out_mem__DOT__bankgen__BRA__0__KET____DOT__genblk1__DOT__mem_bank__DOT__ram[9U] = 0U;
    vlSelf->opl3__DOT__channels__DOT__operator_out_mem__DOT__bankgen__BRA__0__KET____DOT__genblk1__DOT__mem_bank__DOT__ram[8U] = 0U;
    vlSelf->opl3__DOT__channels__DOT__operator_out_mem__DOT__bankgen__BRA__0__KET____DOT__genblk1__DOT__mem_bank__DOT__ram[7U] = 0U;
    vlSelf->opl3__DOT__channels__DOT__operator_out_mem__DOT__bankgen__BRA__0__KET____DOT__genblk1__DOT__mem_bank__DOT__ram[6U] = 0U;
    vlSelf->opl3__DOT__channels__DOT__operator_out_mem__DOT__bankgen__BRA__0__KET____DOT__genblk1__DOT__mem_bank__DOT__ram[5U] = 0U;
    vlSelf->opl3__DOT__channels__DOT__operator_out_mem__DOT__bankgen__BRA__0__KET____DOT__genblk1__DOT__mem_bank__DOT__ram[4U] = 0U;
    vlSelf->opl3__DOT__channels__DOT__operator_out_mem__DOT__bankgen__BRA__0__KET____DOT__genblk1__DOT__mem_bank__DOT__ram[3U] = 0U;
    vlSelf->opl3__DOT__channels__DOT__operator_out_mem__DOT__bankgen__BRA__0__KET____DOT__genblk1__DOT__mem_bank__DOT__ram[2U] = 0U;
    vlSelf->opl3__DOT__channels__DOT__operator_out_mem__DOT__bankgen__BRA__0__KET____DOT__genblk1__DOT__mem_bank__DOT__ram[1U] = 0U;
    vlSelf->opl3__DOT__channels__DOT__operator_out_mem__DOT__bankgen__BRA__0__KET____DOT__genblk1__DOT__mem_bank__DOT__ram[0U] = 0U;
    vlSelf->opl3__DOT__channels__DOT__operator_out_mem__DOT__bankgen__BRA__0__KET____DOT__genblk1__DOT__mem_bank__DOT__genblk1__DOT__dob_p1 = 0U;
    vlSelf->opl3__DOT__channels__DOT__operator_out_mem__DOT__bankgen__BRA__1__KET____DOT__genblk1__DOT__mem_bank__DOT__ram[0x11U] = 0U;
    vlSelf->opl3__DOT__channels__DOT__operator_out_mem__DOT__bankgen__BRA__1__KET____DOT__genblk1__DOT__mem_bank__DOT__ram[0x10U] = 0U;
    vlSelf->opl3__DOT__channels__DOT__operator_out_mem__DOT__bankgen__BRA__1__KET____DOT__genblk1__DOT__mem_bank__DOT__ram[0xfU] = 0U;
    vlSelf->opl3__DOT__channels__DOT__operator_out_mem__DOT__bankgen__BRA__1__KET____DOT__genblk1__DOT__mem_bank__DOT__ram[0xeU] = 0U;
    vlSelf->opl3__DOT__channels__DOT__operator_out_mem__DOT__bankgen__BRA__1__KET____DOT__genblk1__DOT__mem_bank__DOT__ram[0xdU] = 0U;
    vlSelf->opl3__DOT__channels__DOT__operator_out_mem__DOT__bankgen__BRA__1__KET____DOT__genblk1__DOT__mem_bank__DOT__ram[0xcU] = 0U;
    vlSelf->opl3__DOT__channels__DOT__operator_out_mem__DOT__bankgen__BRA__1__KET____DOT__genblk1__DOT__mem_bank__DOT__ram[0xbU] = 0U;
    vlSelf->opl3__DOT__channels__DOT__operator_out_mem__DOT__bankgen__BRA__1__KET____DOT__genblk1__DOT__mem_bank__DOT__ram[0xaU] = 0U;
    vlSelf->opl3__DOT__channels__DOT__operator_out_mem__DOT__bankgen__BRA__1__KET____DOT__genblk1__DOT__mem_bank__DOT__ram[9U] = 0U;
    vlSelf->opl3__DOT__channels__DOT__operator_out_mem__DOT__bankgen__BRA__1__KET____DOT__genblk1__DOT__mem_bank__DOT__ram[8U] = 0U;
    vlSelf->opl3__DOT__channels__DOT__operator_out_mem__DOT__bankgen__BRA__1__KET____DOT__genblk1__DOT__mem_bank__DOT__ram[7U] = 0U;
    vlSelf->opl3__DOT__channels__DOT__operator_out_mem__DOT__bankgen__BRA__1__KET____DOT__genblk1__DOT__mem_bank__DOT__ram[6U] = 0U;
    vlSelf->opl3__DOT__channels__DOT__operator_out_mem__DOT__bankgen__BRA__1__KET____DOT__genblk1__DOT__mem_bank__DOT__ram[5U] = 0U;
    vlSelf->opl3__DOT__channels__DOT__operator_out_mem__DOT__bankgen__BRA__1__KET____DOT__genblk1__DOT__mem_bank__DOT__ram[4U] = 0U;
    vlSelf->opl3__DOT__channels__DOT__operator_out_mem__DOT__bankgen__BRA__1__KET____DOT__genblk1__DOT__mem_bank__DOT__ram[3U] = 0U;
    vlSelf->opl3__DOT__channels__DOT__operator_out_mem__DOT__bankgen__BRA__1__KET____DOT__genblk1__DOT__mem_bank__DOT__ram[2U] = 0U;
    vlSelf->opl3__DOT__channels__DOT__operator_out_mem__DOT__bankgen__BRA__1__KET____DOT__genblk1__DOT__mem_bank__DOT__ram[1U] = 0U;
    vlSelf->opl3__DOT__channels__DOT__operator_out_mem__DOT__bankgen__BRA__1__KET____DOT__genblk1__DOT__mem_bank__DOT__ram[0U] = 0U;
    vlSelf->opl3__DOT__channels__DOT__operator_out_mem__DOT__bankgen__BRA__1__KET____DOT__genblk1__DOT__mem_bank__DOT__genblk1__DOT__dob_p1 = 0U;
    vlSelf->opl3__DOT__channels__DOT__dac_prep__DOT__sample_valid_opl3_p1 = 0U;
    vlSelf->opl3__DOT__channels__DOT__dac_prep__DOT__sample_opl3_l_p1 = 0U;
    vlSelf->opl3__DOT__channels__DOT__dac_prep__DOT__sample_opl3_r_p1 = 0U;
    vlSelf->led = 0U;
    vlSelf->irq_n = 0U;
    vlSelf->opl3__DOT__genblk1__DOT__timers__DOT__timer1 = 0U;
    vlSelf->opl3__DOT__genblk1__DOT__timers__DOT__timer2 = 0U;
    vlSelf->opl3__DOT__genblk1__DOT__timers__DOT__irq_rst = 0U;
    vlSelf->opl3__DOT__genblk1__DOT__timers__DOT__mt1 = 0U;
    vlSelf->opl3__DOT__genblk1__DOT__timers__DOT__mt2 = 0U;
    vlSelf->opl3__DOT__genblk1__DOT__timers__DOT__st1 = 0U;
    vlSelf->opl3__DOT__genblk1__DOT__timers__DOT__st2 = 0U;
    vlSelf->opl3__DOT__genblk1__DOT__timers__DOT__ft1 = 0U;
    vlSelf->opl3__DOT__genblk1__DOT__timers__DOT__ft2 = 0U;
    vlSelf->opl3__DOT__genblk1__DOT__timers__DOT__timer1_overflow_pulse = 0U;
    vlSelf->opl3__DOT__genblk1__DOT__timers__DOT__timer1_inst__DOT__tick_counter = 0U;
    vlSelf->opl3__DOT__genblk1__DOT__timers__DOT__timer1_inst__DOT__tick_pulse = 0U;
    vlSelf->opl3__DOT__genblk1__DOT__timers__DOT__timer1_inst__DOT__timer = 0U;
    vlSelf->opl3__DOT__genblk1__DOT__timers__DOT__timer1_inst__DOT__start_timer_set_pulse = 0U;
    vlSelf->opl3__DOT__genblk1__DOT__timers__DOT__timer1_inst__DOT__start_timer_edge_detect__DOT__in_r0 = 0U;
    vlSelf->opl3__DOT__genblk1__DOT__timers__DOT__timer2_overflow_pulse = 0U;
    vlSelf->opl3__DOT__genblk1__DOT__timers__DOT__timer2_inst__DOT__tick_counter = 0U;
    vlSelf->opl3__DOT__genblk1__DOT__timers__DOT__timer2_inst__DOT__tick_pulse = 0U;
    vlSelf->opl3__DOT__genblk1__DOT__timers__DOT__timer2_inst__DOT__timer = 0U;
    vlSelf->opl3__DOT__genblk1__DOT__timers__DOT__timer2_inst__DOT__start_timer_set_pulse = 0U;
    vlSelf->opl3__DOT__genblk1__DOT__timers__DOT__timer2_inst__DOT__start_timer_edge_detect__DOT__in_r0 = 0U;
}

VL_ATTR_COLD void Vopl3___024root___eval_initial(Vopl3___024root* vlSelf) {
    if (false && vlSelf) {}  // Prevent unused
    Vopl3__Syms* const __restrict vlSymsp VL_ATTR_UNUSED = vlSelf->vlSymsp;
    VL_DEBUG_IF(VL_DBG_MSGF("+    Vopl3___024root___eval_initial\n"); );
    // Body
    vlSelf->__Vtrigprevexpr___TOP__opl3__DOT__channels__DOT____Vcellout__ch_abcd_cnt_mem__dob__0 
        = vlSelf->opl3__DOT__channels__DOT____Vcellout__ch_abcd_cnt_mem__dob;
    vlSelf->__Vtrigprevexpr___TOP__opl3__DOT__channels__DOT____Vcellout__ch_abcd_cnt_mem__dob__1 
        = vlSelf->opl3__DOT__channels__DOT____Vcellout__ch_abcd_cnt_mem__dob;
    vlSelf->__Vtrigprevexpr___TOP__clk__0 = vlSelf->clk;
    vlSelf->__Vtrigprevexpr___TOP__ic_n__0 = vlSelf->ic_n;
    vlSelf->__Vtrigprevexpr___TOP__clk_host__0 = vlSelf->clk_host;
    vlSelf->__Vtrigprevexpr___TOP__opl3__DOT__host_if__DOT____Vcellinp__afifo__i_rd_reset_n__0 
        = vlSelf->opl3__DOT__host_if__DOT____Vcellinp__afifo__i_rd_reset_n;
}

VL_ATTR_COLD void Vopl3___024root___eval_final(Vopl3___024root* vlSelf) {
    if (false && vlSelf) {}  // Prevent unused
    Vopl3__Syms* const __restrict vlSymsp VL_ATTR_UNUSED = vlSelf->vlSymsp;
    VL_DEBUG_IF(VL_DBG_MSGF("+    Vopl3___024root___eval_final\n"); );
}

#ifdef VL_DEBUG
VL_ATTR_COLD void Vopl3___024root___dump_triggers__stl(Vopl3___024root* vlSelf);
#endif  // VL_DEBUG
VL_ATTR_COLD bool Vopl3___024root___eval_phase__stl(Vopl3___024root* vlSelf);

VL_ATTR_COLD void Vopl3___024root___eval_settle(Vopl3___024root* vlSelf) {
    if (false && vlSelf) {}  // Prevent unused
    Vopl3__Syms* const __restrict vlSymsp VL_ATTR_UNUSED = vlSelf->vlSymsp;
    VL_DEBUG_IF(VL_DBG_MSGF("+    Vopl3___024root___eval_settle\n"); );
    // Init
    IData/*31:0*/ __VstlIterCount;
    CData/*0:0*/ __VstlContinue;
    // Body
    __VstlIterCount = 0U;
    vlSelf->__VstlFirstIteration = 1U;
    __VstlContinue = 1U;
    while (__VstlContinue) {
        if (VL_UNLIKELY((0x64U < __VstlIterCount))) {
#ifdef VL_DEBUG
            Vopl3___024root___dump_triggers__stl(vlSelf);
#endif
            VL_FATAL_MT("/mnt/c/Users/alber/proyectosAI/msx/MSX_up/fpga/opl3/opl3.sv", 44, "", "Settle region did not converge.");
        }
        __VstlIterCount = ((IData)(1U) + __VstlIterCount);
        __VstlContinue = 0U;
        if (Vopl3___024root___eval_phase__stl(vlSelf)) {
            __VstlContinue = 1U;
        }
        vlSelf->__VstlFirstIteration = 0U;
    }
}

#ifdef VL_DEBUG
VL_ATTR_COLD void Vopl3___024root___dump_triggers__stl(Vopl3___024root* vlSelf) {
    if (false && vlSelf) {}  // Prevent unused
    Vopl3__Syms* const __restrict vlSymsp VL_ATTR_UNUSED = vlSelf->vlSymsp;
    VL_DEBUG_IF(VL_DBG_MSGF("+    Vopl3___024root___dump_triggers__stl\n"); );
    // Body
    if ((1U & (~ (IData)(vlSelf->__VstlTriggered.any())))) {
        VL_DBG_MSGF("         No triggers active\n");
    }
    if ((1ULL & vlSelf->__VstlTriggered.word(0U))) {
        VL_DBG_MSGF("         'stl' region trigger index 0 is active: Internal 'stl' trigger - first iteration\n");
    }
    if ((2ULL & vlSelf->__VstlTriggered.word(0U))) {
        VL_DBG_MSGF("         'stl' region trigger index 1 is active: @([hybrid] opl3.channels.__Vcellout__ch_abcd_cnt_mem__dob)\n");
    }
}
#endif  // VL_DEBUG

extern const VlUnpacked<CData/*3:0*/, 4096> Vopl3__ConstPool__TABLE_h38f42766_0;
extern const VlUnpacked<CData/*2:0*/, 4096> Vopl3__ConstPool__TABLE_h0637a799_0;
extern const VlUnpacked<CData/*3:0*/, 4096> Vopl3__ConstPool__TABLE_hc80edecc_0;
extern const VlUnpacked<CData/*3:0*/, 4096> Vopl3__ConstPool__TABLE_h6daf335f_0;

VL_ATTR_COLD void Vopl3___024root___stl_sequent__TOP__0(Vopl3___024root* vlSelf) {
    if (false && vlSelf) {}  // Prevent unused
    Vopl3__Syms* const __restrict vlSymsp VL_ATTR_UNUSED = vlSelf->vlSymsp;
    VL_DEBUG_IF(VL_DBG_MSGF("+    Vopl3___024root___stl_sequent__TOP__0\n"); );
    // Init
    CData/*0:0*/ opl3__DOT__channels__DOT____Vcellinp__ch_abcd_cnt_mem__wea;
    opl3__DOT__channels__DOT____Vcellinp__ch_abcd_cnt_mem__wea = 0;
    CData/*2:0*/ opl3__DOT__channels__DOT__control_operators__DOT__ws;
    opl3__DOT__channels__DOT__control_operators__DOT__ws = 0;
    CData/*4:0*/ opl3__DOT__channels__DOT__control_operators__DOT__operator_mem_rd_address;
    opl3__DOT__channels__DOT__control_operators__DOT__operator_mem_rd_address = 0;
    CData/*0:0*/ opl3__DOT__channels__DOT__control_operators__DOT__cnt1_p1;
    opl3__DOT__channels__DOT__control_operators__DOT__cnt1_p1 = 0;
    CData/*7:0*/ opl3__DOT__channels__DOT__control_operators__DOT____Vcellout__ar_dr_mem__dob;
    opl3__DOT__channels__DOT__control_operators__DOT____Vcellout__ar_dr_mem__dob = 0;
    CData/*0:0*/ opl3__DOT__channels__DOT__control_operators__DOT____Vcellinp__block_fnum_high_mem__wea;
    opl3__DOT__channels__DOT__control_operators__DOT____Vcellinp__block_fnum_high_mem__wea = 0;
    CData/*3:0*/ opl3__DOT__channels__DOT__control_operators__DOT____Vcellout__fb_cnt0_mem__dob;
    opl3__DOT__channels__DOT__control_operators__DOT____Vcellout__fb_cnt0_mem__dob = 0;
    IData/*21:0*/ opl3__DOT__channels__DOT__control_operators__DOT__operator__DOT__feedback_result_tmp_p1;
    opl3__DOT__channels__DOT__control_operators__DOT__operator__DOT__feedback_result_tmp_p1 = 0;
    CData/*2:0*/ opl3__DOT__channels__DOT__control_operators__DOT__operator__DOT__calc_phase_inc__DOT__vibrato__DOT__delta1_p1;
    opl3__DOT__channels__DOT__control_operators__DOT__operator__DOT__calc_phase_inc__DOT__vibrato__DOT__delta1_p1 = 0;
    CData/*0:0*/ opl3__DOT__channels__DOT__control_operators__DOT__operator__DOT__envelope_generator__DOT__eg_off_p2;
    opl3__DOT__channels__DOT__control_operators__DOT__operator__DOT__envelope_generator__DOT__eg_off_p2 = 0;
    SData/*11:0*/ opl3__DOT__channels__DOT__control_operators__DOT__operator__DOT__envelope_generator__DOT__env_int_extra_bits_p2;
    opl3__DOT__channels__DOT__control_operators__DOT__operator__DOT__envelope_generator__DOT__env_int_extra_bits_p2 = 0;
    CData/*4:0*/ opl3__DOT__channels__DOT__control_operators__DOT__operator__DOT__envelope_generator__DOT__sl_increased_p2;
    opl3__DOT__channels__DOT__control_operators__DOT__operator__DOT__envelope_generator__DOT__sl_increased_p2 = 0;
    CData/*3:0*/ opl3__DOT__channels__DOT__control_operators__DOT__operator__DOT__envelope_generator__DOT__calc_envelope_shift__DOT__block_shifted;
    opl3__DOT__channels__DOT__control_operators__DOT__operator__DOT__envelope_generator__DOT__calc_envelope_shift__DOT__block_shifted = 0;
    CData/*3:0*/ opl3__DOT__channels__DOT__control_operators__DOT__operator__DOT__envelope_generator__DOT__calc_envelope_shift__DOT__ksv_p0;
    opl3__DOT__channels__DOT__control_operators__DOT__operator__DOT__envelope_generator__DOT__calc_envelope_shift__DOT__ksv_p0 = 0;
    CData/*4:0*/ opl3__DOT__channels__DOT__control_operators__DOT__operator__DOT__envelope_generator__DOT__calc_envelope_shift__DOT__rate_hi_pre_p1;
    opl3__DOT__channels__DOT__control_operators__DOT__operator__DOT__envelope_generator__DOT__calc_envelope_shift__DOT__rate_hi_pre_p1 = 0;
    SData/*9:0*/ opl3__DOT__channels__DOT__control_operators__DOT__operator__DOT__phase_generator__DOT__calc_rhythm_phase__DOT__tc_phase_p2;
    opl3__DOT__channels__DOT__control_operators__DOT__operator__DOT__phase_generator__DOT__calc_rhythm_phase__DOT__tc_phase_p2 = 0;
    SData/*11:0*/ __Vtableidx1;
    __Vtableidx1 = 0;
    // Body
    vlSelf->sample_valid = vlSelf->opl3__DOT__channels__DOT__dac_prep__DOT__sample_valid_opl3_p1;
    vlSelf->sample_l = vlSelf->opl3__DOT__channels__DOT__dac_prep__DOT__sample_opl3_l_p1;
    vlSelf->sample_r = vlSelf->opl3__DOT__channels__DOT__dac_prep__DOT__sample_opl3_r_p1;
    vlSelf->opl3__DOT__host_if__DOT____Vcellinp__afifo__i_rd_reset_n 
        = (1U & (~ (IData)(vlSelf->opl3__DOT__reset_sync__DOT__r2)));
    vlSelf->opl3__DOT__channels__DOT__control_operators__DOT____Vcellinp__am_vib_egt_ksr_mult_mem__wea 
        = ((vlSelf->opl3__DOT__opl3_reg_wr >> 0x11U) 
           & ((0x20U <= (0xffU & (vlSelf->opl3__DOT__opl3_reg_wr 
                                  >> 8U))) & (0x35U 
                                              >= (0xffU 
                                                  & (vlSelf->opl3__DOT__opl3_reg_wr 
                                                     >> 8U)))));
    vlSelf->opl3__DOT__channels__DOT__control_operators__DOT____Vcellinp__ksl_tl_mem__wea 
        = ((vlSelf->opl3__DOT__opl3_reg_wr >> 0x11U) 
           & ((0x40U <= (0xffU & (vlSelf->opl3__DOT__opl3_reg_wr 
                                  >> 8U))) & (0x55U 
                                              >= (0xffU 
                                                  & (vlSelf->opl3__DOT__opl3_reg_wr 
                                                     >> 8U)))));
    vlSelf->opl3__DOT__channels__DOT__control_operators__DOT____Vcellinp__ar_dr_mem__wea 
        = ((vlSelf->opl3__DOT__opl3_reg_wr >> 0x11U) 
           & ((0x60U <= (0xffU & (vlSelf->opl3__DOT__opl3_reg_wr 
                                  >> 8U))) & (0x75U 
                                              >= (0xffU 
                                                  & (vlSelf->opl3__DOT__opl3_reg_wr 
                                                     >> 8U)))));
    vlSelf->opl3__DOT__channels__DOT__control_operators__DOT____Vcellinp__sl_rr_mem__wea 
        = ((vlSelf->opl3__DOT__opl3_reg_wr >> 0x11U) 
           & ((0x80U <= (0xffU & (vlSelf->opl3__DOT__opl3_reg_wr 
                                  >> 8U))) & (0x95U 
                                              >= (0xffU 
                                                  & (vlSelf->opl3__DOT__opl3_reg_wr 
                                                     >> 8U)))));
    vlSelf->opl3__DOT__channels__DOT__control_operators__DOT____Vcellinp__ws_mem__wea 
        = ((vlSelf->opl3__DOT__opl3_reg_wr >> 0x11U) 
           & ((0xe0U <= (0xffU & (vlSelf->opl3__DOT__opl3_reg_wr 
                                  >> 8U))) & (0xf5U 
                                              >= (0xffU 
                                                  & (vlSelf->opl3__DOT__opl3_reg_wr 
                                                     >> 8U)))));
    vlSelf->opl3__DOT__channels__DOT__control_operators__DOT____Vcellinp__fnum_low_mem__wea 
        = ((vlSelf->opl3__DOT__opl3_reg_wr >> 0x11U) 
           & ((0xa0U <= (0xffU & (vlSelf->opl3__DOT__opl3_reg_wr 
                                  >> 8U))) & (0xa8U 
                                              >= (0xffU 
                                                  & (vlSelf->opl3__DOT__opl3_reg_wr 
                                                     >> 8U)))));
    vlSelf->opl3__DOT__host_if__DOT__afifo__DOT__next_wr_addr 
        = (0x7fU & ((IData)(1U) + (IData)(vlSelf->opl3__DOT__host_if__DOT__afifo__DOT__wr_addr)));
    vlSelf->opl3__DOT__host_if__DOT__afifo__DOT__next_rd_addr 
        = (0x7fU & ((IData)(1U) + (IData)(vlSelf->opl3__DOT__host_if__DOT__afifo__DOT__rd_addr)));
    vlSelf->opl3__DOT__channels__DOT__control_operators__DOT__operator__DOT__envelope_generator__DOT__tremolo__DOT__am_val_tmp1_p1 
        = (0x3fU & ((0x1aU < (0x3fU & ((IData)(vlSelf->opl3__DOT__channels__DOT__control_operators__DOT__operator__DOT__envelope_generator__DOT__tremolo__DOT__tremolo_index_p1) 
                                       >> 8U))) ? ((IData)(0x34U) 
                                                   + 
                                                   (~ 
                                                    ((IData)(vlSelf->opl3__DOT__channels__DOT__control_operators__DOT__operator__DOT__envelope_generator__DOT__tremolo__DOT__tremolo_index_p1) 
                                                     >> 8U)))
                     : ((IData)(vlSelf->opl3__DOT__channels__DOT__control_operators__DOT__operator__DOT__envelope_generator__DOT__tremolo__DOT__tremolo_index_p1) 
                        >> 8U)));
    vlSelf->opl3__DOT__genblk1__DOT__timers__DOT__timer1_inst__DOT__tick_pulse 
        = (0xa8bU == (IData)(vlSelf->opl3__DOT__genblk1__DOT__timers__DOT__timer1_inst__DOT__tick_counter));
    vlSelf->opl3__DOT__genblk1__DOT__timers__DOT__timer2_inst__DOT__tick_pulse 
        = (0x2a2fU == (IData)(vlSelf->opl3__DOT__genblk1__DOT__timers__DOT__timer2_inst__DOT__tick_counter));
    vlSelf->opl3__DOT__channels__DOT__control_operators__DOT__kon_mem__DOT__next_self 
        = vlSelf->opl3__DOT__channels__DOT__control_operators__DOT__kon_mem__DOT__self;
    vlSelf->dout = ((0U == (IData)(vlSelf->opl3__DOT__host_if__DOT__address_p1))
                     ? (IData)(vlSelf->opl3__DOT__host_if__DOT__host_status_p1)
                     : 0xffU);
    vlSelf->opl3__DOT__channels__DOT__control_operators__DOT__kon_mem__DOT____Vcellinp__bankgen__BRA__0__KET____DOT__genblk1__DOT__mem_bank__dia 
        = ((1U != vlSelf->opl3__DOT__channels__DOT__control_operators__DOT__kon_mem__DOT__state) 
           & (vlSelf->opl3__DOT__opl3_reg_wr >> 5U));
    vlSelf->opl3__DOT__host_if__DOT__afifo__DOT__o_wr_full 
        = ((IData)(vlSelf->opl3__DOT__host_if__DOT__afifo__DOT__wr_rgray) 
           == ((0x60U & ((~ ((IData)(vlSelf->opl3__DOT__host_if__DOT__afifo__DOT__wgray) 
                             >> 5U)) << 5U)) | (0x1fU 
                                                & (IData)(vlSelf->opl3__DOT__host_if__DOT__afifo__DOT__wgray))));
    vlSelf->opl3__DOT__host_if__DOT__afifo__DOT__lcl_rd_empty 
        = ((IData)(vlSelf->opl3__DOT__host_if__DOT__afifo__DOT__rd_wgray) 
           == (IData)(vlSelf->opl3__DOT__host_if__DOT__afifo__DOT__rgray));
    vlSelf->opl3__DOT__host_if__DOT__genblk1__DOT__trick_sw_detection__DOT__wr_p1 
        = (1U & ((~ (IData)(vlSelf->opl3__DOT__host_if__DOT__genblk1__DOT__trick_sw_detection__DOT__cs_p1_n)) 
                 & (~ (IData)(vlSelf->opl3__DOT__host_if__DOT__genblk1__DOT__trick_sw_detection__DOT__wr_p1_n))));
    vlSelf->opl3__DOT__host_if__DOT__genblk1__DOT__trick_sw_detection__DOT__rd_p1 
        = (1U & ((~ (IData)(vlSelf->opl3__DOT__host_if__DOT__genblk1__DOT__trick_sw_detection__DOT__cs_p1_n)) 
                 & (~ (IData)(vlSelf->opl3__DOT__host_if__DOT__genblk1__DOT__trick_sw_detection__DOT__rd_p1_n))));
    vlSelf->opl3__DOT__channels__DOT__control_operators__DOT__operator__DOT____Vcellinp__feedback_mem__dia 
        = ((0x3ffe000U & (vlSelf->opl3__DOT__channels__DOT__control_operators__DOT__operator__DOT____Vcellout__feedback_sr__out[3U] 
                          << 5U)) | (IData)(vlSelf->opl3__DOT__channels__DOT__control_operators__DOT__out_p6));
    vlSelf->opl3__DOT__channels__DOT__control_operators__DOT__operator__DOT__envelope_generator__DOT__env_int_mem__DOT____Vcellinp__bankgen__BRA__0__KET____DOT__genblk1__DOT__mem_bank__wea 
        = (IData)(((~ ((IData)(vlSelf->opl3__DOT__channels__DOT__control_operators__DOT__operator__DOT__envelope_generator__DOT__bank_num_p) 
                       >> 2U)) & ((IData)(vlSelf->opl3__DOT__channels__DOT__control_operators__DOT__operator__DOT__envelope_generator__DOT____Vcellout__sample_clk_en_sr__out) 
                                  >> 2U)));
    vlSelf->opl3__DOT__channels__DOT__control_operators__DOT__operator__DOT__envelope_generator__DOT__env_int_mem__DOT____Vcellinp__bankgen__BRA__1__KET____DOT__genblk1__DOT__mem_bank__wea 
        = (1U & (((IData)(vlSelf->opl3__DOT__channels__DOT__control_operators__DOT__operator__DOT__envelope_generator__DOT__bank_num_p) 
                  & (IData)(vlSelf->opl3__DOT__channels__DOT__control_operators__DOT__operator__DOT__envelope_generator__DOT____Vcellout__sample_clk_en_sr__out)) 
                 >> 2U));
    vlSelf->opl3__DOT__channels__DOT__control_operators__DOT__operator__DOT__envelope_generator__DOT__ksl_add_rom__DOT__tmp1_p1 
        = (0xffU & VL_EXTENDS_II(8,7, (0x7fU & ((IData)(vlSelf->opl3__DOT__channels__DOT__control_operators__DOT__operator__DOT__envelope_generator__DOT__ksl_add_rom__DOT__rom_out_p1) 
                                                + VL_SHIFTL_III(7,7,32, (IData)(vlSelf->opl3__DOT__channels__DOT__control_operators__DOT__operator__DOT__envelope_generator__DOT__ksl_add_rom__DOT__tmp0_p1), 3U)))));
    vlSelf->opl3__DOT__genblk1__DOT__timers__DOT__timer1_inst__DOT__start_timer_set_pulse 
        = ((~ (IData)(vlSelf->opl3__DOT__genblk1__DOT__timers__DOT__timer1_inst__DOT__start_timer_edge_detect__DOT__in_r0)) 
           & (IData)(vlSelf->opl3__DOT__genblk1__DOT__timers__DOT__st1));
    vlSelf->opl3__DOT__genblk1__DOT__timers__DOT__timer2_inst__DOT__start_timer_set_pulse 
        = ((~ (IData)(vlSelf->opl3__DOT__genblk1__DOT__timers__DOT__timer2_inst__DOT__start_timer_edge_detect__DOT__in_r0)) 
           & (IData)(vlSelf->opl3__DOT__genblk1__DOT__timers__DOT__st2));
    vlSelf->opl3__DOT__channels__DOT__next_state = vlSelf->opl3__DOT__channels__DOT__state;
    if (((((((((0U == vlSelf->opl3__DOT__channels__DOT__state) 
               | (1U == vlSelf->opl3__DOT__channels__DOT__state)) 
              | (2U == vlSelf->opl3__DOT__channels__DOT__state)) 
             | (3U == vlSelf->opl3__DOT__channels__DOT__state)) 
            | (4U == vlSelf->opl3__DOT__channels__DOT__state)) 
           | (5U == vlSelf->opl3__DOT__channels__DOT__state)) 
          | (6U == vlSelf->opl3__DOT__channels__DOT__state)) 
         | (7U == vlSelf->opl3__DOT__channels__DOT__state))) {
        if ((0U == vlSelf->opl3__DOT__channels__DOT__state)) {
            if (vlSelf->opl3__DOT__channels__DOT__ops_done_pulse) {
                vlSelf->opl3__DOT__channels__DOT__next_state = 1U;
            }
        } else {
            vlSelf->opl3__DOT__channels__DOT__next_state 
                = ((1U == vlSelf->opl3__DOT__channels__DOT__state)
                    ? 2U : ((2U == vlSelf->opl3__DOT__channels__DOT__state)
                             ? 3U : ((3U == vlSelf->opl3__DOT__channels__DOT__state)
                                      ? ((8U == (0xfU 
                                                 & (vlSelf->opl3__DOT__channels__DOT__self[1U] 
                                                    >> 8U)))
                                          ? ((0x20000U 
                                              & vlSelf->opl3__DOT__channels__DOT__self[1U])
                                              ? 4U : 1U)
                                          : 1U) : (
                                                   (4U 
                                                    == vlSelf->opl3__DOT__channels__DOT__state)
                                                    ? 5U
                                                    : 
                                                   ((5U 
                                                     == vlSelf->opl3__DOT__channels__DOT__state)
                                                     ? 6U
                                                     : 
                                                    ((6U 
                                                      == vlSelf->opl3__DOT__channels__DOT__state)
                                                      ? 7U
                                                      : 
                                                     ((2U 
                                                       == 
                                                       (0xfU 
                                                        & (vlSelf->opl3__DOT__channels__DOT__self[1U] 
                                                           >> 8U)))
                                                       ? 
                                                      ((0x20000U 
                                                        & vlSelf->opl3__DOT__channels__DOT__self[1U])
                                                        ? 8U
                                                        : 4U)
                                                       : 4U)))))));
        }
    } else if ((8U == vlSelf->opl3__DOT__channels__DOT__state)) {
        vlSelf->opl3__DOT__channels__DOT__next_state = 0U;
    }
    if ((0U == (IData)(vlSelf->opl3__DOT__channels__DOT__control_operators__DOT__state))) {
        vlSelf->opl3__DOT__channels__DOT__control_operators__DOT__next_state 
            = (0x3fU & (IData)(vlSelf->opl3__DOT__sample_clk_en));
        vlSelf->opl3__DOT__channels__DOT__control_operators__DOT__op_num = 0U;
    } else {
        vlSelf->opl3__DOT__channels__DOT__control_operators__DOT__next_state 
            = (0x3fU & ((1U == (IData)(vlSelf->opl3__DOT__channels__DOT__control_operators__DOT__delay_counter))
                         ? ((0x24U == (IData)(vlSelf->opl3__DOT__channels__DOT__control_operators__DOT__state))
                             ? 0U : ((IData)(1U) + (IData)(vlSelf->opl3__DOT__channels__DOT__control_operators__DOT__state)))
                         : (IData)(vlSelf->opl3__DOT__channels__DOT__control_operators__DOT__state)));
        vlSelf->opl3__DOT__channels__DOT__control_operators__DOT__op_num 
            = (0x1fU & ((0x12U < (IData)(vlSelf->opl3__DOT__channels__DOT__control_operators__DOT__state))
                         ? (((IData)(vlSelf->opl3__DOT__channels__DOT__control_operators__DOT__state) 
                             - (IData)(0x12U)) - (IData)(1U))
                         : ((IData)(vlSelf->opl3__DOT__channels__DOT__control_operators__DOT__state) 
                            - (IData)(1U))));
    }
    vlSelf->opl3__DOT__channels__DOT__control_operators__DOT__kon_mem__DOT__next_state 
        = vlSelf->opl3__DOT__channels__DOT__control_operators__DOT__kon_mem__DOT__state;
    if ((0U == vlSelf->opl3__DOT__channels__DOT__control_operators__DOT__kon_mem__DOT__state)) {
        vlSelf->opl3__DOT__channels__DOT__control_operators__DOT__kon_mem__DOT__next_self = 0U;
        if (vlSelf->opl3__DOT__reset_sync__DOT__r2) {
            vlSelf->opl3__DOT__channels__DOT__control_operators__DOT__kon_mem__DOT__next_state = 1U;
        }
    } else if ((1U == vlSelf->opl3__DOT__channels__DOT__control_operators__DOT__kon_mem__DOT__state)) {
        if ((8U == (0xfU & ((IData)(vlSelf->opl3__DOT__channels__DOT__control_operators__DOT__kon_mem__DOT__self) 
                            >> 1U)))) {
            vlSelf->opl3__DOT__channels__DOT__control_operators__DOT__kon_mem__DOT__next_self 
                = (0x21U & (IData)(vlSelf->opl3__DOT__channels__DOT__control_operators__DOT__kon_mem__DOT__next_self));
            if ((0x20U & (IData)(vlSelf->opl3__DOT__channels__DOT__control_operators__DOT__kon_mem__DOT__self))) {
                vlSelf->opl3__DOT__channels__DOT__control_operators__DOT__kon_mem__DOT__next_self 
                    = (1U | (IData)(vlSelf->opl3__DOT__channels__DOT__control_operators__DOT__kon_mem__DOT__next_self));
                vlSelf->opl3__DOT__channels__DOT__control_operators__DOT__kon_mem__DOT__next_state = 0U;
            } else {
                vlSelf->opl3__DOT__channels__DOT__control_operators__DOT__kon_mem__DOT__next_self 
                    = ((0x1fU & (IData)(vlSelf->opl3__DOT__channels__DOT__control_operators__DOT__kon_mem__DOT__next_self)) 
                       | (0x20U & (((IData)(1U) + ((IData)(vlSelf->opl3__DOT__channels__DOT__control_operators__DOT__kon_mem__DOT__self) 
                                                   >> 5U)) 
                                   << 5U)));
            }
        } else {
            vlSelf->opl3__DOT__channels__DOT__control_operators__DOT__kon_mem__DOT__next_self 
                = ((0x21U & (IData)(vlSelf->opl3__DOT__channels__DOT__control_operators__DOT__kon_mem__DOT__next_self)) 
                   | (0x1eU & (((IData)(1U) + ((IData)(vlSelf->opl3__DOT__channels__DOT__control_operators__DOT__kon_mem__DOT__self) 
                                               >> 1U)) 
                               << 1U)));
        }
    }
    vlSelf->opl3__DOT__channels__DOT__control_operators__DOT__kon_mem__DOT____Vcellinp__bankgen__BRA__0__KET____DOT__genblk1__DOT__mem_bank__addra 
        = (0xfU & ((1U == vlSelf->opl3__DOT__channels__DOT__control_operators__DOT__kon_mem__DOT__state)
                    ? ((IData)(vlSelf->opl3__DOT__channels__DOT__control_operators__DOT__kon_mem__DOT__self) 
                       >> 1U) : (vlSelf->opl3__DOT__opl3_reg_wr 
                                 >> 8U)));
    vlSelf->opl3__DOT__channels__DOT__operator_out 
        = ((0x1fffU & vlSelf->opl3__DOT__channels__DOT__operator_out) 
           | ((0x80000U & ((IData)(vlSelf->opl3__DOT__channels__DOT__control_operators__DOT____Vcellout__sample_clk_en_sr__out) 
                           << 0xeU)) | ((0x40000U & 
                                         ((IData)(vlSelf->opl3__DOT__channels__DOT__control_operators__DOT__bank_num_p) 
                                          << 0xdU)) 
                                        | (0x3e000U 
                                           & (vlSelf->opl3__DOT__channels__DOT__control_operators__DOT__op_num_p 
                                              >> 0xcU)))));
    vlSelf->opl3__DOT__channels__DOT__operator_out 
        = ((0xfe000U & vlSelf->opl3__DOT__channels__DOT__operator_out) 
           | (IData)(vlSelf->opl3__DOT__channels__DOT__control_operators__DOT__out_p6));
    vlSelf->opl3__DOT__channels__DOT__control_operators__DOT__operator__DOT__phase_generator__DOT__final_phase_p3 
        = (0x3ffU & ((IData)(vlSelf->opl3__DOT__channels__DOT__control_operators__DOT__operator__DOT__phase_generator__DOT__rhythm_phase_p3) 
                     + ((vlSelf->opl3__DOT__channels__DOT__control_operators__DOT__operator__DOT__phase_generator__DOT__modulation_p[0U] 
                         << 0x13U) | (vlSelf->opl3__DOT__channels__DOT__control_operators__DOT__operator__DOT__phase_generator__DOT__modulation_p[0U] 
                                      >> 0xdU))));
    vlSelf->opl3__DOT__channels__DOT__control_operators__DOT__operator__DOT__phase_generator__DOT__theta_p3 
        = (0xffU & ((((0U == (7U & (vlSelf->opl3__DOT__channels__DOT__control_operators__DOT__operator__DOT__phase_generator__DOT__ws_post_opl_p 
                                    >> 6U))) || (1U 
                                                 == 
                                                 (7U 
                                                  & (vlSelf->opl3__DOT__channels__DOT__control_operators__DOT__operator__DOT__phase_generator__DOT__ws_post_opl_p 
                                                     >> 6U)))) 
                     || (2U == (7U & (vlSelf->opl3__DOT__channels__DOT__control_operators__DOT__operator__DOT__phase_generator__DOT__ws_post_opl_p 
                                      >> 6U)))) ? (
                                                   (0x100U 
                                                    & (IData)(vlSelf->opl3__DOT__channels__DOT__control_operators__DOT__operator__DOT__phase_generator__DOT__final_phase_p3))
                                                    ? 
                                                   (0xffU 
                                                    ^ 
                                                    (0xffU 
                                                     & (IData)(vlSelf->opl3__DOT__channels__DOT__control_operators__DOT__operator__DOT__phase_generator__DOT__final_phase_p3)))
                                                    : 
                                                   (0xffU 
                                                    & (IData)(vlSelf->opl3__DOT__channels__DOT__control_operators__DOT__operator__DOT__phase_generator__DOT__final_phase_p3)))
                     : ((3U == (7U & (vlSelf->opl3__DOT__channels__DOT__control_operators__DOT__operator__DOT__phase_generator__DOT__ws_post_opl_p 
                                      >> 6U))) ? (IData)(vlSelf->opl3__DOT__channels__DOT__control_operators__DOT__operator__DOT__phase_generator__DOT__final_phase_p3)
                         : (((4U == (7U & (vlSelf->opl3__DOT__channels__DOT__control_operators__DOT__operator__DOT__phase_generator__DOT__ws_post_opl_p 
                                           >> 6U))) 
                             || (5U == (7U & (vlSelf->opl3__DOT__channels__DOT__control_operators__DOT__operator__DOT__phase_generator__DOT__ws_post_opl_p 
                                              >> 6U))))
                             ? ((0x80U & (IData)(vlSelf->opl3__DOT__channels__DOT__control_operators__DOT__operator__DOT__phase_generator__DOT__final_phase_p3))
                                 ? (0x1feU ^ VL_SHIFTL_III(32,32,32, 
                                                           (0xffU 
                                                            & (IData)(vlSelf->opl3__DOT__channels__DOT__control_operators__DOT__operator__DOT__phase_generator__DOT__final_phase_p3)), 1U))
                                 : VL_SHIFTL_III(32,32,32, 
                                                 (0xffU 
                                                  & (IData)(vlSelf->opl3__DOT__channels__DOT__control_operators__DOT__operator__DOT__phase_generator__DOT__final_phase_p3)), 1U))
                             : (IData)(vlSelf->opl3__DOT__channels__DOT__control_operators__DOT__operator__DOT__phase_generator__DOT__final_phase_p3)))));
    vlSelf->opl3__DOT__host_if__DOT__wr_p1 = (1U & 
                                              ((~ (IData)(vlSelf->opl3__DOT__host_if__DOT__cs_p1_n)) 
                                               & (~ (IData)(vlSelf->opl3__DOT__host_if__DOT__wr_p1_n))));
    opl3__DOT__channels__DOT__control_operators__DOT__operator__DOT__calc_phase_inc__DOT__vibrato__DOT__delta1_p1 
        = (7U & ((3U == (3U & VL_SHIFTR_III(32,32,32, (IData)(vlSelf->opl3__DOT__channels__DOT__control_operators__DOT__operator__DOT__calc_phase_inc__DOT__vibrato__DOT__vibrato_index_p1), 0xaU)))
                  ? VL_SHIFTR_III(3,3,32, (7U & ((IData)(vlSelf->opl3__DOT__channels__DOT__control_operators__DOT__operator__DOT__calc_phase_inc__DOT__vibrato__DOT__fnum_p1) 
                                                 >> 7U)), 1U)
                  : ((IData)(vlSelf->opl3__DOT__channels__DOT__control_operators__DOT__operator__DOT__calc_phase_inc__DOT__vibrato__DOT__fnum_p1) 
                     >> 7U)));
    vlSelf->opl3__DOT__genblk1__DOT__timers__DOT__irq 
        = ((IData)(vlSelf->opl3__DOT__genblk1__DOT__timers__DOT__ft1) 
           | (IData)(vlSelf->opl3__DOT__genblk1__DOT__timers__DOT__ft2));
    if (((0U == (7U & (vlSelf->opl3__DOT__channels__DOT__control_operators__DOT__operator__DOT__phase_generator__DOT__ws_post_opl_p 
                       >> 9U))) || (2U == (7U & (vlSelf->opl3__DOT__channels__DOT__control_operators__DOT__operator__DOT__phase_generator__DOT__ws_post_opl_p 
                                                 >> 9U))))) {
        vlSelf->opl3__DOT__channels__DOT__control_operators__DOT__operator__DOT__phase_generator__DOT__pre_gain_p4 
            = vlSelf->opl3__DOT__channels__DOT__control_operators__DOT__operator__DOT__phase_generator__DOT__log_sin_out_p4;
    } else if ((((1U == (7U & (vlSelf->opl3__DOT__channels__DOT__control_operators__DOT__operator__DOT__phase_generator__DOT__ws_post_opl_p 
                               >> 9U))) || (4U == (7U 
                                                   & (vlSelf->opl3__DOT__channels__DOT__control_operators__DOT__operator__DOT__phase_generator__DOT__ws_post_opl_p 
                                                      >> 9U)))) 
                || (5U == (7U & (vlSelf->opl3__DOT__channels__DOT__control_operators__DOT__operator__DOT__phase_generator__DOT__ws_post_opl_p 
                                 >> 9U))))) {
        vlSelf->opl3__DOT__channels__DOT__control_operators__DOT__operator__DOT__phase_generator__DOT__pre_gain_p4 
            = ((0x200U & vlSelf->opl3__DOT__channels__DOT__control_operators__DOT__operator__DOT__phase_generator__DOT__final_phase_p)
                ? 0x1000U : (0x1fffU & (IData)(vlSelf->opl3__DOT__channels__DOT__control_operators__DOT__operator__DOT__phase_generator__DOT__log_sin_out_p4)));
    } else if ((3U == (7U & (vlSelf->opl3__DOT__channels__DOT__control_operators__DOT__operator__DOT__phase_generator__DOT__ws_post_opl_p 
                             >> 9U)))) {
        vlSelf->opl3__DOT__channels__DOT__control_operators__DOT__operator__DOT__phase_generator__DOT__pre_gain_p4 
            = ((0x100U & vlSelf->opl3__DOT__channels__DOT__control_operators__DOT__operator__DOT__phase_generator__DOT__final_phase_p)
                ? 0x1000U : (0x1fffU & (IData)(vlSelf->opl3__DOT__channels__DOT__control_operators__DOT__operator__DOT__phase_generator__DOT__log_sin_out_p4)));
    } else if ((6U == (7U & (vlSelf->opl3__DOT__channels__DOT__control_operators__DOT__operator__DOT__phase_generator__DOT__ws_post_opl_p 
                             >> 9U)))) {
        vlSelf->opl3__DOT__channels__DOT__control_operators__DOT__operator__DOT__phase_generator__DOT__pre_gain_p4 = 0U;
    } else if ((7U == (7U & (vlSelf->opl3__DOT__channels__DOT__control_operators__DOT__operator__DOT__phase_generator__DOT__ws_post_opl_p 
                             >> 9U)))) {
        vlSelf->opl3__DOT__channels__DOT__control_operators__DOT__operator__DOT__phase_generator__DOT__pre_gain_p4 
            = (0x1fffU & VL_SHIFTL_III(13,32,32, ((0x200U 
                                                   & vlSelf->opl3__DOT__channels__DOT__control_operators__DOT__operator__DOT__phase_generator__DOT__final_phase_p)
                                                   ? 
                                                  (0x1ffU 
                                                   ^ 
                                                   (0x1ffU 
                                                    & vlSelf->opl3__DOT__channels__DOT__control_operators__DOT__operator__DOT__phase_generator__DOT__final_phase_p))
                                                   : 
                                                  (0x3ffU 
                                                   & vlSelf->opl3__DOT__channels__DOT__control_operators__DOT__operator__DOT__phase_generator__DOT__final_phase_p)), 3U));
    }
    vlSelf->opl3__DOT__channels__DOT__control_operators__DOT__operator__DOT__phase_generator__DOT__post_gain_p4 
        = (0x7fffU & ((IData)(vlSelf->opl3__DOT__channels__DOT__control_operators__DOT__operator__DOT__phase_generator__DOT__pre_gain_p4) 
                      + (IData)(vlSelf->opl3__DOT__channels__DOT__control_operators__DOT__operator__DOT__phase_generator__DOT__env_shifted_p4)));
    vlSelf->opl3__DOT__channels__DOT__control_operators__DOT__operator__DOT__phase_generator__DOT__level_p4 
        = ((0x1fffU < (IData)(vlSelf->opl3__DOT__channels__DOT__control_operators__DOT__operator__DOT__phase_generator__DOT__post_gain_p4))
            ? 0x1fffU : (0x1fffU & (IData)(vlSelf->opl3__DOT__channels__DOT__control_operators__DOT__operator__DOT__phase_generator__DOT__post_gain_p4)));
    opl3__DOT__channels__DOT____Vcellinp__ch_abcd_cnt_mem__wea 
        = ((vlSelf->opl3__DOT__opl3_reg_wr >> 0x11U) 
           & ((0xc0U <= (0xffU & (vlSelf->opl3__DOT__opl3_reg_wr 
                                  >> 8U))) & (0xc8U 
                                              >= (0xffU 
                                                  & (vlSelf->opl3__DOT__opl3_reg_wr 
                                                     >> 8U)))));
    opl3__DOT__channels__DOT__control_operators__DOT____Vcellinp__block_fnum_high_mem__wea 
        = ((vlSelf->opl3__DOT__opl3_reg_wr >> 0x11U) 
           & ((0xb0U <= (0xffU & (vlSelf->opl3__DOT__opl3_reg_wr 
                                  >> 8U))) & (0xb8U 
                                              >= (0xffU 
                                                  & (vlSelf->opl3__DOT__opl3_reg_wr 
                                                     >> 8U)))));
    vlSelf->opl3__DOT__channels__DOT__control_operators__DOT__op_sample_clk_en 
        = ((0U != (IData)(vlSelf->opl3__DOT__channels__DOT__control_operators__DOT__state)) 
           & (0U == (IData)(vlSelf->opl3__DOT__channels__DOT__control_operators__DOT__delay_counter)));
    opl3__DOT__channels__DOT__control_operators__DOT__operator__DOT__envelope_generator__DOT__calc_envelope_shift__DOT__rate_hi_pre_p1 
        = (0x1fU & ((IData)(vlSelf->opl3__DOT__channels__DOT__control_operators__DOT__operator__DOT__envelope_generator__DOT__calc_envelope_shift__DOT__rate_p1) 
                    >> 2U));
    vlSelf->opl3__DOT__channels__DOT__control_operators__DOT__operator__DOT__envelope_generator__DOT__calc_envelope_shift__DOT__rate_hi_p1 
        = ((0x10U & (IData)(opl3__DOT__channels__DOT__control_operators__DOT__operator__DOT__envelope_generator__DOT__calc_envelope_shift__DOT__rate_hi_pre_p1))
            ? 0xfU : (0xfU & (IData)(opl3__DOT__channels__DOT__control_operators__DOT__operator__DOT__envelope_generator__DOT__calc_envelope_shift__DOT__rate_hi_pre_p1)));
    vlSelf->opl3__DOT__channels__DOT__control_operators__DOT__operator__DOT__envelope_generator__DOT__calc_envelope_shift__DOT__rate_lo_p1 
        = (3U & (IData)(vlSelf->opl3__DOT__channels__DOT__control_operators__DOT__operator__DOT__envelope_generator__DOT__calc_envelope_shift__DOT__rate_p1));
    vlSelf->opl3__DOT__channels__DOT__control_operators__DOT__operator__DOT__envelope_generator__DOT__calc_envelope_shift__DOT__eg_shift_p1 
        = (0x3fU & ((IData)(vlSelf->opl3__DOT__channels__DOT__control_operators__DOT__operator__DOT__envelope_generator__DOT__calc_envelope_shift__DOT__rate_hi_p1) 
                    + (IData)(vlSelf->opl3__DOT__channels__DOT__control_operators__DOT__operator__DOT__envelope_generator__DOT__calc_envelope_shift__DOT__eg_add)));
    vlSelf->opl3__DOT__channels__DOT__control_operators__DOT__operator__DOT__envelope_generator__DOT__calc_envelope_shift__DOT__env_shift_pre_p1 
        = (7U & ((3U & (IData)(vlSelf->opl3__DOT__channels__DOT__control_operators__DOT__operator__DOT__envelope_generator__DOT__calc_envelope_shift__DOT__rate_hi_p1)) 
                 + (1U & (0x8aeU >> (0xfU & (VL_SHIFTL_III(4,32,32, (IData)(vlSelf->opl3__DOT__channels__DOT__control_operators__DOT__operator__DOT__envelope_generator__DOT__calc_envelope_shift__DOT__rate_lo_p1), 2U) 
                                             + (IData)(vlSelf->opl3__DOT__channels__DOT__control_operators__DOT__operator__DOT__envelope_generator__DOT__calc_envelope_shift__DOT__eg_timer_lo)))))));
    vlSelf->opl3__DOT__channels__DOT__control_operators__DOT__operator__DOT__feedback_mem__DOT__dob_array[0U] 
        = vlSelf->opl3__DOT__channels__DOT__control_operators__DOT__operator__DOT__feedback_mem__DOT__bankgen__BRA__0__KET____DOT__genblk1__DOT__mem_bank__DOT__genblk1__DOT__dob_p1;
    vlSelf->opl3__DOT__channels__DOT__control_operators__DOT__operator__DOT__feedback_mem__DOT__dob_array[1U] 
        = vlSelf->opl3__DOT__channels__DOT__control_operators__DOT__operator__DOT__feedback_mem__DOT__bankgen__BRA__1__KET____DOT__genblk1__DOT__mem_bank__DOT__genblk1__DOT__dob_p1;
    vlSelf->opl3__DOT__channels__DOT__control_operators__DOT__fb_cnt1_mem__DOT__dob_array[0U] 
        = vlSelf->opl3__DOT__channels__DOT__control_operators__DOT__fb_cnt1_mem__DOT__bankgen__BRA__0__KET____DOT__genblk1__DOT__mem_bank__DOT__genblk1__DOT__dob_p1;
    vlSelf->opl3__DOT__channels__DOT__control_operators__DOT__fb_cnt1_mem__DOT__dob_array[1U] 
        = vlSelf->opl3__DOT__channels__DOT__control_operators__DOT__fb_cnt1_mem__DOT__bankgen__BRA__1__KET____DOT__genblk1__DOT__mem_bank__DOT__genblk1__DOT__dob_p1;
    vlSelf->opl3__DOT__channels__DOT__control_operators__DOT__operator__DOT__phase_generator__DOT__phase_acc_mem__DOT__dob_array[0U] 
        = vlSelf->opl3__DOT__channels__DOT__control_operators__DOT__operator__DOT__phase_generator__DOT__phase_acc_mem__DOT__bankgen__BRA__0__KET____DOT__genblk1__DOT__mem_bank__DOT__genblk1__DOT__genblk1__DOT__dob_p2;
    vlSelf->opl3__DOT__channels__DOT__control_operators__DOT__operator__DOT__phase_generator__DOT__phase_acc_mem__DOT__dob_array[1U] 
        = vlSelf->opl3__DOT__channels__DOT__control_operators__DOT__operator__DOT__phase_generator__DOT__phase_acc_mem__DOT__bankgen__BRA__1__KET____DOT__genblk1__DOT__mem_bank__DOT__genblk1__DOT__genblk1__DOT__dob_p2;
    vlSelf->opl3__DOT__channels__DOT__control_operators__DOT__operator__DOT__envelope_generator__DOT__env_int_pre_p2 
        = (0x1ffU & (vlSelf->opl3__DOT__channels__DOT__control_operators__DOT__operator__DOT__envelope_generator__DOT__env_int_p 
                     >> 9U));
    vlSelf->opl3__DOT__channels__DOT__control_operators__DOT__operator__DOT__envelope_generator__DOT__eg_inc_p2 = 0U;
    opl3__DOT__channels__DOT__control_operators__DOT__operator__DOT__envelope_generator__DOT__eg_off_p2 = 0U;
    vlSelf->opl3__DOT__channels__DOT__control_operators__DOT__operator__DOT__envelope_generator__DOT__next_state_p2 
        = vlSelf->opl3__DOT__channels__DOT__control_operators__DOT__operator__DOT__envelope_generator__DOT__state_p2;
    opl3__DOT__channels__DOT__control_operators__DOT__operator__DOT__envelope_generator__DOT__env_int_extra_bits_p2 
        = (0x1ffU & (vlSelf->opl3__DOT__channels__DOT__control_operators__DOT__operator__DOT__envelope_generator__DOT__env_int_p 
                     >> 9U));
    opl3__DOT__channels__DOT__control_operators__DOT__operator__DOT__envelope_generator__DOT__sl_increased_p2 
        = ((0xfU == (0xfU & ((IData)(vlSelf->opl3__DOT__channels__DOT__control_operators__DOT__operator__DOT__envelope_generator__DOT__sl_p) 
                             >> 4U))) ? 0x1fU : (0xfU 
                                                 & ((IData)(vlSelf->opl3__DOT__channels__DOT__control_operators__DOT__operator__DOT__envelope_generator__DOT__sl_p) 
                                                    >> 4U)));
    if ((((IData)(vlSelf->opl3__DOT__channels__DOT__control_operators__DOT__operator__DOT__envelope_generator__DOT____Vcellout__eg_reset_sr__out) 
          >> 1U) & (0xfU == (IData)(vlSelf->opl3__DOT__channels__DOT__control_operators__DOT__operator__DOT__envelope_generator__DOT__rate_hi_p2)))) {
        vlSelf->opl3__DOT__channels__DOT__control_operators__DOT__operator__DOT__envelope_generator__DOT__env_int_pre_p2 = 0U;
    }
    if ((0x1f8U == (0x1f8U & (vlSelf->opl3__DOT__channels__DOT__control_operators__DOT__operator__DOT__envelope_generator__DOT__env_int_p 
                              >> 9U)))) {
        opl3__DOT__channels__DOT__control_operators__DOT__operator__DOT__envelope_generator__DOT__eg_off_p2 = 1U;
    }
    if ((((1U != (IData)(vlSelf->opl3__DOT__channels__DOT__control_operators__DOT__operator__DOT__envelope_generator__DOT__state_p2)) 
          & (~ ((IData)(vlSelf->opl3__DOT__channels__DOT__control_operators__DOT__operator__DOT__envelope_generator__DOT____Vcellout__eg_reset_sr__out) 
                >> 1U))) & (IData)(opl3__DOT__channels__DOT__control_operators__DOT__operator__DOT__envelope_generator__DOT__eg_off_p2))) {
        vlSelf->opl3__DOT__channels__DOT__control_operators__DOT__operator__DOT__envelope_generator__DOT__env_int_pre_p2 = 0x1ffU;
    }
    if ((8U & (IData)(vlSelf->opl3__DOT__channels__DOT__control_operators__DOT__operator__DOT__envelope_generator__DOT__state_p2))) {
        if ((1U & (~ ((IData)(vlSelf->opl3__DOT__channels__DOT__control_operators__DOT__operator__DOT__envelope_generator__DOT__state_p2) 
                      >> 2U)))) {
            if ((1U & (~ ((IData)(vlSelf->opl3__DOT__channels__DOT__control_operators__DOT__operator__DOT__envelope_generator__DOT__state_p2) 
                          >> 1U)))) {
                if ((1U & (~ (IData)(vlSelf->opl3__DOT__channels__DOT__control_operators__DOT__operator__DOT__envelope_generator__DOT__state_p2)))) {
                    if ((((~ (IData)(opl3__DOT__channels__DOT__control_operators__DOT__operator__DOT__envelope_generator__DOT__eg_off_p2)) 
                          & (~ ((IData)(vlSelf->opl3__DOT__channels__DOT__control_operators__DOT__operator__DOT__envelope_generator__DOT____Vcellout__eg_reset_sr__out) 
                                >> 1U))) & (0U < (IData)(vlSelf->opl3__DOT__channels__DOT__control_operators__DOT__operator__DOT__envelope_generator__DOT__env_shift_p2)))) {
                        vlSelf->opl3__DOT__channels__DOT__control_operators__DOT__operator__DOT__envelope_generator__DOT__eg_inc_p2 
                            = (0x1ffU & VL_SHIFTL_III(9,32,32, (IData)(1U), 
                                                      ((IData)(vlSelf->opl3__DOT__channels__DOT__control_operators__DOT__operator__DOT__envelope_generator__DOT__env_shift_p2) 
                                                       - (IData)(1U))));
                    }
                }
            }
        }
    } else if ((4U & (IData)(vlSelf->opl3__DOT__channels__DOT__control_operators__DOT__operator__DOT__envelope_generator__DOT__state_p2))) {
        if ((1U & (~ ((IData)(vlSelf->opl3__DOT__channels__DOT__control_operators__DOT__operator__DOT__envelope_generator__DOT__state_p2) 
                      >> 1U)))) {
            if ((1U & (~ (IData)(vlSelf->opl3__DOT__channels__DOT__control_operators__DOT__operator__DOT__envelope_generator__DOT__state_p2)))) {
                if ((((~ (IData)(opl3__DOT__channels__DOT__control_operators__DOT__operator__DOT__envelope_generator__DOT__eg_off_p2)) 
                      & (~ ((IData)(vlSelf->opl3__DOT__channels__DOT__control_operators__DOT__operator__DOT__envelope_generator__DOT____Vcellout__eg_reset_sr__out) 
                            >> 1U))) & (0U < (IData)(vlSelf->opl3__DOT__channels__DOT__control_operators__DOT__operator__DOT__envelope_generator__DOT__env_shift_p2)))) {
                    vlSelf->opl3__DOT__channels__DOT__control_operators__DOT__operator__DOT__envelope_generator__DOT__eg_inc_p2 
                        = (0x1ffU & VL_SHIFTL_III(9,32,32, (IData)(1U), 
                                                  ((IData)(vlSelf->opl3__DOT__channels__DOT__control_operators__DOT__operator__DOT__envelope_generator__DOT__env_shift_p2) 
                                                   - (IData)(1U))));
                }
            }
        }
    } else if ((2U & (IData)(vlSelf->opl3__DOT__channels__DOT__control_operators__DOT__operator__DOT__envelope_generator__DOT__state_p2))) {
        if ((1U & (~ (IData)(vlSelf->opl3__DOT__channels__DOT__control_operators__DOT__operator__DOT__envelope_generator__DOT__state_p2)))) {
            if (((0x1ffU & VL_SHIFTR_III(9,9,32, (0x1ffU 
                                                  & (vlSelf->opl3__DOT__channels__DOT__control_operators__DOT__operator__DOT__envelope_generator__DOT__env_int_p 
                                                     >> 9U)), 4U)) 
                 == (IData)(opl3__DOT__channels__DOT__control_operators__DOT__operator__DOT__envelope_generator__DOT__sl_increased_p2))) {
                vlSelf->opl3__DOT__channels__DOT__control_operators__DOT__operator__DOT__envelope_generator__DOT__next_state_p2 = 4U;
            } else if ((((~ (IData)(opl3__DOT__channels__DOT__control_operators__DOT__operator__DOT__envelope_generator__DOT__eg_off_p2)) 
                         & (~ ((IData)(vlSelf->opl3__DOT__channels__DOT__control_operators__DOT__operator__DOT__envelope_generator__DOT____Vcellout__eg_reset_sr__out) 
                               >> 1U))) & (0U < (IData)(vlSelf->opl3__DOT__channels__DOT__control_operators__DOT__operator__DOT__envelope_generator__DOT__env_shift_p2)))) {
                vlSelf->opl3__DOT__channels__DOT__control_operators__DOT__operator__DOT__envelope_generator__DOT__eg_inc_p2 
                    = (0x1ffU & VL_SHIFTL_III(9,32,32, (IData)(1U), 
                                              ((IData)(vlSelf->opl3__DOT__channels__DOT__control_operators__DOT__operator__DOT__envelope_generator__DOT__env_shift_p2) 
                                               - (IData)(1U))));
            }
        }
    } else if ((1U & (IData)(vlSelf->opl3__DOT__channels__DOT__control_operators__DOT__operator__DOT__envelope_generator__DOT__state_p2))) {
        if ((0U == (0x1ffU & (vlSelf->opl3__DOT__channels__DOT__control_operators__DOT__operator__DOT__envelope_generator__DOT__env_int_p 
                              >> 9U)))) {
            vlSelf->opl3__DOT__channels__DOT__control_operators__DOT__operator__DOT__envelope_generator__DOT__next_state_p2 = 2U;
        } else if (((((IData)(vlSelf->opl3__DOT__channels__DOT__control_operators__DOT__operator__DOT__envelope_generator__DOT____Vcellout__key_on_sr__out) 
                      >> 1U) & (0U < (IData)(vlSelf->opl3__DOT__channels__DOT__control_operators__DOT__operator__DOT__envelope_generator__DOT__env_shift_p2))) 
                    & (0xfU != (IData)(vlSelf->opl3__DOT__channels__DOT__control_operators__DOT__operator__DOT__envelope_generator__DOT__rate_hi_p2)))) {
            vlSelf->opl3__DOT__channels__DOT__control_operators__DOT__operator__DOT__envelope_generator__DOT__eg_inc_p2 
                = (0x1ffU & VL_SHIFTR_III(12,12,32, 
                                          (0xfffU & 
                                           (~ (IData)(opl3__DOT__channels__DOT__control_operators__DOT__operator__DOT__envelope_generator__DOT__env_int_extra_bits_p2))), 
                                          ((IData)(4U) 
                                           - (IData)(vlSelf->opl3__DOT__channels__DOT__control_operators__DOT__operator__DOT__envelope_generator__DOT__env_shift_p2))));
        }
    }
    if ((2U & (IData)(vlSelf->opl3__DOT__channels__DOT__control_operators__DOT__operator__DOT__envelope_generator__DOT____Vcellout__eg_reset_sr__out))) {
        vlSelf->opl3__DOT__channels__DOT__control_operators__DOT__operator__DOT__envelope_generator__DOT__next_state_p2 = 1U;
    }
    if ((1U & (~ ((IData)(vlSelf->opl3__DOT__channels__DOT__control_operators__DOT__operator__DOT__envelope_generator__DOT____Vcellout__key_on_sr__out) 
                  >> 1U)))) {
        vlSelf->opl3__DOT__channels__DOT__control_operators__DOT__operator__DOT__envelope_generator__DOT__next_state_p2 = 8U;
    }
    vlSelf->opl3__DOT__channels__DOT__control_operators__DOT__fb_cnt0_mem__DOT__dob_array[0U] 
        = vlSelf->opl3__DOT__channels__DOT__control_operators__DOT__fb_cnt0_mem__DOT__bankgen__BRA__0__KET____DOT__genblk1__DOT__mem_bank__DOT__genblk1__DOT__dob_p1;
    vlSelf->opl3__DOT__channels__DOT__control_operators__DOT__fb_cnt0_mem__DOT__dob_array[1U] 
        = vlSelf->opl3__DOT__channels__DOT__control_operators__DOT__fb_cnt0_mem__DOT__bankgen__BRA__1__KET____DOT__genblk1__DOT__mem_bank__DOT__genblk1__DOT__dob_p1;
    vlSelf->opl3__DOT__channels__DOT__operator_out_mem__DOT__dob_array[0U] 
        = vlSelf->opl3__DOT__channels__DOT__operator_out_mem__DOT__bankgen__BRA__0__KET____DOT__genblk1__DOT__mem_bank__DOT__genblk1__DOT__dob_p1;
    vlSelf->opl3__DOT__channels__DOT__operator_out_mem__DOT__dob_array[1U] 
        = vlSelf->opl3__DOT__channels__DOT__operator_out_mem__DOT__bankgen__BRA__1__KET____DOT__genblk1__DOT__mem_bank__DOT__genblk1__DOT__dob_p1;
    vlSelf->opl3__DOT__host_if__DOT____Vcellinp__afifo__i_wr 
        = ((~ (IData)(vlSelf->opl3__DOT__host_if__DOT__wr_p2)) 
           & (IData)(vlSelf->opl3__DOT__host_if__DOT__wr_p1));
    vlSelf->opl3__DOT__channels__DOT__control_operators__DOT__operator__DOT__calc_phase_inc__DOT__vibrato__DOT__delta2_p1 
        = (7U & ((IData)(vlSelf->opl3__DOT__channels__DOT__control_operators__DOT__operator__DOT__calc_phase_inc__DOT__vibrato__DOT__dvb_p1)
                  ? (IData)(opl3__DOT__channels__DOT__control_operators__DOT__operator__DOT__calc_phase_inc__DOT__vibrato__DOT__delta1_p1)
                  : VL_SHIFTR_III(3,3,32, (IData)(opl3__DOT__channels__DOT__control_operators__DOT__operator__DOT__calc_phase_inc__DOT__vibrato__DOT__delta1_p1), 1U)));
    vlSelf->opl3__DOT__status = 0U;
    vlSelf->opl3__DOT__status = ((0x1fU & (IData)(vlSelf->opl3__DOT__status)) 
                                 | (((IData)(vlSelf->opl3__DOT__genblk1__DOT__timers__DOT__irq) 
                                     << 7U) | (((IData)(vlSelf->opl3__DOT__genblk1__DOT__timers__DOT__ft1) 
                                                << 6U) 
                                               | ((IData)(vlSelf->opl3__DOT__genblk1__DOT__timers__DOT__ft2) 
                                                  << 5U))));
    vlSelf->opl3__DOT__channels__DOT__control_operators__DOT__fb_cnt0_mem__DOT____Vcellinp__bankgen__BRA__0__KET____DOT__genblk1__DOT__mem_bank__wea 
        = ((~ (vlSelf->opl3__DOT__opl3_reg_wr >> 0x10U)) 
           & (IData)(opl3__DOT__channels__DOT____Vcellinp__ch_abcd_cnt_mem__wea));
    vlSelf->opl3__DOT__channels__DOT__control_operators__DOT__fb_cnt0_mem__DOT____Vcellinp__bankgen__BRA__1__KET____DOT__genblk1__DOT__mem_bank__wea 
        = ((vlSelf->opl3__DOT__opl3_reg_wr >> 0x10U) 
           & (IData)(opl3__DOT__channels__DOT____Vcellinp__ch_abcd_cnt_mem__wea));
    vlSelf->opl3__DOT__channels__DOT__control_operators__DOT__block_fnum_high_mem__DOT____Vcellinp__bankgen__BRA__0__KET____DOT__genblk1__DOT__mem_bank__wea 
        = ((~ (vlSelf->opl3__DOT__opl3_reg_wr >> 0x10U)) 
           & (IData)(opl3__DOT__channels__DOT__control_operators__DOT____Vcellinp__block_fnum_high_mem__wea));
    vlSelf->opl3__DOT__channels__DOT__control_operators__DOT__block_fnum_high_mem__DOT____Vcellinp__bankgen__BRA__1__KET____DOT__genblk1__DOT__mem_bank__wea 
        = ((vlSelf->opl3__DOT__opl3_reg_wr >> 0x10U) 
           & (IData)(opl3__DOT__channels__DOT__control_operators__DOT____Vcellinp__block_fnum_high_mem__wea));
    vlSelf->opl3__DOT__channels__DOT__control_operators__DOT__fb_cnt0_mem__DOT__bankgen__BRA__0__KET____DOT__genblk1__DOT__reb_mem 
        = ((0x12U >= (IData)(vlSelf->opl3__DOT__channels__DOT__control_operators__DOT__state)) 
           & (IData)(vlSelf->opl3__DOT__channels__DOT__control_operators__DOT__op_sample_clk_en));
    vlSelf->opl3__DOT__channels__DOT__control_operators__DOT__fb_cnt0_mem__DOT__bankgen__BRA__1__KET____DOT__genblk1__DOT__reb_mem 
        = ((0x12U < (IData)(vlSelf->opl3__DOT__channels__DOT__control_operators__DOT__state)) 
           & (IData)(vlSelf->opl3__DOT__channels__DOT__control_operators__DOT__op_sample_clk_en));
    vlSelf->opl3__DOT__channels__DOT__control_operators__DOT__operator__DOT____Vcellout__feedback_mem__dob 
        = vlSelf->opl3__DOT__channels__DOT__control_operators__DOT__operator__DOT__feedback_mem__DOT__dob_array
        [(1U & (IData)(vlSelf->opl3__DOT__channels__DOT__control_operators__DOT__operator__DOT__feedback_mem__DOT__bankb_p))];
    opl3__DOT__channels__DOT__control_operators__DOT__cnt1_p1 
        = vlSelf->opl3__DOT__channels__DOT__control_operators__DOT__fb_cnt1_mem__DOT__dob_array
        [(1U & (IData)(vlSelf->opl3__DOT__channels__DOT__control_operators__DOT__fb_cnt1_mem__DOT__bankb_p))];
    vlSelf->opl3__DOT__channels__DOT__control_operators__DOT__operator__DOT__phase_generator__DOT__phase_acc_p2 
        = vlSelf->opl3__DOT__channels__DOT__control_operators__DOT__operator__DOT__phase_generator__DOT__phase_acc_mem__DOT__dob_array
        [(1U & ((IData)(vlSelf->opl3__DOT__channels__DOT__control_operators__DOT__operator__DOT__phase_generator__DOT__phase_acc_mem__DOT__bankb_p) 
                >> 1U))];
    opl3__DOT__channels__DOT__control_operators__DOT____Vcellout__fb_cnt0_mem__dob 
        = vlSelf->opl3__DOT__channels__DOT__control_operators__DOT__fb_cnt0_mem__DOT__dob_array
        [(1U & (IData)(vlSelf->opl3__DOT__channels__DOT__control_operators__DOT__fb_cnt0_mem__DOT__bankb_p))];
    vlSelf->opl3__DOT__channels__DOT__operator_mem_out 
        = vlSelf->opl3__DOT__channels__DOT__operator_out_mem__DOT__dob_array
        [(1U & (IData)(vlSelf->opl3__DOT__channels__DOT__operator_out_mem__DOT__bankb_p))];
    vlSelf->opl3__DOT__channels__DOT__control_operators__DOT__operator__DOT__op_type_p0 = 0U;
    if ((0x11U >= (IData)(vlSelf->opl3__DOT__channels__DOT__control_operators__DOT__op_num))) {
        vlSelf->opl3__DOT__channels__DOT__control_operators__DOT__operator__DOT__envelope_generator__DOT__env_int_mem__DOT__dob_array[0U] 
            = vlSelf->opl3__DOT__channels__DOT__control_operators__DOT__operator__DOT__envelope_generator__DOT__env_int_mem__DOT__bankgen__BRA__0__KET____DOT__genblk1__DOT__mem_bank__DOT__ram
            [vlSelf->opl3__DOT__channels__DOT__control_operators__DOT__op_num];
        vlSelf->opl3__DOT__channels__DOT__control_operators__DOT__operator__DOT__envelope_generator__DOT__env_int_mem__DOT__dob_array[1U] 
            = vlSelf->opl3__DOT__channels__DOT__control_operators__DOT__operator__DOT__envelope_generator__DOT__env_int_mem__DOT__bankgen__BRA__1__KET____DOT__genblk1__DOT__mem_bank__DOT__ram
            [vlSelf->opl3__DOT__channels__DOT__control_operators__DOT__op_num];
        vlSelf->opl3__DOT__channels__DOT__control_operators__DOT__operator__DOT__envelope_generator__DOT__state_mem__DOT__dob_array[0U] 
            = vlSelf->opl3__DOT__channels__DOT__control_operators__DOT__operator__DOT__envelope_generator__DOT__state_mem__DOT__bankgen__BRA__0__KET____DOT__genblk1__DOT__mem_bank__DOT__ram
            [vlSelf->opl3__DOT__channels__DOT__control_operators__DOT__op_num];
        vlSelf->opl3__DOT__channels__DOT__control_operators__DOT__operator__DOT__envelope_generator__DOT__state_mem__DOT__dob_array[1U] 
            = vlSelf->opl3__DOT__channels__DOT__control_operators__DOT__operator__DOT__envelope_generator__DOT__state_mem__DOT__bankgen__BRA__1__KET____DOT__genblk1__DOT__mem_bank__DOT__ram
            [vlSelf->opl3__DOT__channels__DOT__control_operators__DOT__op_num];
    } else {
        vlSelf->opl3__DOT__channels__DOT__control_operators__DOT__operator__DOT__envelope_generator__DOT__env_int_mem__DOT__dob_array[0U] = 0U;
        vlSelf->opl3__DOT__channels__DOT__control_operators__DOT__operator__DOT__envelope_generator__DOT__env_int_mem__DOT__dob_array[1U] = 0U;
        vlSelf->opl3__DOT__channels__DOT__control_operators__DOT__operator__DOT__envelope_generator__DOT__state_mem__DOT__dob_array[0U] = 0U;
        vlSelf->opl3__DOT__channels__DOT__control_operators__DOT__operator__DOT__envelope_generator__DOT__state_mem__DOT__dob_array[1U] = 0U;
    }
    opl3__DOT__channels__DOT__control_operators__DOT__operator_mem_rd_address 
        = (0x1fU & ((6U > (IData)(vlSelf->opl3__DOT__channels__DOT__control_operators__DOT__op_num))
                     ? (IData)(vlSelf->opl3__DOT__channels__DOT__control_operators__DOT__op_num)
                     : ((0xcU > (IData)(vlSelf->opl3__DOT__channels__DOT__control_operators__DOT__op_num))
                         ? ((IData)(2U) + (IData)(vlSelf->opl3__DOT__channels__DOT__control_operators__DOT__op_num))
                         : ((IData)(4U) + (IData)(vlSelf->opl3__DOT__channels__DOT__control_operators__DOT__op_num)))));
    __Vtableidx1 = (((IData)(vlSelf->opl3__DOT__channels__DOT__connection_sel) 
                     << 6U) | (((0x12U < (IData)(vlSelf->opl3__DOT__channels__DOT__control_operators__DOT__state)) 
                                << 5U) | (IData)(vlSelf->opl3__DOT__channels__DOT__control_operators__DOT__op_num)));
    vlSelf->opl3__DOT__channels__DOT__control_operators__DOT__cnt1_channel_mem_rd_address 
        = Vopl3__ConstPool__TABLE_h38f42766_0[__Vtableidx1];
    if ((2U & Vopl3__ConstPool__TABLE_h0637a799_0[__Vtableidx1])) {
        vlSelf->opl3__DOT__channels__DOT__control_operators__DOT__kon_block_fnum_channel_mem_rd_address 
            = Vopl3__ConstPool__TABLE_hc80edecc_0[__Vtableidx1];
    }
    if ((4U & Vopl3__ConstPool__TABLE_h0637a799_0[__Vtableidx1])) {
        vlSelf->opl3__DOT__channels__DOT__control_operators__DOT__fb_cnt0_channel_mem_rd_address 
            = Vopl3__ConstPool__TABLE_h6daf335f_0[__Vtableidx1];
    }
    vlSelf->opl3__DOT__channels__DOT__control_operators__DOT__operator__DOT__phase_generator__DOT__calc_rhythm_phase__DOT__hh_phase_p2 
        = (0x3ffU & ((2U == (7U & ((IData)(vlSelf->opl3__DOT__channels__DOT__control_operators__DOT__operator__DOT__phase_generator__DOT__calc_rhythm_phase__DOT__op_type_p) 
                                   >> 3U))) ? (vlSelf->opl3__DOT__channels__DOT__control_operators__DOT__operator__DOT__phase_generator__DOT__phase_acc_p2 
                                               >> 9U)
                      : (IData)(vlSelf->opl3__DOT__channels__DOT__control_operators__DOT__operator__DOT__phase_generator__DOT__calc_rhythm_phase__DOT__hh_phase_friend)));
    opl3__DOT__channels__DOT__control_operators__DOT__operator__DOT__phase_generator__DOT__calc_rhythm_phase__DOT__tc_phase_p2 
        = (0x3ffU & ((5U == (7U & ((IData)(vlSelf->opl3__DOT__channels__DOT__control_operators__DOT__operator__DOT__phase_generator__DOT__calc_rhythm_phase__DOT__op_type_p) 
                                   >> 3U))) ? (vlSelf->opl3__DOT__channels__DOT__control_operators__DOT__operator__DOT__phase_generator__DOT__phase_acc_p2 
                                               >> 9U)
                      : (IData)(vlSelf->opl3__DOT__channels__DOT__control_operators__DOT__operator__DOT__phase_generator__DOT__calc_rhythm_phase__DOT__tc_phase_friend)));
    vlSelf->opl3__DOT__channels__DOT__control_operators__DOT__operator__DOT__phase_generator__DOT__calc_rhythm_phase__DOT__rm_xor_p2 
        = (1U & (((((IData)(vlSelf->opl3__DOT__channels__DOT__control_operators__DOT__operator__DOT__phase_generator__DOT__calc_rhythm_phase__DOT__hh_phase_p2) 
                    >> 2U) ^ ((IData)(vlSelf->opl3__DOT__channels__DOT__control_operators__DOT__operator__DOT__phase_generator__DOT__calc_rhythm_phase__DOT__hh_phase_p2) 
                              >> 7U)) | (((IData)(vlSelf->opl3__DOT__channels__DOT__control_operators__DOT__operator__DOT__phase_generator__DOT__calc_rhythm_phase__DOT__hh_phase_p2) 
                                          >> 3U) ^ 
                                         ((IData)(opl3__DOT__channels__DOT__control_operators__DOT__operator__DOT__phase_generator__DOT__calc_rhythm_phase__DOT__tc_phase_p2) 
                                          >> 5U))) 
                 | (((IData)(opl3__DOT__channels__DOT__control_operators__DOT__operator__DOT__phase_generator__DOT__calc_rhythm_phase__DOT__tc_phase_p2) 
                     >> 3U) ^ ((IData)(opl3__DOT__channels__DOT__control_operators__DOT__operator__DOT__phase_generator__DOT__calc_rhythm_phase__DOT__tc_phase_p2) 
                               >> 5U))));
    opl3__DOT__channels__DOT__control_operators__DOT__operator__DOT__feedback_result_tmp_p1 
        = ((0U == (7U & ((IData)(opl3__DOT__channels__DOT__control_operators__DOT____Vcellout__fb_cnt0_mem__dob) 
                         >> 1U))) ? 0U : (0x3fffffU 
                                          & ((VL_EXTENDS_II(32,13, 
                                                            (0x1fffU 
                                                             & vlSelf->opl3__DOT__channels__DOT__control_operators__DOT__operator__DOT____Vcellout__feedback_mem__dob)) 
                                              + VL_EXTENDS_II(32,13, 
                                                              (0x1fffU 
                                                               & (vlSelf->opl3__DOT__channels__DOT__control_operators__DOT__operator__DOT____Vcellout__feedback_mem__dob 
                                                                  >> 0xdU)))) 
                                             << (7U 
                                                 & ((IData)(opl3__DOT__channels__DOT__control_operators__DOT____Vcellout__fb_cnt0_mem__dob) 
                                                    >> 1U)))));
    vlSelf->opl3__DOT__channels__DOT__control_operators__DOT__operator__DOT__feedback_result_p1 
        = (0x1fffU & VL_SHIFTRS_III(22,22,32, opl3__DOT__channels__DOT__control_operators__DOT__operator__DOT__feedback_result_tmp_p1, 9U));
    if ((((((((((((((0U == (IData)(vlSelf->opl3__DOT__channels__DOT__control_operators__DOT__op_num_p1)) 
                    || (1U == (IData)(vlSelf->opl3__DOT__channels__DOT__control_operators__DOT__op_num_p1))) 
                   || (2U == (IData)(vlSelf->opl3__DOT__channels__DOT__control_operators__DOT__op_num_p1))) 
                  || (0xcU == (IData)(vlSelf->opl3__DOT__channels__DOT__control_operators__DOT__op_num_p1))) 
                 || (0xdU == (IData)(vlSelf->opl3__DOT__channels__DOT__control_operators__DOT__op_num_p1))) 
                || (0xeU == (IData)(vlSelf->opl3__DOT__channels__DOT__control_operators__DOT__op_num_p1))) 
               | ((((3U == (IData)(vlSelf->opl3__DOT__channels__DOT__control_operators__DOT__op_num_p1)) 
                    || (4U == (IData)(vlSelf->opl3__DOT__channels__DOT__control_operators__DOT__op_num_p1))) 
                   || (5U == (IData)(vlSelf->opl3__DOT__channels__DOT__control_operators__DOT__op_num_p1))) 
                  || (0xfU == (IData)(vlSelf->opl3__DOT__channels__DOT__control_operators__DOT__op_num_p1)))) 
              | (6U == (IData)(vlSelf->opl3__DOT__channels__DOT__control_operators__DOT__op_num_p1))) 
             | (7U == (IData)(vlSelf->opl3__DOT__channels__DOT__control_operators__DOT__op_num_p1))) 
            | (8U == (IData)(vlSelf->opl3__DOT__channels__DOT__control_operators__DOT__op_num_p1))) 
           | (9U == (IData)(vlSelf->opl3__DOT__channels__DOT__control_operators__DOT__op_num_p1))) 
          | (0xaU == (IData)(vlSelf->opl3__DOT__channels__DOT__control_operators__DOT__op_num_p1))) 
         | (0xbU == (IData)(vlSelf->opl3__DOT__channels__DOT__control_operators__DOT__op_num_p1)))) {
        if (((((((0U == (IData)(vlSelf->opl3__DOT__channels__DOT__control_operators__DOT__op_num_p1)) 
                 || (1U == (IData)(vlSelf->opl3__DOT__channels__DOT__control_operators__DOT__op_num_p1))) 
                || (2U == (IData)(vlSelf->opl3__DOT__channels__DOT__control_operators__DOT__op_num_p1))) 
               || (0xcU == (IData)(vlSelf->opl3__DOT__channels__DOT__control_operators__DOT__op_num_p1))) 
              || (0xdU == (IData)(vlSelf->opl3__DOT__channels__DOT__control_operators__DOT__op_num_p1))) 
             || (0xeU == (IData)(vlSelf->opl3__DOT__channels__DOT__control_operators__DOT__op_num_p1)))) {
            vlSelf->opl3__DOT__channels__DOT__control_operators__DOT__modulation_p1 = 0U;
        } else if (((((3U == (IData)(vlSelf->opl3__DOT__channels__DOT__control_operators__DOT__op_num_p1)) 
                      || (4U == (IData)(vlSelf->opl3__DOT__channels__DOT__control_operators__DOT__op_num_p1))) 
                     || (5U == (IData)(vlSelf->opl3__DOT__channels__DOT__control_operators__DOT__op_num_p1))) 
                    || (0xfU == (IData)(vlSelf->opl3__DOT__channels__DOT__control_operators__DOT__op_num_p1)))) {
            vlSelf->opl3__DOT__channels__DOT__control_operators__DOT__modulation_p1 
                = ((1U & (IData)(opl3__DOT__channels__DOT__control_operators__DOT____Vcellout__fb_cnt0_mem__dob))
                    ? 0U : (0x1fffU & VL_EXTENDS_II(32,13, (IData)(vlSelf->opl3__DOT__channels__DOT__control_operators__DOT__modulation_out_p1))));
        } else if ((6U == (IData)(vlSelf->opl3__DOT__channels__DOT__control_operators__DOT__op_num_p1))) {
            if ((1U & (((~ (IData)(vlSelf->opl3__DOT__channels__DOT__control_operators__DOT__bank_num_p1)) 
                        & (IData)(vlSelf->opl3__DOT__channels__DOT__control_operators__DOT__connection_sel_p1)) 
                       | ((IData)(vlSelf->opl3__DOT__channels__DOT__control_operators__DOT__bank_num_p1) 
                          & ((IData)(vlSelf->opl3__DOT__channels__DOT__control_operators__DOT__connection_sel_p1) 
                             >> 3U))))) {
                if ((((0U == ((2U & ((IData)(opl3__DOT__channels__DOT__control_operators__DOT____Vcellout__fb_cnt0_mem__dob) 
                                     << 1U)) | (IData)(opl3__DOT__channels__DOT__control_operators__DOT__cnt1_p1))) 
                      || (2U == ((2U & ((IData)(opl3__DOT__channels__DOT__control_operators__DOT____Vcellout__fb_cnt0_mem__dob) 
                                        << 1U)) | (IData)(opl3__DOT__channels__DOT__control_operators__DOT__cnt1_p1)))) 
                     || (3U == ((2U & ((IData)(opl3__DOT__channels__DOT__control_operators__DOT____Vcellout__fb_cnt0_mem__dob) 
                                       << 1U)) | (IData)(opl3__DOT__channels__DOT__control_operators__DOT__cnt1_p1))))) {
                    vlSelf->opl3__DOT__channels__DOT__control_operators__DOT__modulation_p1 
                        = vlSelf->opl3__DOT__channels__DOT__control_operators__DOT__modulation_out_p1;
                } else if ((1U == ((2U & ((IData)(opl3__DOT__channels__DOT__control_operators__DOT____Vcellout__fb_cnt0_mem__dob) 
                                          << 1U)) | (IData)(opl3__DOT__channels__DOT__control_operators__DOT__cnt1_p1)))) {
                    vlSelf->opl3__DOT__channels__DOT__control_operators__DOT__modulation_p1 = 0U;
                }
            } else {
                vlSelf->opl3__DOT__channels__DOT__control_operators__DOT__modulation_p1 = 0U;
            }
        } else if ((7U == (IData)(vlSelf->opl3__DOT__channels__DOT__control_operators__DOT__op_num_p1))) {
            if ((1U & (((~ (IData)(vlSelf->opl3__DOT__channels__DOT__control_operators__DOT__bank_num_p1)) 
                        & ((IData)(vlSelf->opl3__DOT__channels__DOT__control_operators__DOT__connection_sel_p1) 
                           >> 1U)) | ((IData)(vlSelf->opl3__DOT__channels__DOT__control_operators__DOT__bank_num_p1) 
                                      & ((IData)(vlSelf->opl3__DOT__channels__DOT__control_operators__DOT__connection_sel_p1) 
                                         >> 4U))))) {
                if ((((0U == ((2U & ((IData)(opl3__DOT__channels__DOT__control_operators__DOT____Vcellout__fb_cnt0_mem__dob) 
                                     << 1U)) | (IData)(opl3__DOT__channels__DOT__control_operators__DOT__cnt1_p1))) 
                      || (2U == ((2U & ((IData)(opl3__DOT__channels__DOT__control_operators__DOT____Vcellout__fb_cnt0_mem__dob) 
                                        << 1U)) | (IData)(opl3__DOT__channels__DOT__control_operators__DOT__cnt1_p1)))) 
                     || (3U == ((2U & ((IData)(opl3__DOT__channels__DOT__control_operators__DOT____Vcellout__fb_cnt0_mem__dob) 
                                       << 1U)) | (IData)(opl3__DOT__channels__DOT__control_operators__DOT__cnt1_p1))))) {
                    vlSelf->opl3__DOT__channels__DOT__control_operators__DOT__modulation_p1 
                        = vlSelf->opl3__DOT__channels__DOT__control_operators__DOT__modulation_out_p1;
                } else if ((1U == ((2U & ((IData)(opl3__DOT__channels__DOT__control_operators__DOT____Vcellout__fb_cnt0_mem__dob) 
                                          << 1U)) | (IData)(opl3__DOT__channels__DOT__control_operators__DOT__cnt1_p1)))) {
                    vlSelf->opl3__DOT__channels__DOT__control_operators__DOT__modulation_p1 = 0U;
                }
            } else {
                vlSelf->opl3__DOT__channels__DOT__control_operators__DOT__modulation_p1 = 0U;
            }
        } else if ((8U == (IData)(vlSelf->opl3__DOT__channels__DOT__control_operators__DOT__op_num_p1))) {
            if ((1U & (((~ (IData)(vlSelf->opl3__DOT__channels__DOT__control_operators__DOT__bank_num_p1)) 
                        & ((IData)(vlSelf->opl3__DOT__channels__DOT__control_operators__DOT__connection_sel_p1) 
                           >> 2U)) | ((IData)(vlSelf->opl3__DOT__channels__DOT__control_operators__DOT__bank_num_p1) 
                                      & ((IData)(vlSelf->opl3__DOT__channels__DOT__control_operators__DOT__connection_sel_p1) 
                                         >> 5U))))) {
                if ((((0U == ((2U & ((IData)(opl3__DOT__channels__DOT__control_operators__DOT____Vcellout__fb_cnt0_mem__dob) 
                                     << 1U)) | (IData)(opl3__DOT__channels__DOT__control_operators__DOT__cnt1_p1))) 
                      || (2U == ((2U & ((IData)(opl3__DOT__channels__DOT__control_operators__DOT____Vcellout__fb_cnt0_mem__dob) 
                                        << 1U)) | (IData)(opl3__DOT__channels__DOT__control_operators__DOT__cnt1_p1)))) 
                     || (3U == ((2U & ((IData)(opl3__DOT__channels__DOT__control_operators__DOT____Vcellout__fb_cnt0_mem__dob) 
                                       << 1U)) | (IData)(opl3__DOT__channels__DOT__control_operators__DOT__cnt1_p1))))) {
                    vlSelf->opl3__DOT__channels__DOT__control_operators__DOT__modulation_p1 
                        = vlSelf->opl3__DOT__channels__DOT__control_operators__DOT__modulation_out_p1;
                } else if ((1U == ((2U & ((IData)(opl3__DOT__channels__DOT__control_operators__DOT____Vcellout__fb_cnt0_mem__dob) 
                                          << 1U)) | (IData)(opl3__DOT__channels__DOT__control_operators__DOT__cnt1_p1)))) {
                    vlSelf->opl3__DOT__channels__DOT__control_operators__DOT__modulation_p1 = 0U;
                }
            } else {
                vlSelf->opl3__DOT__channels__DOT__control_operators__DOT__modulation_p1 = 0U;
            }
        } else if ((9U == (IData)(vlSelf->opl3__DOT__channels__DOT__control_operators__DOT__op_num_p1))) {
            if ((1U & (((~ (IData)(vlSelf->opl3__DOT__channels__DOT__control_operators__DOT__bank_num_p1)) 
                        & (IData)(vlSelf->opl3__DOT__channels__DOT__control_operators__DOT__connection_sel_p1)) 
                       | ((IData)(vlSelf->opl3__DOT__channels__DOT__control_operators__DOT__bank_num_p1) 
                          & ((IData)(vlSelf->opl3__DOT__channels__DOT__control_operators__DOT__connection_sel_p1) 
                             >> 3U))))) {
                if ((((0U == ((2U & ((IData)(opl3__DOT__channels__DOT__control_operators__DOT____Vcellout__fb_cnt0_mem__dob) 
                                     << 1U)) | (IData)(opl3__DOT__channels__DOT__control_operators__DOT__cnt1_p1))) 
                      || (1U == ((2U & ((IData)(opl3__DOT__channels__DOT__control_operators__DOT____Vcellout__fb_cnt0_mem__dob) 
                                        << 1U)) | (IData)(opl3__DOT__channels__DOT__control_operators__DOT__cnt1_p1)))) 
                     || (2U == ((2U & ((IData)(opl3__DOT__channels__DOT__control_operators__DOT____Vcellout__fb_cnt0_mem__dob) 
                                       << 1U)) | (IData)(opl3__DOT__channels__DOT__control_operators__DOT__cnt1_p1))))) {
                    vlSelf->opl3__DOT__channels__DOT__control_operators__DOT__modulation_p1 
                        = vlSelf->opl3__DOT__channels__DOT__control_operators__DOT__modulation_out_p1;
                } else if ((3U == ((2U & ((IData)(opl3__DOT__channels__DOT__control_operators__DOT____Vcellout__fb_cnt0_mem__dob) 
                                          << 1U)) | (IData)(opl3__DOT__channels__DOT__control_operators__DOT__cnt1_p1)))) {
                    vlSelf->opl3__DOT__channels__DOT__control_operators__DOT__modulation_p1 = 0U;
                }
            } else {
                vlSelf->opl3__DOT__channels__DOT__control_operators__DOT__modulation_p1 
                    = ((1U & (IData)(opl3__DOT__channels__DOT__control_operators__DOT____Vcellout__fb_cnt0_mem__dob))
                        ? 0U : (0x1fffU & VL_EXTENDS_II(32,13, (IData)(vlSelf->opl3__DOT__channels__DOT__control_operators__DOT__modulation_out_p1))));
            }
        } else if ((0xaU == (IData)(vlSelf->opl3__DOT__channels__DOT__control_operators__DOT__op_num_p1))) {
            if ((1U & (((~ (IData)(vlSelf->opl3__DOT__channels__DOT__control_operators__DOT__bank_num_p1)) 
                        & ((IData)(vlSelf->opl3__DOT__channels__DOT__control_operators__DOT__connection_sel_p1) 
                           >> 1U)) | ((IData)(vlSelf->opl3__DOT__channels__DOT__control_operators__DOT__bank_num_p1) 
                                      & ((IData)(vlSelf->opl3__DOT__channels__DOT__control_operators__DOT__connection_sel_p1) 
                                         >> 4U))))) {
                if ((((0U == ((2U & ((IData)(opl3__DOT__channels__DOT__control_operators__DOT____Vcellout__fb_cnt0_mem__dob) 
                                     << 1U)) | (IData)(opl3__DOT__channels__DOT__control_operators__DOT__cnt1_p1))) 
                      || (1U == ((2U & ((IData)(opl3__DOT__channels__DOT__control_operators__DOT____Vcellout__fb_cnt0_mem__dob) 
                                        << 1U)) | (IData)(opl3__DOT__channels__DOT__control_operators__DOT__cnt1_p1)))) 
                     || (2U == ((2U & ((IData)(opl3__DOT__channels__DOT__control_operators__DOT____Vcellout__fb_cnt0_mem__dob) 
                                       << 1U)) | (IData)(opl3__DOT__channels__DOT__control_operators__DOT__cnt1_p1))))) {
                    vlSelf->opl3__DOT__channels__DOT__control_operators__DOT__modulation_p1 
                        = vlSelf->opl3__DOT__channels__DOT__control_operators__DOT__modulation_out_p1;
                } else if ((3U == ((2U & ((IData)(opl3__DOT__channels__DOT__control_operators__DOT____Vcellout__fb_cnt0_mem__dob) 
                                          << 1U)) | (IData)(opl3__DOT__channels__DOT__control_operators__DOT__cnt1_p1)))) {
                    vlSelf->opl3__DOT__channels__DOT__control_operators__DOT__modulation_p1 = 0U;
                }
            } else {
                vlSelf->opl3__DOT__channels__DOT__control_operators__DOT__modulation_p1 
                    = ((1U & (IData)(opl3__DOT__channels__DOT__control_operators__DOT____Vcellout__fb_cnt0_mem__dob))
                        ? 0U : (0x1fffU & VL_EXTENDS_II(32,13, (IData)(vlSelf->opl3__DOT__channels__DOT__control_operators__DOT__modulation_out_p1))));
            }
        } else if ((1U & (((~ (IData)(vlSelf->opl3__DOT__channels__DOT__control_operators__DOT__bank_num_p1)) 
                           & ((IData)(vlSelf->opl3__DOT__channels__DOT__control_operators__DOT__connection_sel_p1) 
                              >> 2U)) | ((IData)(vlSelf->opl3__DOT__channels__DOT__control_operators__DOT__bank_num_p1) 
                                         & ((IData)(vlSelf->opl3__DOT__channels__DOT__control_operators__DOT__connection_sel_p1) 
                                            >> 5U))))) {
            if ((((0U == ((2U & ((IData)(opl3__DOT__channels__DOT__control_operators__DOT____Vcellout__fb_cnt0_mem__dob) 
                                 << 1U)) | (IData)(opl3__DOT__channels__DOT__control_operators__DOT__cnt1_p1))) 
                  || (1U == ((2U & ((IData)(opl3__DOT__channels__DOT__control_operators__DOT____Vcellout__fb_cnt0_mem__dob) 
                                    << 1U)) | (IData)(opl3__DOT__channels__DOT__control_operators__DOT__cnt1_p1)))) 
                 || (2U == ((2U & ((IData)(opl3__DOT__channels__DOT__control_operators__DOT____Vcellout__fb_cnt0_mem__dob) 
                                   << 1U)) | (IData)(opl3__DOT__channels__DOT__control_operators__DOT__cnt1_p1))))) {
                vlSelf->opl3__DOT__channels__DOT__control_operators__DOT__modulation_p1 
                    = vlSelf->opl3__DOT__channels__DOT__control_operators__DOT__modulation_out_p1;
            } else if ((3U == ((2U & ((IData)(opl3__DOT__channels__DOT__control_operators__DOT____Vcellout__fb_cnt0_mem__dob) 
                                      << 1U)) | (IData)(opl3__DOT__channels__DOT__control_operators__DOT__cnt1_p1)))) {
                vlSelf->opl3__DOT__channels__DOT__control_operators__DOT__modulation_p1 = 0U;
            }
        } else {
            vlSelf->opl3__DOT__channels__DOT__control_operators__DOT__modulation_p1 
                = ((1U & (IData)(opl3__DOT__channels__DOT__control_operators__DOT____Vcellout__fb_cnt0_mem__dob))
                    ? 0U : (0x1fffU & VL_EXTENDS_II(32,13, (IData)(vlSelf->opl3__DOT__channels__DOT__control_operators__DOT__modulation_out_p1))));
        }
    } else if (((0x10U == (IData)(vlSelf->opl3__DOT__channels__DOT__control_operators__DOT__op_num_p1)) 
                || (0x11U == (IData)(vlSelf->opl3__DOT__channels__DOT__control_operators__DOT__op_num_p1)))) {
        vlSelf->opl3__DOT__channels__DOT__control_operators__DOT__modulation_p1 
            = ((1U & ((IData)(opl3__DOT__channels__DOT__control_operators__DOT____Vcellout__fb_cnt0_mem__dob) 
                      | ((IData)(vlSelf->opl3__DOT__channels__DOT__control_operators__DOT__ryt_p1) 
                         & (~ (IData)(vlSelf->opl3__DOT__channels__DOT__control_operators__DOT__bank_num_p1)))))
                ? 0U : (0x1fffU & VL_EXTENDS_II(32,13, (IData)(vlSelf->opl3__DOT__channels__DOT__control_operators__DOT__modulation_out_p1))));
    }
    vlSelf->opl3__DOT__channels__DOT__control_operators__DOT__operator__DOT__envelope_generator__DOT____Vcellout__state_mem__dob 
        = vlSelf->opl3__DOT__channels__DOT__control_operators__DOT__operator__DOT__envelope_generator__DOT__state_mem__DOT__dob_array
        [(0x12U < (IData)(vlSelf->opl3__DOT__channels__DOT__control_operators__DOT__state))];
    if ((0x15U >= (IData)(opl3__DOT__channels__DOT__control_operators__DOT__operator_mem_rd_address))) {
        vlSelf->opl3__DOT__channels__DOT__control_operators__DOT__ksl_tl_mem__DOT__dob_array[0U] 
            = vlSelf->opl3__DOT__channels__DOT__control_operators__DOT__ksl_tl_mem__DOT__bankgen__BRA__0__KET____DOT__genblk1__DOT__mem_bank__DOT__ram
            [opl3__DOT__channels__DOT__control_operators__DOT__operator_mem_rd_address];
        vlSelf->opl3__DOT__channels__DOT__control_operators__DOT__ksl_tl_mem__DOT__dob_array[1U] 
            = vlSelf->opl3__DOT__channels__DOT__control_operators__DOT__ksl_tl_mem__DOT__bankgen__BRA__1__KET____DOT__genblk1__DOT__mem_bank__DOT__ram
            [opl3__DOT__channels__DOT__control_operators__DOT__operator_mem_rd_address];
        vlSelf->opl3__DOT__channels__DOT__control_operators__DOT__ws_mem__DOT__dob_array[0U] 
            = vlSelf->opl3__DOT__channels__DOT__control_operators__DOT__ws_mem__DOT__bankgen__BRA__0__KET____DOT__genblk1__DOT__mem_bank__DOT__ram
            [opl3__DOT__channels__DOT__control_operators__DOT__operator_mem_rd_address];
        vlSelf->opl3__DOT__channels__DOT__control_operators__DOT__ws_mem__DOT__dob_array[1U] 
            = vlSelf->opl3__DOT__channels__DOT__control_operators__DOT__ws_mem__DOT__bankgen__BRA__1__KET____DOT__genblk1__DOT__mem_bank__DOT__ram
            [opl3__DOT__channels__DOT__control_operators__DOT__operator_mem_rd_address];
        vlSelf->opl3__DOT__channels__DOT__control_operators__DOT__ar_dr_mem__DOT__dob_array[0U] 
            = vlSelf->opl3__DOT__channels__DOT__control_operators__DOT__ar_dr_mem__DOT__bankgen__BRA__0__KET____DOT__genblk1__DOT__mem_bank__DOT__ram
            [opl3__DOT__channels__DOT__control_operators__DOT__operator_mem_rd_address];
        vlSelf->opl3__DOT__channels__DOT__control_operators__DOT__ar_dr_mem__DOT__dob_array[1U] 
            = vlSelf->opl3__DOT__channels__DOT__control_operators__DOT__ar_dr_mem__DOT__bankgen__BRA__1__KET____DOT__genblk1__DOT__mem_bank__DOT__ram
            [opl3__DOT__channels__DOT__control_operators__DOT__operator_mem_rd_address];
        vlSelf->opl3__DOT__channels__DOT__control_operators__DOT__sl_rr_mem__DOT__dob_array[0U] 
            = vlSelf->opl3__DOT__channels__DOT__control_operators__DOT__sl_rr_mem__DOT__bankgen__BRA__0__KET____DOT__genblk1__DOT__mem_bank__DOT__ram
            [opl3__DOT__channels__DOT__control_operators__DOT__operator_mem_rd_address];
        vlSelf->opl3__DOT__channels__DOT__control_operators__DOT__sl_rr_mem__DOT__dob_array[1U] 
            = vlSelf->opl3__DOT__channels__DOT__control_operators__DOT__sl_rr_mem__DOT__bankgen__BRA__1__KET____DOT__genblk1__DOT__mem_bank__DOT__ram
            [opl3__DOT__channels__DOT__control_operators__DOT__operator_mem_rd_address];
        vlSelf->opl3__DOT__channels__DOT__control_operators__DOT__am_vib_egt_ksr_mult_mem__DOT__dob_array[0U] 
            = vlSelf->opl3__DOT__channels__DOT__control_operators__DOT__am_vib_egt_ksr_mult_mem__DOT__bankgen__BRA__0__KET____DOT__genblk1__DOT__mem_bank__DOT__ram
            [opl3__DOT__channels__DOT__control_operators__DOT__operator_mem_rd_address];
        vlSelf->opl3__DOT__channels__DOT__control_operators__DOT__am_vib_egt_ksr_mult_mem__DOT__dob_array[1U] 
            = vlSelf->opl3__DOT__channels__DOT__control_operators__DOT__am_vib_egt_ksr_mult_mem__DOT__bankgen__BRA__1__KET____DOT__genblk1__DOT__mem_bank__DOT__ram
            [opl3__DOT__channels__DOT__control_operators__DOT__operator_mem_rd_address];
    } else {
        vlSelf->opl3__DOT__channels__DOT__control_operators__DOT__ksl_tl_mem__DOT__dob_array[0U] = 0U;
        vlSelf->opl3__DOT__channels__DOT__control_operators__DOT__ksl_tl_mem__DOT__dob_array[1U] = 0U;
        vlSelf->opl3__DOT__channels__DOT__control_operators__DOT__ws_mem__DOT__dob_array[0U] = 0U;
        vlSelf->opl3__DOT__channels__DOT__control_operators__DOT__ws_mem__DOT__dob_array[1U] = 0U;
        vlSelf->opl3__DOT__channels__DOT__control_operators__DOT__ar_dr_mem__DOT__dob_array[0U] = 0U;
        vlSelf->opl3__DOT__channels__DOT__control_operators__DOT__ar_dr_mem__DOT__dob_array[1U] = 0U;
        vlSelf->opl3__DOT__channels__DOT__control_operators__DOT__sl_rr_mem__DOT__dob_array[0U] = 0U;
        vlSelf->opl3__DOT__channels__DOT__control_operators__DOT__sl_rr_mem__DOT__dob_array[1U] = 0U;
        vlSelf->opl3__DOT__channels__DOT__control_operators__DOT__am_vib_egt_ksr_mult_mem__DOT__dob_array[0U] = 0U;
        vlSelf->opl3__DOT__channels__DOT__control_operators__DOT__am_vib_egt_ksr_mult_mem__DOT__dob_array[1U] = 0U;
    }
    if ((8U >= (IData)(vlSelf->opl3__DOT__channels__DOT__control_operators__DOT__kon_block_fnum_channel_mem_rd_address))) {
        vlSelf->opl3__DOT__channels__DOT__control_operators__DOT__fnum_low_mem__DOT__dob_array[0U] 
            = vlSelf->opl3__DOT__channels__DOT__control_operators__DOT__fnum_low_mem__DOT__bankgen__BRA__0__KET____DOT__genblk1__DOT__mem_bank__DOT__ram
            [vlSelf->opl3__DOT__channels__DOT__control_operators__DOT__kon_block_fnum_channel_mem_rd_address];
        vlSelf->opl3__DOT__channels__DOT__control_operators__DOT__fnum_low_mem__DOT__dob_array[1U] 
            = vlSelf->opl3__DOT__channels__DOT__control_operators__DOT__fnum_low_mem__DOT__bankgen__BRA__1__KET____DOT__genblk1__DOT__mem_bank__DOT__ram
            [vlSelf->opl3__DOT__channels__DOT__control_operators__DOT__kon_block_fnum_channel_mem_rd_address];
        vlSelf->opl3__DOT__channels__DOT__control_operators__DOT__block_fnum_high_mem__DOT__dob_array[0U] 
            = vlSelf->opl3__DOT__channels__DOT__control_operators__DOT__block_fnum_high_mem__DOT__bankgen__BRA__0__KET____DOT__genblk1__DOT__mem_bank__DOT__ram
            [vlSelf->opl3__DOT__channels__DOT__control_operators__DOT__kon_block_fnum_channel_mem_rd_address];
        vlSelf->opl3__DOT__channels__DOT__control_operators__DOT__block_fnum_high_mem__DOT__dob_array[1U] 
            = vlSelf->opl3__DOT__channels__DOT__control_operators__DOT__block_fnum_high_mem__DOT__bankgen__BRA__1__KET____DOT__genblk1__DOT__mem_bank__DOT__ram
            [vlSelf->opl3__DOT__channels__DOT__control_operators__DOT__kon_block_fnum_channel_mem_rd_address];
    } else {
        vlSelf->opl3__DOT__channels__DOT__control_operators__DOT__fnum_low_mem__DOT__dob_array[0U] = 0U;
        vlSelf->opl3__DOT__channels__DOT__control_operators__DOT__fnum_low_mem__DOT__dob_array[1U] = 0U;
        vlSelf->opl3__DOT__channels__DOT__control_operators__DOT__block_fnum_high_mem__DOT__dob_array[0U] = 0U;
        vlSelf->opl3__DOT__channels__DOT__control_operators__DOT__block_fnum_high_mem__DOT__dob_array[1U] = 0U;
    }
    vlSelf->opl3__DOT__channels__DOT__control_operators__DOT__kon_mem__DOT__dob_array[0U] 
        = ((8U >= (IData)(vlSelf->opl3__DOT__channels__DOT__control_operators__DOT__kon_block_fnum_channel_mem_rd_address)) 
           && vlSelf->opl3__DOT__channels__DOT__control_operators__DOT__kon_mem__DOT__bankgen__BRA__0__KET____DOT__genblk1__DOT__mem_bank__DOT__ram
           [vlSelf->opl3__DOT__channels__DOT__control_operators__DOT__kon_block_fnum_channel_mem_rd_address]);
    vlSelf->opl3__DOT__channels__DOT__control_operators__DOT__kon_mem__DOT__dob_array[1U] 
        = ((8U >= (IData)(vlSelf->opl3__DOT__channels__DOT__control_operators__DOT__kon_block_fnum_channel_mem_rd_address)) 
           && vlSelf->opl3__DOT__channels__DOT__control_operators__DOT__kon_mem__DOT__bankgen__BRA__1__KET____DOT__genblk1__DOT__mem_bank__DOT__ram
           [vlSelf->opl3__DOT__channels__DOT__control_operators__DOT__kon_block_fnum_channel_mem_rd_address]);
    vlSelf->opl3__DOT__channels__DOT__control_operators__DOT____Vcellout__ksl_tl_mem__dob 
        = vlSelf->opl3__DOT__channels__DOT__control_operators__DOT__ksl_tl_mem__DOT__dob_array
        [(0x12U < (IData)(vlSelf->opl3__DOT__channels__DOT__control_operators__DOT__state))];
    opl3__DOT__channels__DOT__control_operators__DOT__ws 
        = vlSelf->opl3__DOT__channels__DOT__control_operators__DOT__ws_mem__DOT__dob_array
        [(0x12U < (IData)(vlSelf->opl3__DOT__channels__DOT__control_operators__DOT__state))];
    opl3__DOT__channels__DOT__control_operators__DOT____Vcellout__ar_dr_mem__dob 
        = vlSelf->opl3__DOT__channels__DOT__control_operators__DOT__ar_dr_mem__DOT__dob_array
        [(0x12U < (IData)(vlSelf->opl3__DOT__channels__DOT__control_operators__DOT__state))];
    vlSelf->opl3__DOT__channels__DOT__control_operators__DOT____Vcellout__sl_rr_mem__dob 
        = vlSelf->opl3__DOT__channels__DOT__control_operators__DOT__sl_rr_mem__DOT__dob_array
        [(0x12U < (IData)(vlSelf->opl3__DOT__channels__DOT__control_operators__DOT__state))];
    vlSelf->opl3__DOT__channels__DOT__control_operators__DOT____Vcellout__am_vib_egt_ksr_mult_mem__dob 
        = vlSelf->opl3__DOT__channels__DOT__control_operators__DOT__am_vib_egt_ksr_mult_mem__DOT__dob_array
        [(0x12U < (IData)(vlSelf->opl3__DOT__channels__DOT__control_operators__DOT__state))];
    vlSelf->opl3__DOT__channels__DOT__control_operators__DOT____Vcellout__fnum_low_mem__dob 
        = vlSelf->opl3__DOT__channels__DOT__control_operators__DOT__fnum_low_mem__DOT__dob_array
        [(0x12U < (IData)(vlSelf->opl3__DOT__channels__DOT__control_operators__DOT__state))];
    vlSelf->opl3__DOT__channels__DOT__control_operators__DOT__operator__DOT__key_on_p0 
        = vlSelf->opl3__DOT__channels__DOT__control_operators__DOT__kon_mem__DOT__dob_array
        [(0x12U < (IData)(vlSelf->opl3__DOT__channels__DOT__control_operators__DOT__state))];
    if (((0x12U >= (IData)(vlSelf->opl3__DOT__channels__DOT__control_operators__DOT__state)) 
         & (IData)(vlSelf->opl3__DOT__channels__DOT__ryt))) {
        if (((0xcU == (IData)(vlSelf->opl3__DOT__channels__DOT__control_operators__DOT__op_num)) 
             || (0xfU == (IData)(vlSelf->opl3__DOT__channels__DOT__control_operators__DOT__op_num)))) {
            vlSelf->opl3__DOT__channels__DOT__control_operators__DOT__operator__DOT__op_type_p0 = 1U;
            vlSelf->opl3__DOT__channels__DOT__control_operators__DOT__operator__DOT__key_on_p0 
                = vlSelf->opl3__DOT__channels__DOT__control_operators__DOT__bd;
        } else if ((0xdU == (IData)(vlSelf->opl3__DOT__channels__DOT__control_operators__DOT__op_num))) {
            vlSelf->opl3__DOT__channels__DOT__control_operators__DOT__operator__DOT__op_type_p0 = 2U;
            vlSelf->opl3__DOT__channels__DOT__control_operators__DOT__operator__DOT__key_on_p0 
                = vlSelf->opl3__DOT__channels__DOT__control_operators__DOT__hh;
        } else if ((0xeU == (IData)(vlSelf->opl3__DOT__channels__DOT__control_operators__DOT__op_num))) {
            vlSelf->opl3__DOT__channels__DOT__control_operators__DOT__operator__DOT__op_type_p0 = 3U;
            vlSelf->opl3__DOT__channels__DOT__control_operators__DOT__operator__DOT__key_on_p0 
                = vlSelf->opl3__DOT__channels__DOT__control_operators__DOT__tom;
        } else if ((0x10U == (IData)(vlSelf->opl3__DOT__channels__DOT__control_operators__DOT__op_num))) {
            vlSelf->opl3__DOT__channels__DOT__control_operators__DOT__operator__DOT__op_type_p0 = 4U;
            vlSelf->opl3__DOT__channels__DOT__control_operators__DOT__operator__DOT__key_on_p0 
                = vlSelf->opl3__DOT__channels__DOT__control_operators__DOT__sd;
        } else if ((0x11U == (IData)(vlSelf->opl3__DOT__channels__DOT__control_operators__DOT__op_num))) {
            vlSelf->opl3__DOT__channels__DOT__control_operators__DOT__operator__DOT__op_type_p0 = 5U;
            vlSelf->opl3__DOT__channels__DOT__control_operators__DOT__operator__DOT__key_on_p0 
                = vlSelf->opl3__DOT__channels__DOT__control_operators__DOT__tc;
        }
    }
    vlSelf->opl3__DOT__channels__DOT__control_operators__DOT____Vcellout__block_fnum_high_mem__dob 
        = vlSelf->opl3__DOT__channels__DOT__control_operators__DOT__block_fnum_high_mem__DOT__dob_array
        [(0x12U < (IData)(vlSelf->opl3__DOT__channels__DOT__control_operators__DOT__state))];
    vlSelf->opl3__DOT__channels__DOT__control_operators__DOT__operator__DOT__phase_generator__DOT__ws_post_opl_p0 
        = opl3__DOT__channels__DOT__control_operators__DOT__ws;
    vlSelf->opl3__DOT__channels__DOT__control_operators__DOT__operator__DOT__phase_generator__DOT__ws_post_opl_p0 
        = ((3U & (IData)(vlSelf->opl3__DOT__channels__DOT__control_operators__DOT__operator__DOT__phase_generator__DOT__ws_post_opl_p0)) 
           | (0xfffffffcU & ((IData)(opl3__DOT__channels__DOT__control_operators__DOT__ws) 
                             & ((IData)(vlSelf->opl3__DOT__channels__DOT__is_new) 
                                << 2U))));
    vlSelf->opl3__DOT__channels__DOT__control_operators__DOT__operator__DOT__envelope_generator__DOT__eg_reset_p0 = 0U;
    if (((IData)(vlSelf->opl3__DOT__channels__DOT__control_operators__DOT__operator__DOT__key_on_p0) 
         & (8U == (IData)(vlSelf->opl3__DOT__channels__DOT__control_operators__DOT__operator__DOT__envelope_generator__DOT____Vcellout__state_mem__dob)))) {
        vlSelf->opl3__DOT__channels__DOT__control_operators__DOT__operator__DOT__envelope_generator__DOT__eg_reset_p0 = 1U;
        vlSelf->opl3__DOT__channels__DOT__control_operators__DOT__operator__DOT__envelope_generator__DOT__requested_rate_p0 
            = (0xfU & ((IData)(opl3__DOT__channels__DOT__control_operators__DOT____Vcellout__ar_dr_mem__dob) 
                       >> 4U));
    } else if ((1U == (IData)(vlSelf->opl3__DOT__channels__DOT__control_operators__DOT__operator__DOT__envelope_generator__DOT____Vcellout__state_mem__dob))) {
        vlSelf->opl3__DOT__channels__DOT__control_operators__DOT__operator__DOT__envelope_generator__DOT__requested_rate_p0 
            = (0xfU & ((IData)(opl3__DOT__channels__DOT__control_operators__DOT____Vcellout__ar_dr_mem__dob) 
                       >> 4U));
    } else if ((2U == (IData)(vlSelf->opl3__DOT__channels__DOT__control_operators__DOT__operator__DOT__envelope_generator__DOT____Vcellout__state_mem__dob))) {
        vlSelf->opl3__DOT__channels__DOT__control_operators__DOT__operator__DOT__envelope_generator__DOT__requested_rate_p0 
            = (0xfU & (IData)(opl3__DOT__channels__DOT__control_operators__DOT____Vcellout__ar_dr_mem__dob));
    } else if ((4U == (IData)(vlSelf->opl3__DOT__channels__DOT__control_operators__DOT__operator__DOT__envelope_generator__DOT____Vcellout__state_mem__dob))) {
        vlSelf->opl3__DOT__channels__DOT__control_operators__DOT__operator__DOT__envelope_generator__DOT__requested_rate_p0 
            = ((0x20U & (IData)(vlSelf->opl3__DOT__channels__DOT__control_operators__DOT____Vcellout__am_vib_egt_ksr_mult_mem__dob))
                ? 0U : (0xfU & (IData)(vlSelf->opl3__DOT__channels__DOT__control_operators__DOT____Vcellout__sl_rr_mem__dob)));
    } else if ((8U == (IData)(vlSelf->opl3__DOT__channels__DOT__control_operators__DOT__operator__DOT__envelope_generator__DOT____Vcellout__state_mem__dob))) {
        vlSelf->opl3__DOT__channels__DOT__control_operators__DOT__operator__DOT__envelope_generator__DOT__requested_rate_p0 
            = (0xfU & (IData)(vlSelf->opl3__DOT__channels__DOT__control_operators__DOT____Vcellout__sl_rr_mem__dob));
    }
    vlSelf->opl3__DOT__channels__DOT__control_operators__DOT__fnum 
        = ((0x300U & ((IData)(vlSelf->opl3__DOT__channels__DOT__control_operators__DOT____Vcellout__block_fnum_high_mem__dob) 
                      << 8U)) | (IData)(vlSelf->opl3__DOT__channels__DOT__control_operators__DOT____Vcellout__fnum_low_mem__dob));
    opl3__DOT__channels__DOT__control_operators__DOT__operator__DOT__envelope_generator__DOT__calc_envelope_shift__DOT__block_shifted 
        = (0xfU & VL_SHIFTL_III(4,4,32, (7U & ((IData)(vlSelf->opl3__DOT__channels__DOT__control_operators__DOT____Vcellout__block_fnum_high_mem__dob) 
                                               >> 2U)), 1U));
    opl3__DOT__channels__DOT__control_operators__DOT__operator__DOT__envelope_generator__DOT__calc_envelope_shift__DOT__ksv_p0 
        = ((IData)(opl3__DOT__channels__DOT__control_operators__DOT__operator__DOT__envelope_generator__DOT__calc_envelope_shift__DOT__block_shifted) 
           | ((IData)(vlSelf->opl3__DOT__channels__DOT__control_operators__DOT__nts)
               ? (1U & ((IData)(vlSelf->opl3__DOT__channels__DOT__control_operators__DOT__fnum) 
                        >> 8U)) : (1U & ((IData)(vlSelf->opl3__DOT__channels__DOT__control_operators__DOT__fnum) 
                                         >> 9U))));
    vlSelf->opl3__DOT__channels__DOT__control_operators__DOT__operator__DOT__envelope_generator__DOT__calc_envelope_shift__DOT__ks_p0 
        = (0xfU & ((0x10U & (IData)(vlSelf->opl3__DOT__channels__DOT__control_operators__DOT____Vcellout__am_vib_egt_ksr_mult_mem__dob))
                    ? (IData)(opl3__DOT__channels__DOT__control_operators__DOT__operator__DOT__envelope_generator__DOT__calc_envelope_shift__DOT__ksv_p0)
                    : VL_SHIFTR_III(4,4,32, (IData)(opl3__DOT__channels__DOT__control_operators__DOT__operator__DOT__envelope_generator__DOT__calc_envelope_shift__DOT__ksv_p0), 2U)));
}

void Vopl3___024root___act_sequent__TOP__0(Vopl3___024root* vlSelf);

VL_ATTR_COLD void Vopl3___024root___eval_stl(Vopl3___024root* vlSelf) {
    if (false && vlSelf) {}  // Prevent unused
    Vopl3__Syms* const __restrict vlSymsp VL_ATTR_UNUSED = vlSelf->vlSymsp;
    VL_DEBUG_IF(VL_DBG_MSGF("+    Vopl3___024root___eval_stl\n"); );
    // Body
    if ((1ULL & vlSelf->__VstlTriggered.word(0U))) {
        Vopl3___024root___stl_sequent__TOP__0(vlSelf);
    }
    if ((3ULL & vlSelf->__VstlTriggered.word(0U))) {
        Vopl3___024root___act_sequent__TOP__0(vlSelf);
    }
}

VL_ATTR_COLD void Vopl3___024root___eval_triggers__stl(Vopl3___024root* vlSelf);

VL_ATTR_COLD bool Vopl3___024root___eval_phase__stl(Vopl3___024root* vlSelf) {
    if (false && vlSelf) {}  // Prevent unused
    Vopl3__Syms* const __restrict vlSymsp VL_ATTR_UNUSED = vlSelf->vlSymsp;
    VL_DEBUG_IF(VL_DBG_MSGF("+    Vopl3___024root___eval_phase__stl\n"); );
    // Init
    CData/*0:0*/ __VstlExecute;
    // Body
    Vopl3___024root___eval_triggers__stl(vlSelf);
    __VstlExecute = vlSelf->__VstlTriggered.any();
    if (__VstlExecute) {
        Vopl3___024root___eval_stl(vlSelf);
    }
    return (__VstlExecute);
}

#ifdef VL_DEBUG
VL_ATTR_COLD void Vopl3___024root___dump_triggers__act(Vopl3___024root* vlSelf) {
    if (false && vlSelf) {}  // Prevent unused
    Vopl3__Syms* const __restrict vlSymsp VL_ATTR_UNUSED = vlSelf->vlSymsp;
    VL_DEBUG_IF(VL_DBG_MSGF("+    Vopl3___024root___dump_triggers__act\n"); );
    // Body
    if ((1U & (~ (IData)(vlSelf->__VactTriggered.any())))) {
        VL_DBG_MSGF("         No triggers active\n");
    }
    if ((1ULL & vlSelf->__VactTriggered.word(0U))) {
        VL_DBG_MSGF("         'act' region trigger index 0 is active: @([hybrid] opl3.channels.__Vcellout__ch_abcd_cnt_mem__dob)\n");
    }
    if ((2ULL & vlSelf->__VactTriggered.word(0U))) {
        VL_DBG_MSGF("         'act' region trigger index 1 is active: @(posedge clk or negedge ic_n)\n");
    }
    if ((4ULL & vlSelf->__VactTriggered.word(0U))) {
        VL_DBG_MSGF("         'act' region trigger index 2 is active: @(posedge clk_host)\n");
    }
    if ((8ULL & vlSelf->__VactTriggered.word(0U))) {
        VL_DBG_MSGF("         'act' region trigger index 3 is active: @(posedge clk)\n");
    }
    if ((0x10ULL & vlSelf->__VactTriggered.word(0U))) {
        VL_DBG_MSGF("         'act' region trigger index 4 is active: @(posedge clk_host or negedge ic_n)\n");
    }
    if ((0x20ULL & vlSelf->__VactTriggered.word(0U))) {
        VL_DBG_MSGF("         'act' region trigger index 5 is active: @(posedge clk or negedge opl3.host_if.__Vcellinp__afifo__i_rd_reset_n)\n");
    }
}
#endif  // VL_DEBUG

#ifdef VL_DEBUG
VL_ATTR_COLD void Vopl3___024root___dump_triggers__nba(Vopl3___024root* vlSelf) {
    if (false && vlSelf) {}  // Prevent unused
    Vopl3__Syms* const __restrict vlSymsp VL_ATTR_UNUSED = vlSelf->vlSymsp;
    VL_DEBUG_IF(VL_DBG_MSGF("+    Vopl3___024root___dump_triggers__nba\n"); );
    // Body
    if ((1U & (~ (IData)(vlSelf->__VnbaTriggered.any())))) {
        VL_DBG_MSGF("         No triggers active\n");
    }
    if ((1ULL & vlSelf->__VnbaTriggered.word(0U))) {
        VL_DBG_MSGF("         'nba' region trigger index 0 is active: @([hybrid] opl3.channels.__Vcellout__ch_abcd_cnt_mem__dob)\n");
    }
    if ((2ULL & vlSelf->__VnbaTriggered.word(0U))) {
        VL_DBG_MSGF("         'nba' region trigger index 1 is active: @(posedge clk or negedge ic_n)\n");
    }
    if ((4ULL & vlSelf->__VnbaTriggered.word(0U))) {
        VL_DBG_MSGF("         'nba' region trigger index 2 is active: @(posedge clk_host)\n");
    }
    if ((8ULL & vlSelf->__VnbaTriggered.word(0U))) {
        VL_DBG_MSGF("         'nba' region trigger index 3 is active: @(posedge clk)\n");
    }
    if ((0x10ULL & vlSelf->__VnbaTriggered.word(0U))) {
        VL_DBG_MSGF("         'nba' region trigger index 4 is active: @(posedge clk_host or negedge ic_n)\n");
    }
    if ((0x20ULL & vlSelf->__VnbaTriggered.word(0U))) {
        VL_DBG_MSGF("         'nba' region trigger index 5 is active: @(posedge clk or negedge opl3.host_if.__Vcellinp__afifo__i_rd_reset_n)\n");
    }
}
#endif  // VL_DEBUG

VL_ATTR_COLD void Vopl3___024root___ctor_var_reset(Vopl3___024root* vlSelf) {
    if (false && vlSelf) {}  // Prevent unused
    Vopl3__Syms* const __restrict vlSymsp VL_ATTR_UNUSED = vlSelf->vlSymsp;
    VL_DEBUG_IF(VL_DBG_MSGF("+    Vopl3___024root___ctor_var_reset\n"); );
    // Body
    vlSelf->clk = VL_RAND_RESET_I(1);
    vlSelf->clk_host = VL_RAND_RESET_I(1);
    vlSelf->clk_dac = VL_RAND_RESET_I(1);
    vlSelf->ic_n = VL_RAND_RESET_I(1);
    vlSelf->cs_n = VL_RAND_RESET_I(1);
    vlSelf->rd_n = VL_RAND_RESET_I(1);
    vlSelf->wr_n = VL_RAND_RESET_I(1);
    vlSelf->address = VL_RAND_RESET_I(2);
    vlSelf->din = VL_RAND_RESET_I(8);
    vlSelf->dout = VL_RAND_RESET_I(8);
    vlSelf->sample_valid = VL_RAND_RESET_I(1);
    vlSelf->sample_l = VL_RAND_RESET_I(24);
    vlSelf->sample_r = VL_RAND_RESET_I(24);
    vlSelf->led = VL_RAND_RESET_I(4);
    vlSelf->irq_n = VL_RAND_RESET_I(1);
    vlSelf->force_clear_flags = VL_RAND_RESET_I(1);
    vlSelf->opl3__DOT__sample_clk_en = VL_RAND_RESET_I(1);
    vlSelf->opl3__DOT__opl3_reg_wr = VL_RAND_RESET_I(18);
    vlSelf->opl3__DOT__status = VL_RAND_RESET_I(8);
    vlSelf->opl3__DOT__reset_sync__DOT__r0 = VL_RAND_RESET_I(1);
    vlSelf->opl3__DOT__reset_sync__DOT__r1 = VL_RAND_RESET_I(1);
    vlSelf->opl3__DOT__reset_sync__DOT__r2 = VL_RAND_RESET_I(1);
    vlSelf->opl3__DOT__host_if__DOT__cs_p1_n = VL_RAND_RESET_I(1);
    vlSelf->opl3__DOT__host_if__DOT__wr_p1_n = VL_RAND_RESET_I(1);
    vlSelf->opl3__DOT__host_if__DOT__address_p1 = VL_RAND_RESET_I(2);
    vlSelf->opl3__DOT__host_if__DOT__din_p1 = VL_RAND_RESET_I(8);
    vlSelf->opl3__DOT__host_if__DOT__opl3_fifo_empty = VL_RAND_RESET_I(1);
    vlSelf->opl3__DOT__host_if__DOT__wr_p1 = VL_RAND_RESET_I(1);
    vlSelf->opl3__DOT__host_if__DOT__wr_p2 = VL_RAND_RESET_I(1);
    vlSelf->opl3__DOT__host_if__DOT__host_status_p1 = VL_RAND_RESET_I(8);
    vlSelf->opl3__DOT__host_if__DOT____Vcellout__afifo__o_rd_data = VL_RAND_RESET_I(10);
    vlSelf->opl3__DOT__host_if__DOT____Vcellinp__afifo__i_rd_reset_n = VL_RAND_RESET_I(1);
    vlSelf->opl3__DOT__host_if__DOT____Vcellinp__afifo__i_wr = VL_RAND_RESET_I(1);
    vlSelf->opl3__DOT__host_if__DOT__afifo__DOT__o_wr_full = VL_RAND_RESET_I(1);
    for (int __Vi0 = 0; __Vi0 < 64; ++__Vi0) {
        vlSelf->opl3__DOT__host_if__DOT__afifo__DOT__mem[__Vi0] = VL_RAND_RESET_I(10);
    }
    vlSelf->opl3__DOT__host_if__DOT__afifo__DOT__rd_addr = VL_RAND_RESET_I(7);
    vlSelf->opl3__DOT__host_if__DOT__afifo__DOT__wr_addr = VL_RAND_RESET_I(7);
    vlSelf->opl3__DOT__host_if__DOT__afifo__DOT__rd_wgray = VL_RAND_RESET_I(7);
    vlSelf->opl3__DOT__host_if__DOT__afifo__DOT__wr_rgray = VL_RAND_RESET_I(7);
    vlSelf->opl3__DOT__host_if__DOT__afifo__DOT__next_rd_addr = VL_RAND_RESET_I(7);
    vlSelf->opl3__DOT__host_if__DOT__afifo__DOT__next_wr_addr = VL_RAND_RESET_I(7);
    vlSelf->opl3__DOT__host_if__DOT__afifo__DOT__rgray = VL_RAND_RESET_I(7);
    vlSelf->opl3__DOT__host_if__DOT__afifo__DOT__wgray = VL_RAND_RESET_I(7);
    vlSelf->opl3__DOT__host_if__DOT__afifo__DOT__rgray_cross = VL_RAND_RESET_I(7);
    vlSelf->opl3__DOT__host_if__DOT__afifo__DOT__wgray_cross = VL_RAND_RESET_I(7);
    vlSelf->opl3__DOT__host_if__DOT__afifo__DOT__lcl_rd_empty = VL_RAND_RESET_I(1);
    vlSelf->opl3__DOT__host_if__DOT__dout_sync__DOT__sync_regs = VL_RAND_RESET_I(16);
    vlSelf->opl3__DOT__host_if__DOT__genblk1__DOT__trick_sw_detection__DOT__cs_p1_n = VL_RAND_RESET_I(1);
    vlSelf->opl3__DOT__host_if__DOT__genblk1__DOT__trick_sw_detection__DOT__wr_p1_n = VL_RAND_RESET_I(1);
    vlSelf->opl3__DOT__host_if__DOT__genblk1__DOT__trick_sw_detection__DOT__rd_p1_n = VL_RAND_RESET_I(1);
    vlSelf->opl3__DOT__host_if__DOT__genblk1__DOT__trick_sw_detection__DOT__address_p1 = VL_RAND_RESET_I(2);
    vlSelf->opl3__DOT__host_if__DOT__genblk1__DOT__trick_sw_detection__DOT__din_p1 = VL_RAND_RESET_I(8);
    vlSelf->opl3__DOT__host_if__DOT__genblk1__DOT__trick_sw_detection__DOT__wr_p1 = VL_RAND_RESET_I(1);
    vlSelf->opl3__DOT__host_if__DOT__genblk1__DOT__trick_sw_detection__DOT__wr_p2 = VL_RAND_RESET_I(1);
    vlSelf->opl3__DOT__host_if__DOT__genblk1__DOT__trick_sw_detection__DOT__host_rd_counter = VL_RAND_RESET_I(6);
    vlSelf->opl3__DOT__host_if__DOT__genblk1__DOT__trick_sw_detection__DOT__host_reg_wr = VL_RAND_RESET_I(18);
    vlSelf->opl3__DOT__host_if__DOT__genblk1__DOT__trick_sw_detection__DOT__rd_p1 = VL_RAND_RESET_I(1);
    vlSelf->opl3__DOT__host_if__DOT__genblk1__DOT__trick_sw_detection__DOT__rd_p2 = VL_RAND_RESET_I(1);
    vlSelf->opl3__DOT__host_if__DOT__genblk1__DOT__trick_sw_detection__DOT__host_force_timer_overflow = VL_RAND_RESET_I(1);
    vlSelf->opl3__DOT__host_if__DOT__genblk1__DOT__trick_sw_detection__DOT__start_counter = VL_RAND_RESET_I(1);
    vlSelf->opl3__DOT__host_if__DOT__genblk1__DOT__trick_sw_detection__DOT__timer1 = VL_RAND_RESET_I(8);
    vlSelf->opl3__DOT__host_if__DOT__genblk1__DOT__trick_sw_detection__DOT__force_timer_overflow_sync__DOT__sync_regs = VL_RAND_RESET_I(2);
    vlSelf->opl3__DOT__sample_clk_gen__DOT__counter = VL_RAND_RESET_I(10);
    vlSelf->opl3__DOT__channels__DOT__operator_out = VL_RAND_RESET_I(20);
    vlSelf->opl3__DOT__channels__DOT__operator_mem_out = VL_RAND_RESET_I(13);
    vlSelf->opl3__DOT__channels__DOT__channel_l = VL_RAND_RESET_I(16);
    vlSelf->opl3__DOT__channels__DOT__channel_r = VL_RAND_RESET_I(16);
    vlSelf->opl3__DOT__channels__DOT__channel_valid = VL_RAND_RESET_I(1);
    vlSelf->opl3__DOT__channels__DOT__ops_done_pulse = VL_RAND_RESET_I(1);
    vlSelf->opl3__DOT__channels__DOT__connection_sel = VL_RAND_RESET_I(6);
    vlSelf->opl3__DOT__channels__DOT__is_new = VL_RAND_RESET_I(1);
    vlSelf->opl3__DOT__channels__DOT__ryt = VL_RAND_RESET_I(1);
    vlSelf->opl3__DOT__channels__DOT__state = 0;
    vlSelf->opl3__DOT__channels__DOT__next_state = 0;
    VL_RAND_RESET_W(77, vlSelf->opl3__DOT__channels__DOT__self);
    VL_RAND_RESET_W(77, vlSelf->opl3__DOT__channels__DOT__next_self);
    vlSelf->opl3__DOT__channels__DOT__signals = VL_RAND_RESET_I(30);
    vlSelf->opl3__DOT__channels__DOT____Vcellout__ch_abcd_cnt_mem__dob = VL_RAND_RESET_I(8);
    for (int __Vi0 = 0; __Vi0 < 2; ++__Vi0) {
        vlSelf->opl3__DOT__channels__DOT__ch_abcd_cnt_mem__DOT__dob_array[__Vi0] = VL_RAND_RESET_I(8);
    }
    for (int __Vi0 = 0; __Vi0 < 9; ++__Vi0) {
        vlSelf->opl3__DOT__channels__DOT__ch_abcd_cnt_mem__DOT__bankgen__BRA__0__KET____DOT__genblk1__DOT__mem_bank__DOT__ram[__Vi0] = VL_RAND_RESET_I(8);
    }
    vlSelf->opl3__DOT__channels__DOT__ch_abcd_cnt_mem__DOT__bankgen__BRA__0__KET____DOT__genblk1__DOT__mem_bank__DOT____Vlvbound_h86a57974__0 = VL_RAND_RESET_I(8);
    for (int __Vi0 = 0; __Vi0 < 9; ++__Vi0) {
        vlSelf->opl3__DOT__channels__DOT__ch_abcd_cnt_mem__DOT__bankgen__BRA__1__KET____DOT__genblk1__DOT__mem_bank__DOT__ram[__Vi0] = VL_RAND_RESET_I(8);
    }
    vlSelf->opl3__DOT__channels__DOT__ch_abcd_cnt_mem__DOT__bankgen__BRA__1__KET____DOT__genblk1__DOT__mem_bank__DOT____Vlvbound_h86a57974__0 = VL_RAND_RESET_I(8);
    vlSelf->opl3__DOT__channels__DOT__control_operators__DOT__delay_counter = VL_RAND_RESET_I(2);
    vlSelf->opl3__DOT__channels__DOT__control_operators__DOT__state = VL_RAND_RESET_I(6);
    vlSelf->opl3__DOT__channels__DOT__control_operators__DOT__next_state = VL_RAND_RESET_I(6);
    vlSelf->opl3__DOT__channels__DOT__control_operators__DOT__bank_num_p1 = VL_RAND_RESET_I(1);
    vlSelf->opl3__DOT__channels__DOT__control_operators__DOT__op_num = VL_RAND_RESET_I(5);
    vlSelf->opl3__DOT__channels__DOT__control_operators__DOT__op_num_p1 = VL_RAND_RESET_I(5);
    vlSelf->opl3__DOT__channels__DOT__control_operators__DOT__use_feedback_p1 = VL_RAND_RESET_I(1);
    vlSelf->opl3__DOT__channels__DOT__control_operators__DOT__modulation_p1 = VL_RAND_RESET_I(13);
    vlSelf->opl3__DOT__channels__DOT__control_operators__DOT__out_p6 = VL_RAND_RESET_I(13);
    vlSelf->opl3__DOT__channels__DOT__control_operators__DOT__modulation_out_p1 = VL_RAND_RESET_I(13);
    vlSelf->opl3__DOT__channels__DOT__control_operators__DOT__op_sample_clk_en = VL_RAND_RESET_I(1);
    vlSelf->opl3__DOT__channels__DOT__control_operators__DOT__bank_num_p = VL_RAND_RESET_I(6);
    vlSelf->opl3__DOT__channels__DOT__control_operators__DOT__op_num_p = VL_RAND_RESET_I(30);
    vlSelf->opl3__DOT__channels__DOT__control_operators__DOT__connection_sel_p1 = VL_RAND_RESET_I(6);
    vlSelf->opl3__DOT__channels__DOT__control_operators__DOT__ryt_p1 = VL_RAND_RESET_I(1);
    vlSelf->opl3__DOT__channels__DOT__control_operators__DOT__fnum = VL_RAND_RESET_I(10);
    vlSelf->opl3__DOT__channels__DOT__control_operators__DOT__kon_block_fnum_channel_mem_rd_address = VL_RAND_RESET_I(4);
    vlSelf->opl3__DOT__channels__DOT__control_operators__DOT__fb_cnt0_channel_mem_rd_address = VL_RAND_RESET_I(4);
    vlSelf->opl3__DOT__channels__DOT__control_operators__DOT__cnt1_channel_mem_rd_address = VL_RAND_RESET_I(4);
    vlSelf->opl3__DOT__channels__DOT__control_operators__DOT__nts = VL_RAND_RESET_I(1);
    vlSelf->opl3__DOT__channels__DOT__control_operators__DOT__dvb = VL_RAND_RESET_I(1);
    vlSelf->opl3__DOT__channels__DOT__control_operators__DOT__dam = VL_RAND_RESET_I(1);
    vlSelf->opl3__DOT__channels__DOT__control_operators__DOT__bd = VL_RAND_RESET_I(1);
    vlSelf->opl3__DOT__channels__DOT__control_operators__DOT__sd = VL_RAND_RESET_I(1);
    vlSelf->opl3__DOT__channels__DOT__control_operators__DOT__tom = VL_RAND_RESET_I(1);
    vlSelf->opl3__DOT__channels__DOT__control_operators__DOT__tc = VL_RAND_RESET_I(1);
    vlSelf->opl3__DOT__channels__DOT__control_operators__DOT__hh = VL_RAND_RESET_I(1);
    vlSelf->opl3__DOT__channels__DOT__control_operators__DOT____Vcellout__am_vib_egt_ksr_mult_mem__dob = VL_RAND_RESET_I(8);
    vlSelf->opl3__DOT__channels__DOT__control_operators__DOT____Vcellinp__am_vib_egt_ksr_mult_mem__wea = VL_RAND_RESET_I(1);
    vlSelf->opl3__DOT__channels__DOT__control_operators__DOT____Vcellout__ksl_tl_mem__dob = VL_RAND_RESET_I(8);
    vlSelf->opl3__DOT__channels__DOT__control_operators__DOT____Vcellinp__ksl_tl_mem__wea = VL_RAND_RESET_I(1);
    vlSelf->opl3__DOT__channels__DOT__control_operators__DOT____Vcellinp__ar_dr_mem__wea = VL_RAND_RESET_I(1);
    vlSelf->opl3__DOT__channels__DOT__control_operators__DOT____Vcellout__sl_rr_mem__dob = VL_RAND_RESET_I(8);
    vlSelf->opl3__DOT__channels__DOT__control_operators__DOT____Vcellinp__sl_rr_mem__wea = VL_RAND_RESET_I(1);
    vlSelf->opl3__DOT__channels__DOT__control_operators__DOT____Vcellinp__ws_mem__wea = VL_RAND_RESET_I(1);
    vlSelf->opl3__DOT__channels__DOT__control_operators__DOT____Vcellout__fnum_low_mem__dob = VL_RAND_RESET_I(8);
    vlSelf->opl3__DOT__channels__DOT__control_operators__DOT____Vcellinp__fnum_low_mem__wea = VL_RAND_RESET_I(1);
    vlSelf->opl3__DOT__channels__DOT__control_operators__DOT____Vcellout__block_fnum_high_mem__dob = VL_RAND_RESET_I(5);
    vlSelf->opl3__DOT__channels__DOT__control_operators__DOT____Vcellout__sample_clk_en_sr__out = VL_RAND_RESET_I(6);
    for (int __Vi0 = 0; __Vi0 < 2; ++__Vi0) {
        vlSelf->opl3__DOT__channels__DOT__control_operators__DOT__am_vib_egt_ksr_mult_mem__DOT__dob_array[__Vi0] = VL_RAND_RESET_I(8);
    }
    for (int __Vi0 = 0; __Vi0 < 22; ++__Vi0) {
        vlSelf->opl3__DOT__channels__DOT__control_operators__DOT__am_vib_egt_ksr_mult_mem__DOT__bankgen__BRA__0__KET____DOT__genblk1__DOT__mem_bank__DOT__ram[__Vi0] = VL_RAND_RESET_I(8);
    }
    vlSelf->opl3__DOT__channels__DOT__control_operators__DOT__am_vib_egt_ksr_mult_mem__DOT__bankgen__BRA__0__KET____DOT__genblk1__DOT__mem_bank__DOT____Vlvbound_h78e36339__0 = VL_RAND_RESET_I(8);
    for (int __Vi0 = 0; __Vi0 < 22; ++__Vi0) {
        vlSelf->opl3__DOT__channels__DOT__control_operators__DOT__am_vib_egt_ksr_mult_mem__DOT__bankgen__BRA__1__KET____DOT__genblk1__DOT__mem_bank__DOT__ram[__Vi0] = VL_RAND_RESET_I(8);
    }
    vlSelf->opl3__DOT__channels__DOT__control_operators__DOT__am_vib_egt_ksr_mult_mem__DOT__bankgen__BRA__1__KET____DOT__genblk1__DOT__mem_bank__DOT____Vlvbound_h78e36339__0 = VL_RAND_RESET_I(8);
    for (int __Vi0 = 0; __Vi0 < 2; ++__Vi0) {
        vlSelf->opl3__DOT__channels__DOT__control_operators__DOT__ksl_tl_mem__DOT__dob_array[__Vi0] = VL_RAND_RESET_I(8);
    }
    for (int __Vi0 = 0; __Vi0 < 22; ++__Vi0) {
        vlSelf->opl3__DOT__channels__DOT__control_operators__DOT__ksl_tl_mem__DOT__bankgen__BRA__0__KET____DOT__genblk1__DOT__mem_bank__DOT__ram[__Vi0] = VL_RAND_RESET_I(8);
    }
    vlSelf->opl3__DOT__channels__DOT__control_operators__DOT__ksl_tl_mem__DOT__bankgen__BRA__0__KET____DOT__genblk1__DOT__mem_bank__DOT____Vlvbound_h78e36339__0 = VL_RAND_RESET_I(8);
    for (int __Vi0 = 0; __Vi0 < 22; ++__Vi0) {
        vlSelf->opl3__DOT__channels__DOT__control_operators__DOT__ksl_tl_mem__DOT__bankgen__BRA__1__KET____DOT__genblk1__DOT__mem_bank__DOT__ram[__Vi0] = VL_RAND_RESET_I(8);
    }
    vlSelf->opl3__DOT__channels__DOT__control_operators__DOT__ksl_tl_mem__DOT__bankgen__BRA__1__KET____DOT__genblk1__DOT__mem_bank__DOT____Vlvbound_h78e36339__0 = VL_RAND_RESET_I(8);
    for (int __Vi0 = 0; __Vi0 < 2; ++__Vi0) {
        vlSelf->opl3__DOT__channels__DOT__control_operators__DOT__ar_dr_mem__DOT__dob_array[__Vi0] = VL_RAND_RESET_I(8);
    }
    for (int __Vi0 = 0; __Vi0 < 22; ++__Vi0) {
        vlSelf->opl3__DOT__channels__DOT__control_operators__DOT__ar_dr_mem__DOT__bankgen__BRA__0__KET____DOT__genblk1__DOT__mem_bank__DOT__ram[__Vi0] = VL_RAND_RESET_I(8);
    }
    vlSelf->opl3__DOT__channels__DOT__control_operators__DOT__ar_dr_mem__DOT__bankgen__BRA__0__KET____DOT__genblk1__DOT__mem_bank__DOT____Vlvbound_h78e36339__0 = VL_RAND_RESET_I(8);
    for (int __Vi0 = 0; __Vi0 < 22; ++__Vi0) {
        vlSelf->opl3__DOT__channels__DOT__control_operators__DOT__ar_dr_mem__DOT__bankgen__BRA__1__KET____DOT__genblk1__DOT__mem_bank__DOT__ram[__Vi0] = VL_RAND_RESET_I(8);
    }
    vlSelf->opl3__DOT__channels__DOT__control_operators__DOT__ar_dr_mem__DOT__bankgen__BRA__1__KET____DOT__genblk1__DOT__mem_bank__DOT____Vlvbound_h78e36339__0 = VL_RAND_RESET_I(8);
    for (int __Vi0 = 0; __Vi0 < 2; ++__Vi0) {
        vlSelf->opl3__DOT__channels__DOT__control_operators__DOT__sl_rr_mem__DOT__dob_array[__Vi0] = VL_RAND_RESET_I(8);
    }
    for (int __Vi0 = 0; __Vi0 < 22; ++__Vi0) {
        vlSelf->opl3__DOT__channels__DOT__control_operators__DOT__sl_rr_mem__DOT__bankgen__BRA__0__KET____DOT__genblk1__DOT__mem_bank__DOT__ram[__Vi0] = VL_RAND_RESET_I(8);
    }
    vlSelf->opl3__DOT__channels__DOT__control_operators__DOT__sl_rr_mem__DOT__bankgen__BRA__0__KET____DOT__genblk1__DOT__mem_bank__DOT____Vlvbound_h78e36339__0 = VL_RAND_RESET_I(8);
    for (int __Vi0 = 0; __Vi0 < 22; ++__Vi0) {
        vlSelf->opl3__DOT__channels__DOT__control_operators__DOT__sl_rr_mem__DOT__bankgen__BRA__1__KET____DOT__genblk1__DOT__mem_bank__DOT__ram[__Vi0] = VL_RAND_RESET_I(8);
    }
    vlSelf->opl3__DOT__channels__DOT__control_operators__DOT__sl_rr_mem__DOT__bankgen__BRA__1__KET____DOT__genblk1__DOT__mem_bank__DOT____Vlvbound_h78e36339__0 = VL_RAND_RESET_I(8);
    for (int __Vi0 = 0; __Vi0 < 2; ++__Vi0) {
        vlSelf->opl3__DOT__channels__DOT__control_operators__DOT__ws_mem__DOT__dob_array[__Vi0] = VL_RAND_RESET_I(3);
    }
    for (int __Vi0 = 0; __Vi0 < 22; ++__Vi0) {
        vlSelf->opl3__DOT__channels__DOT__control_operators__DOT__ws_mem__DOT__bankgen__BRA__0__KET____DOT__genblk1__DOT__mem_bank__DOT__ram[__Vi0] = VL_RAND_RESET_I(3);
    }
    vlSelf->opl3__DOT__channels__DOT__control_operators__DOT__ws_mem__DOT__bankgen__BRA__0__KET____DOT__genblk1__DOT__mem_bank__DOT____Vlvbound_hebd03cde__0 = VL_RAND_RESET_I(3);
    for (int __Vi0 = 0; __Vi0 < 22; ++__Vi0) {
        vlSelf->opl3__DOT__channels__DOT__control_operators__DOT__ws_mem__DOT__bankgen__BRA__1__KET____DOT__genblk1__DOT__mem_bank__DOT__ram[__Vi0] = VL_RAND_RESET_I(3);
    }
    vlSelf->opl3__DOT__channels__DOT__control_operators__DOT__ws_mem__DOT__bankgen__BRA__1__KET____DOT__genblk1__DOT__mem_bank__DOT____Vlvbound_hebd03cde__0 = VL_RAND_RESET_I(3);
    for (int __Vi0 = 0; __Vi0 < 2; ++__Vi0) {
        vlSelf->opl3__DOT__channels__DOT__control_operators__DOT__fnum_low_mem__DOT__dob_array[__Vi0] = VL_RAND_RESET_I(8);
    }
    for (int __Vi0 = 0; __Vi0 < 9; ++__Vi0) {
        vlSelf->opl3__DOT__channels__DOT__control_operators__DOT__fnum_low_mem__DOT__bankgen__BRA__0__KET____DOT__genblk1__DOT__mem_bank__DOT__ram[__Vi0] = VL_RAND_RESET_I(8);
    }
    vlSelf->opl3__DOT__channels__DOT__control_operators__DOT__fnum_low_mem__DOT__bankgen__BRA__0__KET____DOT__genblk1__DOT__mem_bank__DOT____Vlvbound_h86a57974__0 = VL_RAND_RESET_I(8);
    for (int __Vi0 = 0; __Vi0 < 9; ++__Vi0) {
        vlSelf->opl3__DOT__channels__DOT__control_operators__DOT__fnum_low_mem__DOT__bankgen__BRA__1__KET____DOT__genblk1__DOT__mem_bank__DOT__ram[__Vi0] = VL_RAND_RESET_I(8);
    }
    vlSelf->opl3__DOT__channels__DOT__control_operators__DOT__fnum_low_mem__DOT__bankgen__BRA__1__KET____DOT__genblk1__DOT__mem_bank__DOT____Vlvbound_h86a57974__0 = VL_RAND_RESET_I(8);
    for (int __Vi0 = 0; __Vi0 < 2; ++__Vi0) {
        vlSelf->opl3__DOT__channels__DOT__control_operators__DOT__kon_mem__DOT__dob_array[__Vi0] = VL_RAND_RESET_I(1);
    }
    vlSelf->opl3__DOT__channels__DOT__control_operators__DOT__kon_mem__DOT__state = 0;
    vlSelf->opl3__DOT__channels__DOT__control_operators__DOT__kon_mem__DOT__next_state = 0;
    vlSelf->opl3__DOT__channels__DOT__control_operators__DOT__kon_mem__DOT__self = VL_RAND_RESET_I(6);
    vlSelf->opl3__DOT__channels__DOT__control_operators__DOT__kon_mem__DOT__next_self = VL_RAND_RESET_I(6);
    vlSelf->opl3__DOT__channels__DOT__control_operators__DOT__kon_mem__DOT____Vcellinp__bankgen__BRA__0__KET____DOT__genblk1__DOT__mem_bank__dia = VL_RAND_RESET_I(1);
    vlSelf->opl3__DOT__channels__DOT__control_operators__DOT__kon_mem__DOT____Vcellinp__bankgen__BRA__0__KET____DOT__genblk1__DOT__mem_bank__addra = VL_RAND_RESET_I(4);
    for (int __Vi0 = 0; __Vi0 < 9; ++__Vi0) {
        vlSelf->opl3__DOT__channels__DOT__control_operators__DOT__kon_mem__DOT__bankgen__BRA__0__KET____DOT__genblk1__DOT__mem_bank__DOT__ram[__Vi0] = VL_RAND_RESET_I(1);
    }
    vlSelf->opl3__DOT__channels__DOT__control_operators__DOT__kon_mem__DOT__bankgen__BRA__0__KET____DOT__genblk1__DOT__mem_bank__DOT____Vlvbound_hecc6a027__0 = VL_RAND_RESET_I(1);
    for (int __Vi0 = 0; __Vi0 < 9; ++__Vi0) {
        vlSelf->opl3__DOT__channels__DOT__control_operators__DOT__kon_mem__DOT__bankgen__BRA__1__KET____DOT__genblk1__DOT__mem_bank__DOT__ram[__Vi0] = VL_RAND_RESET_I(1);
    }
    vlSelf->opl3__DOT__channels__DOT__control_operators__DOT__kon_mem__DOT__bankgen__BRA__1__KET____DOT__genblk1__DOT__mem_bank__DOT____Vlvbound_hecc6a027__0 = VL_RAND_RESET_I(1);
    for (int __Vi0 = 0; __Vi0 < 2; ++__Vi0) {
        vlSelf->opl3__DOT__channels__DOT__control_operators__DOT__block_fnum_high_mem__DOT__dob_array[__Vi0] = VL_RAND_RESET_I(5);
    }
    vlSelf->opl3__DOT__channels__DOT__control_operators__DOT__block_fnum_high_mem__DOT____Vcellinp__bankgen__BRA__0__KET____DOT__genblk1__DOT__mem_bank__wea = VL_RAND_RESET_I(1);
    vlSelf->opl3__DOT__channels__DOT__control_operators__DOT__block_fnum_high_mem__DOT____Vcellinp__bankgen__BRA__1__KET____DOT__genblk1__DOT__mem_bank__wea = VL_RAND_RESET_I(1);
    for (int __Vi0 = 0; __Vi0 < 9; ++__Vi0) {
        vlSelf->opl3__DOT__channels__DOT__control_operators__DOT__block_fnum_high_mem__DOT__bankgen__BRA__0__KET____DOT__genblk1__DOT__mem_bank__DOT__ram[__Vi0] = VL_RAND_RESET_I(5);
    }
    vlSelf->opl3__DOT__channels__DOT__control_operators__DOT__block_fnum_high_mem__DOT__bankgen__BRA__0__KET____DOT__genblk1__DOT__mem_bank__DOT____Vlvbound_hf28499db__0 = VL_RAND_RESET_I(5);
    for (int __Vi0 = 0; __Vi0 < 9; ++__Vi0) {
        vlSelf->opl3__DOT__channels__DOT__control_operators__DOT__block_fnum_high_mem__DOT__bankgen__BRA__1__KET____DOT__genblk1__DOT__mem_bank__DOT__ram[__Vi0] = VL_RAND_RESET_I(5);
    }
    vlSelf->opl3__DOT__channels__DOT__control_operators__DOT__block_fnum_high_mem__DOT__bankgen__BRA__1__KET____DOT__genblk1__DOT__mem_bank__DOT____Vlvbound_hf28499db__0 = VL_RAND_RESET_I(5);
    for (int __Vi0 = 0; __Vi0 < 2; ++__Vi0) {
        vlSelf->opl3__DOT__channels__DOT__control_operators__DOT__fb_cnt0_mem__DOT__dob_array[__Vi0] = VL_RAND_RESET_I(4);
    }
    vlSelf->opl3__DOT__channels__DOT__control_operators__DOT__fb_cnt0_mem__DOT__bankb_p = VL_RAND_RESET_I(2);
    vlSelf->opl3__DOT__channels__DOT__control_operators__DOT__fb_cnt0_mem__DOT__bankgen__BRA__0__KET____DOT__genblk1__DOT__reb_mem = VL_RAND_RESET_I(1);
    vlSelf->opl3__DOT__channels__DOT__control_operators__DOT__fb_cnt0_mem__DOT____Vcellinp__bankgen__BRA__0__KET____DOT__genblk1__DOT__mem_bank__wea = VL_RAND_RESET_I(1);
    vlSelf->opl3__DOT__channels__DOT__control_operators__DOT__fb_cnt0_mem__DOT__bankgen__BRA__1__KET____DOT__genblk1__DOT__reb_mem = VL_RAND_RESET_I(1);
    vlSelf->opl3__DOT__channels__DOT__control_operators__DOT__fb_cnt0_mem__DOT____Vcellinp__bankgen__BRA__1__KET____DOT__genblk1__DOT__mem_bank__wea = VL_RAND_RESET_I(1);
    for (int __Vi0 = 0; __Vi0 < 9; ++__Vi0) {
        vlSelf->opl3__DOT__channels__DOT__control_operators__DOT__fb_cnt0_mem__DOT__bankgen__BRA__0__KET____DOT__genblk1__DOT__mem_bank__DOT__ram[__Vi0] = VL_RAND_RESET_I(4);
    }
    vlSelf->opl3__DOT__channels__DOT__control_operators__DOT__fb_cnt0_mem__DOT__bankgen__BRA__0__KET____DOT__genblk1__DOT__mem_bank__DOT__genblk1__DOT__dob_p1 = VL_RAND_RESET_I(4);
    vlSelf->opl3__DOT__channels__DOT__control_operators__DOT__fb_cnt0_mem__DOT__bankgen__BRA__0__KET____DOT__genblk1__DOT__mem_bank__DOT____Vlvbound_h95153f4e__0 = VL_RAND_RESET_I(4);
    for (int __Vi0 = 0; __Vi0 < 9; ++__Vi0) {
        vlSelf->opl3__DOT__channels__DOT__control_operators__DOT__fb_cnt0_mem__DOT__bankgen__BRA__1__KET____DOT__genblk1__DOT__mem_bank__DOT__ram[__Vi0] = VL_RAND_RESET_I(4);
    }
    vlSelf->opl3__DOT__channels__DOT__control_operators__DOT__fb_cnt0_mem__DOT__bankgen__BRA__1__KET____DOT__genblk1__DOT__mem_bank__DOT__genblk1__DOT__dob_p1 = VL_RAND_RESET_I(4);
    vlSelf->opl3__DOT__channels__DOT__control_operators__DOT__fb_cnt0_mem__DOT__bankgen__BRA__1__KET____DOT__genblk1__DOT__mem_bank__DOT____Vlvbound_h95153f4e__0 = VL_RAND_RESET_I(4);
    for (int __Vi0 = 0; __Vi0 < 2; ++__Vi0) {
        vlSelf->opl3__DOT__channels__DOT__control_operators__DOT__fb_cnt1_mem__DOT__dob_array[__Vi0] = VL_RAND_RESET_I(1);
    }
    vlSelf->opl3__DOT__channels__DOT__control_operators__DOT__fb_cnt1_mem__DOT__bankb_p = VL_RAND_RESET_I(2);
    for (int __Vi0 = 0; __Vi0 < 9; ++__Vi0) {
        vlSelf->opl3__DOT__channels__DOT__control_operators__DOT__fb_cnt1_mem__DOT__bankgen__BRA__0__KET____DOT__genblk1__DOT__mem_bank__DOT__ram[__Vi0] = VL_RAND_RESET_I(1);
    }
    vlSelf->opl3__DOT__channels__DOT__control_operators__DOT__fb_cnt1_mem__DOT__bankgen__BRA__0__KET____DOT__genblk1__DOT__mem_bank__DOT__genblk1__DOT__dob_p1 = VL_RAND_RESET_I(1);
    vlSelf->opl3__DOT__channels__DOT__control_operators__DOT__fb_cnt1_mem__DOT__bankgen__BRA__0__KET____DOT__genblk1__DOT__mem_bank__DOT____Vlvbound_hecc6a027__0 = VL_RAND_RESET_I(1);
    for (int __Vi0 = 0; __Vi0 < 9; ++__Vi0) {
        vlSelf->opl3__DOT__channels__DOT__control_operators__DOT__fb_cnt1_mem__DOT__bankgen__BRA__1__KET____DOT__genblk1__DOT__mem_bank__DOT__ram[__Vi0] = VL_RAND_RESET_I(1);
    }
    vlSelf->opl3__DOT__channels__DOT__control_operators__DOT__fb_cnt1_mem__DOT__bankgen__BRA__1__KET____DOT__genblk1__DOT__mem_bank__DOT__genblk1__DOT__dob_p1 = VL_RAND_RESET_I(1);
    vlSelf->opl3__DOT__channels__DOT__control_operators__DOT__fb_cnt1_mem__DOT__bankgen__BRA__1__KET____DOT__genblk1__DOT__mem_bank__DOT____Vlvbound_hecc6a027__0 = VL_RAND_RESET_I(1);
    vlSelf->opl3__DOT__channels__DOT__control_operators__DOT__operator__DOT__bank_num_p = VL_RAND_RESET_I(6);
    vlSelf->opl3__DOT__channels__DOT__control_operators__DOT__operator__DOT__op_num_p = VL_RAND_RESET_I(30);
    vlSelf->opl3__DOT__channels__DOT__control_operators__DOT__operator__DOT__env_p3 = VL_RAND_RESET_I(11);
    vlSelf->opl3__DOT__channels__DOT__control_operators__DOT__operator__DOT__feedback_result_p1 = VL_RAND_RESET_I(13);
    vlSelf->opl3__DOT__channels__DOT__control_operators__DOT__operator__DOT__op_type_p0 = VL_RAND_RESET_I(3);
    vlSelf->opl3__DOT__channels__DOT__control_operators__DOT__operator__DOT__key_on_p0 = VL_RAND_RESET_I(1);
    vlSelf->opl3__DOT__channels__DOT__control_operators__DOT__operator__DOT____Vcellout__sample_clk_en_sr__out = VL_RAND_RESET_I(6);
    vlSelf->opl3__DOT__channels__DOT__control_operators__DOT__operator__DOT____Vcellout__feedback_mem__dob = VL_RAND_RESET_I(26);
    vlSelf->opl3__DOT__channels__DOT__control_operators__DOT__operator__DOT____Vcellinp__feedback_mem__dia = VL_RAND_RESET_I(26);
    VL_RAND_RESET_W(130, vlSelf->opl3__DOT__channels__DOT__control_operators__DOT__operator__DOT____Vcellout__feedback_sr__out);
    vlSelf->opl3__DOT__channels__DOT__control_operators__DOT__operator__DOT__calc_phase_inc__DOT__pre_mult_p1 = VL_RAND_RESET_I(17);
    vlSelf->opl3__DOT__channels__DOT__control_operators__DOT__operator__DOT__calc_phase_inc__DOT__post_mult_p2 = VL_RAND_RESET_I(20);
    vlSelf->opl3__DOT__channels__DOT__control_operators__DOT__operator__DOT__calc_phase_inc__DOT__vib_val_p2 = VL_RAND_RESET_I(3);
    vlSelf->opl3__DOT__channels__DOT__control_operators__DOT__operator__DOT__calc_phase_inc__DOT__multiplier_p1 = VL_RAND_RESET_I(5);
    vlSelf->opl3__DOT__channels__DOT__control_operators__DOT__operator__DOT__calc_phase_inc__DOT____Vcellout__vib_sr__out = VL_RAND_RESET_I(2);
    vlSelf->opl3__DOT__channels__DOT__control_operators__DOT__operator__DOT__calc_phase_inc__DOT__vibrato__DOT__vibrato_index_p1 = VL_RAND_RESET_I(13);
    vlSelf->opl3__DOT__channels__DOT__control_operators__DOT__operator__DOT__calc_phase_inc__DOT__vibrato__DOT__delta2_p1 = VL_RAND_RESET_I(3);
    vlSelf->opl3__DOT__channels__DOT__control_operators__DOT__operator__DOT__calc_phase_inc__DOT__vibrato__DOT__fnum_p1 = VL_RAND_RESET_I(10);
    vlSelf->opl3__DOT__channels__DOT__control_operators__DOT__operator__DOT__calc_phase_inc__DOT__vibrato__DOT__dvb_p1 = VL_RAND_RESET_I(1);
    vlSelf->opl3__DOT__channels__DOT__control_operators__DOT__operator__DOT__envelope_generator__DOT__state_p1 = VL_RAND_RESET_I(4);
    vlSelf->opl3__DOT__channels__DOT__control_operators__DOT__operator__DOT__envelope_generator__DOT__state_p2 = VL_RAND_RESET_I(4);
    vlSelf->opl3__DOT__channels__DOT__control_operators__DOT__operator__DOT__envelope_generator__DOT__next_state_p2 = VL_RAND_RESET_I(4);
    vlSelf->opl3__DOT__channels__DOT__control_operators__DOT__operator__DOT__envelope_generator__DOT__state_p3 = VL_RAND_RESET_I(4);
    vlSelf->opl3__DOT__channels__DOT__control_operators__DOT__operator__DOT__envelope_generator__DOT__ksl_add_p2 = VL_RAND_RESET_I(8);
    vlSelf->opl3__DOT__channels__DOT__control_operators__DOT__operator__DOT__envelope_generator__DOT__env_int_pre_p2 = VL_RAND_RESET_I(9);
    vlSelf->opl3__DOT__channels__DOT__control_operators__DOT__operator__DOT__envelope_generator__DOT__eg_inc_p2 = VL_RAND_RESET_I(9);
    vlSelf->opl3__DOT__channels__DOT__control_operators__DOT__operator__DOT__envelope_generator__DOT__env_int_new_p3 = VL_RAND_RESET_I(9);
    vlSelf->opl3__DOT__channels__DOT__control_operators__DOT__operator__DOT__envelope_generator__DOT__am_val_p2 = VL_RAND_RESET_I(6);
    vlSelf->opl3__DOT__channels__DOT__control_operators__DOT__operator__DOT__envelope_generator__DOT__requested_rate_p0 = VL_RAND_RESET_I(4);
    vlSelf->opl3__DOT__channels__DOT__control_operators__DOT__operator__DOT__envelope_generator__DOT__env_shift_p2 = VL_RAND_RESET_I(2);
    vlSelf->opl3__DOT__channels__DOT__control_operators__DOT__operator__DOT__envelope_generator__DOT__rate_hi_p2 = VL_RAND_RESET_I(4);
    vlSelf->opl3__DOT__channels__DOT__control_operators__DOT__operator__DOT__envelope_generator__DOT__eg_reset_p0 = VL_RAND_RESET_I(1);
    vlSelf->opl3__DOT__channels__DOT__control_operators__DOT__operator__DOT__envelope_generator__DOT__bank_num_p = VL_RAND_RESET_I(3);
    vlSelf->opl3__DOT__channels__DOT__control_operators__DOT__operator__DOT__envelope_generator__DOT__op_num_p = VL_RAND_RESET_I(15);
    vlSelf->opl3__DOT__channels__DOT__control_operators__DOT__operator__DOT__envelope_generator__DOT__tl_p = VL_RAND_RESET_I(18);
    vlSelf->opl3__DOT__channels__DOT__control_operators__DOT__operator__DOT__envelope_generator__DOT__sl_p = VL_RAND_RESET_I(12);
    vlSelf->opl3__DOT__channels__DOT__control_operators__DOT__operator__DOT__envelope_generator__DOT__env_int_p = VL_RAND_RESET_I(27);
    vlSelf->opl3__DOT__channels__DOT__control_operators__DOT__operator__DOT__envelope_generator__DOT____Vcellout__sample_clk_en_sr__out = VL_RAND_RESET_I(3);
    vlSelf->opl3__DOT__channels__DOT__control_operators__DOT__operator__DOT__envelope_generator__DOT____Vcellout__key_on_sr__out = VL_RAND_RESET_I(3);
    vlSelf->opl3__DOT__channels__DOT__control_operators__DOT__operator__DOT__envelope_generator__DOT____Vcellout__eg_reset_sr__out = VL_RAND_RESET_I(3);
    vlSelf->opl3__DOT__channels__DOT__control_operators__DOT__operator__DOT__envelope_generator__DOT____Vcellout__state_mem__dob = VL_RAND_RESET_I(4);
    vlSelf->opl3__DOT__channels__DOT__control_operators__DOT__operator__DOT__envelope_generator__DOT__ksl_add_rom__DOT__rom_out_p1 = VL_RAND_RESET_I(7);
    vlSelf->opl3__DOT__channels__DOT__control_operators__DOT__operator__DOT__envelope_generator__DOT__ksl_add_rom__DOT__tmp0_p1 = VL_RAND_RESET_I(6);
    vlSelf->opl3__DOT__channels__DOT__control_operators__DOT__operator__DOT__envelope_generator__DOT__ksl_add_rom__DOT__tmp1_p1 = VL_RAND_RESET_I(8);
    vlSelf->opl3__DOT__channels__DOT__control_operators__DOT__operator__DOT__envelope_generator__DOT__ksl_add_rom__DOT__ksl_p1 = VL_RAND_RESET_I(2);
    for (int __Vi0 = 0; __Vi0 < 2; ++__Vi0) {
        vlSelf->opl3__DOT__channels__DOT__control_operators__DOT__operator__DOT__envelope_generator__DOT__state_mem__DOT__dob_array[__Vi0] = VL_RAND_RESET_I(4);
    }
    for (int __Vi0 = 0; __Vi0 < 18; ++__Vi0) {
        vlSelf->opl3__DOT__channels__DOT__control_operators__DOT__operator__DOT__envelope_generator__DOT__state_mem__DOT__bankgen__BRA__0__KET____DOT__genblk1__DOT__mem_bank__DOT__ram[__Vi0] = VL_RAND_RESET_I(4);
    }
    vlSelf->opl3__DOT__channels__DOT__control_operators__DOT__operator__DOT__envelope_generator__DOT__state_mem__DOT__bankgen__BRA__0__KET____DOT__genblk1__DOT__mem_bank__DOT____Vlvbound_hb6861da5__0 = VL_RAND_RESET_I(4);
    for (int __Vi0 = 0; __Vi0 < 18; ++__Vi0) {
        vlSelf->opl3__DOT__channels__DOT__control_operators__DOT__operator__DOT__envelope_generator__DOT__state_mem__DOT__bankgen__BRA__1__KET____DOT__genblk1__DOT__mem_bank__DOT__ram[__Vi0] = VL_RAND_RESET_I(4);
    }
    vlSelf->opl3__DOT__channels__DOT__control_operators__DOT__operator__DOT__envelope_generator__DOT__state_mem__DOT__bankgen__BRA__1__KET____DOT__genblk1__DOT__mem_bank__DOT____Vlvbound_hb6861da5__0 = VL_RAND_RESET_I(4);
    vlSelf->opl3__DOT__channels__DOT__control_operators__DOT__operator__DOT__envelope_generator__DOT__calc_envelope_shift__DOT__eg_timer = VL_RAND_RESET_I(13);
    vlSelf->opl3__DOT__channels__DOT__control_operators__DOT__operator__DOT__envelope_generator__DOT__calc_envelope_shift__DOT__eg_state = VL_RAND_RESET_I(1);
    vlSelf->opl3__DOT__channels__DOT__control_operators__DOT__operator__DOT__envelope_generator__DOT__calc_envelope_shift__DOT__eg_add = VL_RAND_RESET_I(4);
    vlSelf->opl3__DOT__channels__DOT__control_operators__DOT__operator__DOT__envelope_generator__DOT__calc_envelope_shift__DOT__ks_p0 = VL_RAND_RESET_I(4);
    vlSelf->opl3__DOT__channels__DOT__control_operators__DOT__operator__DOT__envelope_generator__DOT__calc_envelope_shift__DOT__rate_p1 = VL_RAND_RESET_I(7);
    vlSelf->opl3__DOT__channels__DOT__control_operators__DOT__operator__DOT__envelope_generator__DOT__calc_envelope_shift__DOT__rate_hi_p1 = VL_RAND_RESET_I(4);
    vlSelf->opl3__DOT__channels__DOT__control_operators__DOT__operator__DOT__envelope_generator__DOT__calc_envelope_shift__DOT__rate_lo_p1 = VL_RAND_RESET_I(2);
    vlSelf->opl3__DOT__channels__DOT__control_operators__DOT__operator__DOT__envelope_generator__DOT__calc_envelope_shift__DOT__eg_timer_lo = VL_RAND_RESET_I(2);
    vlSelf->opl3__DOT__channels__DOT__control_operators__DOT__operator__DOT__envelope_generator__DOT__calc_envelope_shift__DOT__eg_shift_p1 = VL_RAND_RESET_I(6);
    vlSelf->opl3__DOT__channels__DOT__control_operators__DOT__operator__DOT__envelope_generator__DOT__calc_envelope_shift__DOT__requested_rate_not_zero_p1 = VL_RAND_RESET_I(1);
    vlSelf->opl3__DOT__channels__DOT__control_operators__DOT__operator__DOT__envelope_generator__DOT__calc_envelope_shift__DOT__env_shift_pre_p1 = VL_RAND_RESET_I(3);
    vlSelf->opl3__DOT__channels__DOT__control_operators__DOT__operator__DOT__envelope_generator__DOT__calc_envelope_shift__DOT__bank_num_p = VL_RAND_RESET_I(3);
    vlSelf->opl3__DOT__channels__DOT__control_operators__DOT__operator__DOT__envelope_generator__DOT__calc_envelope_shift__DOT__op_num_p = VL_RAND_RESET_I(15);
    vlSelf->opl3__DOT__channels__DOT__control_operators__DOT__operator__DOT__envelope_generator__DOT__calc_envelope_shift__DOT____Vcellout__sample_clk_en_sr__out = VL_RAND_RESET_I(3);
    for (int __Vi0 = 0; __Vi0 < 2; ++__Vi0) {
        vlSelf->opl3__DOT__channels__DOT__control_operators__DOT__operator__DOT__envelope_generator__DOT__env_int_mem__DOT__dob_array[__Vi0] = VL_RAND_RESET_I(9);
    }
    vlSelf->opl3__DOT__channels__DOT__control_operators__DOT__operator__DOT__envelope_generator__DOT__env_int_mem__DOT____Vcellinp__bankgen__BRA__0__KET____DOT__genblk1__DOT__mem_bank__wea = VL_RAND_RESET_I(1);
    vlSelf->opl3__DOT__channels__DOT__control_operators__DOT__operator__DOT__envelope_generator__DOT__env_int_mem__DOT____Vcellinp__bankgen__BRA__1__KET____DOT__genblk1__DOT__mem_bank__wea = VL_RAND_RESET_I(1);
    for (int __Vi0 = 0; __Vi0 < 18; ++__Vi0) {
        vlSelf->opl3__DOT__channels__DOT__control_operators__DOT__operator__DOT__envelope_generator__DOT__env_int_mem__DOT__bankgen__BRA__0__KET____DOT__genblk1__DOT__mem_bank__DOT__ram[__Vi0] = VL_RAND_RESET_I(9);
    }
    vlSelf->opl3__DOT__channels__DOT__control_operators__DOT__operator__DOT__envelope_generator__DOT__env_int_mem__DOT__bankgen__BRA__0__KET____DOT__genblk1__DOT__mem_bank__DOT____Vlvbound_hb6d43ef3__0 = VL_RAND_RESET_I(9);
    for (int __Vi0 = 0; __Vi0 < 18; ++__Vi0) {
        vlSelf->opl3__DOT__channels__DOT__control_operators__DOT__operator__DOT__envelope_generator__DOT__env_int_mem__DOT__bankgen__BRA__1__KET____DOT__genblk1__DOT__mem_bank__DOT__ram[__Vi0] = VL_RAND_RESET_I(9);
    }
    vlSelf->opl3__DOT__channels__DOT__control_operators__DOT__operator__DOT__envelope_generator__DOT__env_int_mem__DOT__bankgen__BRA__1__KET____DOT__genblk1__DOT__mem_bank__DOT____Vlvbound_hb6d43ef3__0 = VL_RAND_RESET_I(9);
    vlSelf->opl3__DOT__channels__DOT__control_operators__DOT__operator__DOT__envelope_generator__DOT__tremolo__DOT__tremolo_index_p1 = VL_RAND_RESET_I(14);
    vlSelf->opl3__DOT__channels__DOT__control_operators__DOT__operator__DOT__envelope_generator__DOT__tremolo__DOT__am_val_tmp1_p1 = VL_RAND_RESET_I(6);
    vlSelf->opl3__DOT__channels__DOT__control_operators__DOT__operator__DOT__envelope_generator__DOT__tremolo__DOT__dam_p1 = VL_RAND_RESET_I(1);
    vlSelf->opl3__DOT__channels__DOT__control_operators__DOT__operator__DOT__phase_generator__DOT__phase_acc_p2 = VL_RAND_RESET_I(20);
    vlSelf->opl3__DOT__channels__DOT__control_operators__DOT__operator__DOT__phase_generator__DOT__phase_acc_p3 = VL_RAND_RESET_I(20);
    vlSelf->opl3__DOT__channels__DOT__control_operators__DOT__operator__DOT__phase_generator__DOT__final_phase_p3 = VL_RAND_RESET_I(10);
    vlSelf->opl3__DOT__channels__DOT__control_operators__DOT__operator__DOT__phase_generator__DOT__theta_p3 = VL_RAND_RESET_I(8);
    vlSelf->opl3__DOT__channels__DOT__control_operators__DOT__operator__DOT__phase_generator__DOT__rhythm_phase_p3 = VL_RAND_RESET_I(10);
    vlSelf->opl3__DOT__channels__DOT__control_operators__DOT__operator__DOT__phase_generator__DOT__log_sin_out_p4 = VL_RAND_RESET_I(12);
    vlSelf->opl3__DOT__channels__DOT__control_operators__DOT__operator__DOT__phase_generator__DOT__pre_gain_p4 = VL_RAND_RESET_I(13);
    vlSelf->opl3__DOT__channels__DOT__control_operators__DOT__operator__DOT__phase_generator__DOT__post_gain_p4 = VL_RAND_RESET_I(15);
    vlSelf->opl3__DOT__channels__DOT__control_operators__DOT__operator__DOT__phase_generator__DOT__ws_post_opl_p0 = VL_RAND_RESET_I(3);
    vlSelf->opl3__DOT__channels__DOT__control_operators__DOT__operator__DOT__phase_generator__DOT__ws_post_opl_p = VL_RAND_RESET_I(18);
    vlSelf->opl3__DOT__channels__DOT__control_operators__DOT__operator__DOT__phase_generator__DOT__bank_num_p = VL_RAND_RESET_I(6);
    vlSelf->opl3__DOT__channels__DOT__control_operators__DOT__operator__DOT__phase_generator__DOT__op_num_p = VL_RAND_RESET_I(30);
    VL_RAND_RESET_W(65, vlSelf->opl3__DOT__channels__DOT__control_operators__DOT__operator__DOT__phase_generator__DOT__modulation_p);
    vlSelf->opl3__DOT__channels__DOT__control_operators__DOT__operator__DOT__phase_generator__DOT__final_phase_p = VL_RAND_RESET_I(30);
    vlSelf->opl3__DOT__channels__DOT__control_operators__DOT__operator__DOT__phase_generator__DOT__env_shifted_p4 = VL_RAND_RESET_I(14);
    vlSelf->opl3__DOT__channels__DOT__control_operators__DOT__operator__DOT__phase_generator__DOT__level_p4 = VL_RAND_RESET_I(13);
    vlSelf->opl3__DOT__channels__DOT__control_operators__DOT__operator__DOT__phase_generator__DOT__level_p5 = VL_RAND_RESET_I(13);
    vlSelf->opl3__DOT__channels__DOT__control_operators__DOT__operator__DOT__phase_generator__DOT__exp_out_p5 = VL_RAND_RESET_I(10);
    vlSelf->opl3__DOT__channels__DOT__control_operators__DOT__operator__DOT__phase_generator__DOT__neg_p5 = VL_RAND_RESET_I(13);
    vlSelf->opl3__DOT__channels__DOT__control_operators__DOT__operator__DOT__phase_generator__DOT____Vcellout__sample_clk_en_sr__out = VL_RAND_RESET_I(6);
    for (int __Vi0 = 0; __Vi0 < 2; ++__Vi0) {
        vlSelf->opl3__DOT__channels__DOT__control_operators__DOT__operator__DOT__phase_generator__DOT__phase_acc_mem__DOT__dob_array[__Vi0] = VL_RAND_RESET_I(20);
    }
    vlSelf->opl3__DOT__channels__DOT__control_operators__DOT__operator__DOT__phase_generator__DOT__phase_acc_mem__DOT__bankb_p = VL_RAND_RESET_I(2);
    for (int __Vi0 = 0; __Vi0 < 18; ++__Vi0) {
        vlSelf->opl3__DOT__channels__DOT__control_operators__DOT__operator__DOT__phase_generator__DOT__phase_acc_mem__DOT__bankgen__BRA__0__KET____DOT__genblk1__DOT__mem_bank__DOT__ram[__Vi0] = VL_RAND_RESET_I(20);
    }
    vlSelf->opl3__DOT__channels__DOT__control_operators__DOT__operator__DOT__phase_generator__DOT__phase_acc_mem__DOT__bankgen__BRA__0__KET____DOT__genblk1__DOT__mem_bank__DOT__genblk1__DOT__dob_p1 = VL_RAND_RESET_I(20);
    vlSelf->opl3__DOT__channels__DOT__control_operators__DOT__operator__DOT__phase_generator__DOT__phase_acc_mem__DOT__bankgen__BRA__0__KET____DOT__genblk1__DOT__mem_bank__DOT__genblk1__DOT__genblk1__DOT__dob_p2 = VL_RAND_RESET_I(20);
    vlSelf->opl3__DOT__channels__DOT__control_operators__DOT__operator__DOT__phase_generator__DOT__phase_acc_mem__DOT__bankgen__BRA__0__KET____DOT__genblk1__DOT__mem_bank__DOT____Vlvbound_hbe76e32b__0 = VL_RAND_RESET_I(20);
    for (int __Vi0 = 0; __Vi0 < 18; ++__Vi0) {
        vlSelf->opl3__DOT__channels__DOT__control_operators__DOT__operator__DOT__phase_generator__DOT__phase_acc_mem__DOT__bankgen__BRA__1__KET____DOT__genblk1__DOT__mem_bank__DOT__ram[__Vi0] = VL_RAND_RESET_I(20);
    }
    vlSelf->opl3__DOT__channels__DOT__control_operators__DOT__operator__DOT__phase_generator__DOT__phase_acc_mem__DOT__bankgen__BRA__1__KET____DOT__genblk1__DOT__mem_bank__DOT__genblk1__DOT__dob_p1 = VL_RAND_RESET_I(20);
    vlSelf->opl3__DOT__channels__DOT__control_operators__DOT__operator__DOT__phase_generator__DOT__phase_acc_mem__DOT__bankgen__BRA__1__KET____DOT__genblk1__DOT__mem_bank__DOT__genblk1__DOT__genblk1__DOT__dob_p2 = VL_RAND_RESET_I(20);
    vlSelf->opl3__DOT__channels__DOT__control_operators__DOT__operator__DOT__phase_generator__DOT__phase_acc_mem__DOT__bankgen__BRA__1__KET____DOT__genblk1__DOT__mem_bank__DOT____Vlvbound_hbe76e32b__0 = VL_RAND_RESET_I(20);
    vlSelf->opl3__DOT__channels__DOT__control_operators__DOT__operator__DOT__phase_generator__DOT__calc_rhythm_phase__DOT__hh_phase_friend = VL_RAND_RESET_I(10);
    vlSelf->opl3__DOT__channels__DOT__control_operators__DOT__operator__DOT__phase_generator__DOT__calc_rhythm_phase__DOT__tc_phase_friend = VL_RAND_RESET_I(10);
    vlSelf->opl3__DOT__channels__DOT__control_operators__DOT__operator__DOT__phase_generator__DOT__calc_rhythm_phase__DOT__hh_phase_p2 = VL_RAND_RESET_I(10);
    vlSelf->opl3__DOT__channels__DOT__control_operators__DOT__operator__DOT__phase_generator__DOT__calc_rhythm_phase__DOT__rm_xor_p2 = VL_RAND_RESET_I(1);
    vlSelf->opl3__DOT__channels__DOT__control_operators__DOT__operator__DOT__phase_generator__DOT__calc_rhythm_phase__DOT__rand_num = VL_RAND_RESET_I(24);
    vlSelf->opl3__DOT__channels__DOT__control_operators__DOT__operator__DOT__phase_generator__DOT__calc_rhythm_phase__DOT__op_type_p = VL_RAND_RESET_I(9);
    vlSelf->opl3__DOT__channels__DOT__control_operators__DOT__operator__DOT__phase_generator__DOT__calc_rhythm_phase__DOT__bank_num_p = VL_RAND_RESET_I(3);
    vlSelf->opl3__DOT__channels__DOT__control_operators__DOT__operator__DOT__phase_generator__DOT__calc_rhythm_phase__DOT__op_num_p = VL_RAND_RESET_I(15);
    vlSelf->opl3__DOT__channels__DOT__control_operators__DOT__operator__DOT__phase_generator__DOT__calc_rhythm_phase__DOT____Vcellout__sample_clk_en_sr__out = VL_RAND_RESET_I(3);
    for (int __Vi0 = 0; __Vi0 < 2; ++__Vi0) {
        vlSelf->opl3__DOT__channels__DOT__control_operators__DOT__operator__DOT__feedback_mem__DOT__dob_array[__Vi0] = VL_RAND_RESET_I(26);
    }
    vlSelf->opl3__DOT__channels__DOT__control_operators__DOT__operator__DOT__feedback_mem__DOT__bankb_p = VL_RAND_RESET_I(2);
    for (int __Vi0 = 0; __Vi0 < 18; ++__Vi0) {
        vlSelf->opl3__DOT__channels__DOT__control_operators__DOT__operator__DOT__feedback_mem__DOT__bankgen__BRA__0__KET____DOT__genblk1__DOT__mem_bank__DOT__ram[__Vi0] = VL_RAND_RESET_I(26);
    }
    vlSelf->opl3__DOT__channels__DOT__control_operators__DOT__operator__DOT__feedback_mem__DOT__bankgen__BRA__0__KET____DOT__genblk1__DOT__mem_bank__DOT__genblk1__DOT__dob_p1 = VL_RAND_RESET_I(26);
    vlSelf->opl3__DOT__channels__DOT__control_operators__DOT__operator__DOT__feedback_mem__DOT__bankgen__BRA__0__KET____DOT__genblk1__DOT__mem_bank__DOT____Vlvbound_hbc745659__0 = VL_RAND_RESET_I(26);
    for (int __Vi0 = 0; __Vi0 < 18; ++__Vi0) {
        vlSelf->opl3__DOT__channels__DOT__control_operators__DOT__operator__DOT__feedback_mem__DOT__bankgen__BRA__1__KET____DOT__genblk1__DOT__mem_bank__DOT__ram[__Vi0] = VL_RAND_RESET_I(26);
    }
    vlSelf->opl3__DOT__channels__DOT__control_operators__DOT__operator__DOT__feedback_mem__DOT__bankgen__BRA__1__KET____DOT__genblk1__DOT__mem_bank__DOT__genblk1__DOT__dob_p1 = VL_RAND_RESET_I(26);
    vlSelf->opl3__DOT__channels__DOT__control_operators__DOT__operator__DOT__feedback_mem__DOT__bankgen__BRA__1__KET____DOT__genblk1__DOT__mem_bank__DOT____Vlvbound_hbc745659__0 = VL_RAND_RESET_I(26);
    for (int __Vi0 = 0; __Vi0 < 2; ++__Vi0) {
        vlSelf->opl3__DOT__channels__DOT__operator_out_mem__DOT__dob_array[__Vi0] = VL_RAND_RESET_I(13);
    }
    vlSelf->opl3__DOT__channels__DOT__operator_out_mem__DOT__bankb_p = VL_RAND_RESET_I(2);
    for (int __Vi0 = 0; __Vi0 < 18; ++__Vi0) {
        vlSelf->opl3__DOT__channels__DOT__operator_out_mem__DOT__bankgen__BRA__0__KET____DOT__genblk1__DOT__mem_bank__DOT__ram[__Vi0] = VL_RAND_RESET_I(13);
    }
    vlSelf->opl3__DOT__channels__DOT__operator_out_mem__DOT__bankgen__BRA__0__KET____DOT__genblk1__DOT__mem_bank__DOT__genblk1__DOT__dob_p1 = VL_RAND_RESET_I(13);
    vlSelf->opl3__DOT__channels__DOT__operator_out_mem__DOT__bankgen__BRA__0__KET____DOT__genblk1__DOT__mem_bank__DOT____Vlvbound_h1f1451d1__0 = VL_RAND_RESET_I(13);
    for (int __Vi0 = 0; __Vi0 < 18; ++__Vi0) {
        vlSelf->opl3__DOT__channels__DOT__operator_out_mem__DOT__bankgen__BRA__1__KET____DOT__genblk1__DOT__mem_bank__DOT__ram[__Vi0] = VL_RAND_RESET_I(13);
    }
    vlSelf->opl3__DOT__channels__DOT__operator_out_mem__DOT__bankgen__BRA__1__KET____DOT__genblk1__DOT__mem_bank__DOT__genblk1__DOT__dob_p1 = VL_RAND_RESET_I(13);
    vlSelf->opl3__DOT__channels__DOT__operator_out_mem__DOT__bankgen__BRA__1__KET____DOT__genblk1__DOT__mem_bank__DOT____Vlvbound_h1f1451d1__0 = VL_RAND_RESET_I(13);
    vlSelf->opl3__DOT__channels__DOT__dac_prep__DOT__sample_valid_opl3_p1 = VL_RAND_RESET_I(1);
    vlSelf->opl3__DOT__channels__DOT__dac_prep__DOT__sample_opl3_l_p1 = VL_RAND_RESET_I(24);
    vlSelf->opl3__DOT__channels__DOT__dac_prep__DOT__sample_opl3_r_p1 = VL_RAND_RESET_I(24);
    vlSelf->opl3__DOT__genblk1__DOT__timers__DOT__timer1 = VL_RAND_RESET_I(8);
    vlSelf->opl3__DOT__genblk1__DOT__timers__DOT__timer2 = VL_RAND_RESET_I(8);
    vlSelf->opl3__DOT__genblk1__DOT__timers__DOT__irq_rst = VL_RAND_RESET_I(1);
    vlSelf->opl3__DOT__genblk1__DOT__timers__DOT__mt1 = VL_RAND_RESET_I(1);
    vlSelf->opl3__DOT__genblk1__DOT__timers__DOT__mt2 = VL_RAND_RESET_I(1);
    vlSelf->opl3__DOT__genblk1__DOT__timers__DOT__st1 = VL_RAND_RESET_I(1);
    vlSelf->opl3__DOT__genblk1__DOT__timers__DOT__st2 = VL_RAND_RESET_I(1);
    vlSelf->opl3__DOT__genblk1__DOT__timers__DOT__timer1_overflow_pulse = VL_RAND_RESET_I(1);
    vlSelf->opl3__DOT__genblk1__DOT__timers__DOT__timer2_overflow_pulse = VL_RAND_RESET_I(1);
    vlSelf->opl3__DOT__genblk1__DOT__timers__DOT__ft1 = VL_RAND_RESET_I(1);
    vlSelf->opl3__DOT__genblk1__DOT__timers__DOT__ft2 = VL_RAND_RESET_I(1);
    vlSelf->opl3__DOT__genblk1__DOT__timers__DOT__irq = VL_RAND_RESET_I(1);
    vlSelf->opl3__DOT__genblk1__DOT__timers__DOT__timer1_inst__DOT__tick_counter = VL_RAND_RESET_I(12);
    vlSelf->opl3__DOT__genblk1__DOT__timers__DOT__timer1_inst__DOT__tick_pulse = VL_RAND_RESET_I(1);
    vlSelf->opl3__DOT__genblk1__DOT__timers__DOT__timer1_inst__DOT__timer = VL_RAND_RESET_I(8);
    vlSelf->opl3__DOT__genblk1__DOT__timers__DOT__timer1_inst__DOT__start_timer_set_pulse = VL_RAND_RESET_I(1);
    vlSelf->opl3__DOT__genblk1__DOT__timers__DOT__timer1_inst__DOT__start_timer_edge_detect__DOT__in_r0 = VL_RAND_RESET_I(1);
    vlSelf->opl3__DOT__genblk1__DOT__timers__DOT__timer2_inst__DOT__tick_counter = VL_RAND_RESET_I(14);
    vlSelf->opl3__DOT__genblk1__DOT__timers__DOT__timer2_inst__DOT__tick_pulse = VL_RAND_RESET_I(1);
    vlSelf->opl3__DOT__genblk1__DOT__timers__DOT__timer2_inst__DOT__timer = VL_RAND_RESET_I(8);
    vlSelf->opl3__DOT__genblk1__DOT__timers__DOT__timer2_inst__DOT__start_timer_set_pulse = VL_RAND_RESET_I(1);
    vlSelf->opl3__DOT__genblk1__DOT__timers__DOT__timer2_inst__DOT__start_timer_edge_detect__DOT__in_r0 = VL_RAND_RESET_I(1);
    vlSelf->__Vtrigprevexpr___TOP__opl3__DOT__channels__DOT____Vcellout__ch_abcd_cnt_mem__dob__0 = VL_RAND_RESET_I(8);
    vlSelf->__VstlDidInit = 0;
    vlSelf->__Vtrigprevexpr___TOP__opl3__DOT__channels__DOT____Vcellout__ch_abcd_cnt_mem__dob__1 = VL_RAND_RESET_I(8);
    vlSelf->__Vtrigprevexpr___TOP__clk__0 = VL_RAND_RESET_I(1);
    vlSelf->__Vtrigprevexpr___TOP__ic_n__0 = VL_RAND_RESET_I(1);
    vlSelf->__Vtrigprevexpr___TOP__clk_host__0 = VL_RAND_RESET_I(1);
    vlSelf->__Vtrigprevexpr___TOP__opl3__DOT__host_if__DOT____Vcellinp__afifo__i_rd_reset_n__0 = VL_RAND_RESET_I(1);
    vlSelf->__VactDidInit = 0;
}
